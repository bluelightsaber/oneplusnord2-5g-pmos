// SPDX-License-Identifier: GPL-2.0-only
/*
 * OnePlus Nord 2 5G (denniz) - generated from the chopin board file by scripts/mk-denniz-dts.py
 *
 * Board file: model, memory map and the wiring that is specific to this
 * handset.  The SoC side lives in mt6893.dtsi.
 */

/dts-v1/;

#include "mt6893.dtsi"

/ {
	model = "OnePlus Nord 2 5G (denniz)";
	compatible = "oneplus,denniz", "mediatek,MT6893";
	interrupt-parent = <&gic>;
	#address-cells = <0x02>;
	#size-cells = <0x02>;

	bootprof {
		lk_logo_t = <0x3ee>;
		lk_t = <0xe29>;
		pl_t = <0xaa4>;
	};
	md_attr_node {
		mediatek,md_product_name_model_id = <0xf0f0f0f>;
		mediatek,md_drdi_rf_set_idx = <0x0a>;
		compatible = "mediatek,md_attr_node";
	};
	firmware {

		android {
			mode = "normal";
			/* serialno removed: identify the device, not the board */
			hardware = "mt6893";
			compatible = "android,firmware";
			vbmeta.hash_alg = "sha256";
		};
	};
	mt6360_pmu: mt6360_pmu_dts {
		status = "ok";
		mt6360,intr_gpio_num = <0x18>;
		mt6360,intr_gpio = <0x02 0x18 0x00>;
		interrupt-controller;
		#interrupt-cells = <0x02>;
		phandle = <0x03>;

		adc: adc {
			compatible = "mediatek,mt6360_pmu_adc";
			interrupt-parent = <&mt6360_pmu>;
			interrupts = <0x29 0x00 0x2b 0x00 0x2c 0x00>;
			interrupt-names = "bat_ovp_adc_evt", "adc_wakeup_evt", "adc_donei";
			#io-channel-cells = <0x01>;
			phandle = <0x04>;
		};

		chg {
			compatible = "mediatek,mt6360_pmu_chg";
			interrupt-parent = <&mt6360_pmu>;
			interrupts = <0x04 0x00 0x06 0x00 0x07 0x00 0x09 0x00 0x0c 0x00 0x0d 0x00 0x0e 0x00 0x0f 0x00 0x1b 0x00 0x1d 0x00 0x20 0x00 0x23 0x00 0x28 0x00 0x30 0x00 0x3c 0x00>;
			interrupt-names = "chg_treg_evt", "chg_mivr_evt", "pwr_rdy_evt", "chg_batsysuv_evt", "chg_vsysuv_evt", "chg_vsysov_evt", "chg_vbatov_evt", "chg_vbusov_evt", "chg_tmri", "chg_adpbadi", "chg_aiccmeasl", "wdtmri", "pumpx_donei", "attachi", "chrdet_ext_evt";
			io-channels = <0x04 0x00 0x04 0x01 0x04 0x03 0x04 0x04 0x04 0x05 0x04 0x06 0x04 0x08 0x04 0x0a>;
			io-channel-names = "USBID", "VBUSDIV5", "VSYS", "VBAT", "IBUS", "IBAT", "TEMP_JC", "TS";
			chg_name = "primary_chg";
			ichg = <0x1e8480>;
			aicr = <0x7a120>;
			mivr = <0x432380>;
			cv = <0x43e6d0>;
			ieoc = <0x30d40>;
			safety_timer = <0x0c>;
			ircmp_resistor = <0x00>;
			ircmp_vclamp = <0x00>;
			en_te = <0x01>;
			en_wdt = <0x01>;
			en_otg_wdt = <0x01>;
			aicc_once = <0x01>;
			post_aicc = <0x01>;
			batoc_notify = <0x00>;
			en_eoc = <0x01>;
		};

		fled {
			compatible = "mediatek,mt6360_pmu_fled";
			interrupt-parent = <&mt6360_pmu>;
			interrupts = <0x0b 0x00 0x4a 0x00 0x4b 0x00 0x4e 0x00 0x4f 0x00>;
			interrupt-names = "fled_chg_vinovp_evt", "fled_tx_evt", "fled_lvf_evt", "fled2_short_evt", "fled1_short_evt";
			fled_vmid_track = <0x00>;
			fled_strb_tout = <0x4e0>;
			fled1_tor_cur = <0x927c>;
			fled1_strb_cur = <0xb71b0>;
			fled2_tor_cur = <0x927c>;
			fled2_strb_cur = "", "\f5";
		};

		rgbled {
			compatible = "mediatek,mt6360_pmu_rgbled";
			mt,led_name = "red", "green", "blue", "mt6360_pmu_led4";
			mt,led_default_trigger = "cc_mode", "cc_mode", "cc_mode", "none";
		};

		core {
			compatible = "mediatek,mt6360_pmu_core";
			interrupt-parent = <&mt6360_pmu>;
			interrupts = <0x41 0x00 0x42 0x00 0x43 0x00 0x44 0x00 0x45 0x00 0x46 0x00 0x47 0x00>;
			interrupt-names = "ap_wdtrst_evt", "en_evt", "qonb_rst_evt", "mrstb_evt", "otp_evt", "vddaov_evt", "sysuv_evt";
			mren = <0x01>;
			apwdtrst_en = <0x01>;
			cc_open_sel = <0x03>;
			i2c_cc_open_tsel = <0x01>;
			ldo5_otp_en = <0x00>;
			sda_sizesel = <0x03>;
			sda_drvsrsel = <0x01>;
		};
	};
	mt6360_pmic: mt6360_pmic_dts {
		status = "ok";
		interrupt-parent = <&mt6360_pmu>;
		interrupts = <0x60 0x00 0x64 0x00 0x65 0x00 0x66 0x00 0x68 0x00 0x6c 0x00 0x6d 0x00 0x6e 0x00 0x76 0x00 0x77 0x00 0x7e 0x00 0x7f 0x00>;
		interrupt-names = "buck1_pgb_evt", "buck1_oc_evt", "buck1_ov_evt", "buck1_uv_evt", "buck2_pgb_evt", "buck2_oc_evt", "buck2_ov_evt", "buck2_uv_evt", "ldo6_oc_evt", "ldo7_oc_evt", "ldo6_pgb_evt", "ldo7_pgb_evt";
		pwr_off_seq = <0x4000202>;
		phandle = <0xef>;

		buck1 {
			regulator-compatible = "BUCK1";
			regulator-name = "VMDLA";
			regulator-min-microvolt = <0x493e0>;
			regulator-max-microvolt = <0x13d620>;
			regulator-always-on;
		};

		buck2 {
			regulator-compatible = "BUCK2";
			regulator-name = "VDRAM1";
			regulator-min-microvolt = <0x493e0>;
			regulator-max-microvolt = <0x13d620>;
			regulator-always-on;
		};

		ldo6 {
			regulator-compatible = "LDO6";
			regulator-name = "VMDDR";
			regulator-min-microvolt = <0x7a120>;
			regulator-max-microvolt = <0x200b20>;
		};

		ldo7 {
			regulator-compatible = "LDO7";
			regulator-name = "VDRAM2";
			regulator-min-microvolt = <0x7a120>;
			regulator-max-microvolt = <0x200b20>;
			regulator-always-on;
		};
	};
	mt6360_ldo: mt6360_ldo_dts {
		status = "ok";
		interrupt-parent = <&mt6360_pmu>;
		interrupts = <0x71 0x00 0x72 0x00 0x73 0x00 0x75 0x00 0x79 0x00 0x7a 0x00 0x7b 0x00 0x7d 0x00>;
		interrupt-names = "ldo1_oc_evt", "ldo2_oc_evt", "ldo3_oc_evt", "ldo5_oc_evt", "ldo1_pgb_evt", "ldo2_pgb_evt", "ldo3_pgb_evt", "ldo5_pgb_evt";
		phandle = <0xf0>;

		mt_pmic_vmc_ldo_reg: ldo1 {
			regulator-compatible = "LDO1";
			regulator-name = "VFP";
			regulator-min-microvolt = <0x124f80>;
			regulator-max-microvolt = <0x36ee80>;
			regulator-always-on;
			phandle = <0x1e5>;
		};

		mt_pmic_vtp_ldo_reg: ldo2 {
			regulator-compatible = "LDO2";
			regulator-name = "vtp";
			regulator-min-microvolt = <0x124f80>;
			regulator-max-microvolt = <0x36ee80>;
			phandle = <0xf1>;
			regulator-always-on;
			status = "okay";
		};

		mt_pmic_vfp_ldo_reg: ldo3 {
			regulator-compatible = "LDO3";
			regulator-name = "VMC";
			regulator-min-microvolt = <0x124f80>;
			regulator-max-microvolt = <0x36ee80>;
			phandle = <0x260>;
		};

		mt_pmic_vmch_ldo_reg: ldo5 {
			regulator-compatible = "LDO5";
			regulator-name = "VMCH";
			regulator-min-microvolt = <0x2932e0>;
			regulator-max-microvolt = <0x36ee80>;
			phandle = <0x51>;
		};
	};
	chosen: chosen {
		mrdump,lk = "MRDUMP11";
		mrdump,cblock = <0x11e000 0x2000>;
		mrdump,ddr_rsv = "yes";
		aee,enable = "mini";
		atag,chipid = <0x6000000 0x50090000 0x8a0000 0xca0000 0x0>;
		linux,initrd-end = <0x524d748b>;
		dfd,cache_dump_support = <0x01>;
		dfd,base_addr_msb = <0x75000000>;
		dfd,base_addr = <0x00 0x75000000>;
		non_secure_sram = <0xdc1000 0x240100>;
		atag,masp = <0x16000000 0x66080041 0x11000000 0x22000000 0x1000000 0x0 0x4e7ce573 0xe6e2bae4 0xa2b512a4 0xf5b21d19 0x31413532 0x41333637 0x43423132 0x43343538 0xd1d93cd4 0x53265e94 0x0 0x0 0x0 0x0 0x0 0x0>;
		atag,ptp = <0x6000000 0x8004154 0x0 0x0 0x0 0x0>;
		ccci,modem_info_v2 = <0xf7bf 0x00 0x680a0000 0x00 0x3000000 0x14000000 0x1000000 0x00 0x00 0x00 0x00 0x00>;
		atag,mdinfo = <0x3000000 0x6080041 0x0>;
		atag,videolfb = <0xa277 0x0 0x1000000 0xa8170000 0x7e02 0x6b313061 0x5f33365f 0x30325f30 0x615f6473 0x635f7664 0x6f5f6c63 0x6d5f6472 0x76000000>;
		atag,devinfo = <0xdc000000 0x00 0x00 0x00 0x80 0x452202 0x00 0x200ce21 0x10002800 0x50090000 0x50090000 0x400ab56 0x40040000 0x40e0f8a4 0x57742cc 0x2abe1487 0x1b2fa05c 0x00 0xca0000 0x50090000 0x50090000 0x50090000 0x00 0x5000000 0x00 0x00 0x00 0x8000000 0x4e000000 0x50090000 0x00 0x10000000 0x00 0x00 0x00 0x1000000 0x1000000 0x00 0x00 0x00 0x00 0x00 0x00 0x50090000 0x00 0x00 0x00 0x00 0x50090000 0x50090000 0x00 0x3001500 0x9f245c92 0xf624a481 0x84255e24 0x93245526 0xc624a6f3 0x00 0x8a2454c5 0x932453d2 0xc624a79a 0x9024a596 0x9f244dc2 0xf624a691 0x31bfba8 0x84241420 0x8424ea5b 0x2324160f 0x8d2494a9 0x8e249bb6 0x10000 0xb9b0b9b 0x8a25b29d 0xdbd6a2c0 0x2316b66 0x00 0x50090000 0x00 0x00 0x00 0x00 0xd1d93cd4 0x5f2d24d9 0x7bf5373c 0x3b5468e9 0x53265e94 0xf78ae5e2 0x2a2d6550 0xefc6c691 0x00 0x00 0x00 0x00 0x00 0x00 0x00 0x00 0x00 0x00 0x50090000 0x50090000 0x10001c1c 0x1c000013 0x14131315 0x25220000 0xa4b51863 0x890904a 0x00 0x8081400 0x10000000 0x4419638c 0xc418658c 0x4429658c 0x44196594 0xfccd7600 0x78780e06 0x00 0x3c 0xd6890000 0xc489000a 0x6e890050 0x00 0x00 0x00 0x00 0x00 0x00 0x00 0x50090000 0x50090000 0x50090000 0x00 0x00 0x270c0000 0x00 0x60 0x25801028 0x2deebd30 0xb60efe48 0xe0f85058 0x1500bd 0xf0 0x00 0x50090000 0x50090000 0x50090000 0x50090000 0x50090000 0x50090000 0x50090000 0x50090000 0x00 0x00 0x00 0x00 0x00 0x00 0x00 0x00 0x00 0x00 0x00 0x00 0x00 0x00 0x00 0x00 0x00 0x00 0x00 0x00 0x00 0x00 0x00 0x50090000 0x50090000 0x50090000 0x50090000 0x50090000 0x50090000 0x50090000 0x00 0x50090000 0x50090000 0x50090000 0x50090000 0x50090000 0x50090000 0x50090000 0x50090000 0x50090000 0x3c890000 0x789000a 0xe890054 0xc3880000 0xb688000a 0xc7880048 0x32870000 0x838a000a 0x3389004c 0xc2860000 0x5a89000a 0x7a89003e 0xab890000 0x4e89000a 0x1c890043 0xf890000 0xe388000a 0x510a0035 0x00 0x00 0x50090000 0x50090000 0x64d665c0 0xa53d6ac3 0x9288148c 0x24a108ef 0x929af8 0x733f3170 0xd642763b 0x701b8393>;
		atag,mem = <0x6000000 0x2004254 0x0 0x0 0x0 0x0 0x6000000 0x2004254 0x0 0x0 0x0 0x0>;
		atag,two_sec_reboot = [30];
		atag,boot_voltage = [30];
		log_store = <0xdf1100 0x10000>;
		ram_console = <0xd01100 0x80000 0x1000000 0xc00e0000>;
		atag,shutdown_time = [30];
		atag,fg_swocv_i = [30];
		atag,fg_swocv_v = [30];
		atag,imix_r = <0xaa000000>;
		atag,boot = <0x3000000 0x2080041 0x0 0x2000000>;
		linux,initrd-start = <0x51100000>;
		plat_dbg_info,size = <0x80 0x1c 0x14>;
		plat_dbg_info,base = <0x11d80c 0x11d88c 0x11d8a8>;
		plat_dbg_info,key = <0xd8a3 0xe31c 0xdb45>;
		plat_dbg_info,max = <0x03>;
		bootargs = "console=tty0 console=ttyS0,921600n1 root=/dev/ram vmalloc=400M slub_debug=OFZPU swiotlb=noforce firmware_class.path=/vendor/firmware page_owner=on loop.max_part=7 has_battery_removed=0 loop.max_part=7 androidboot.boot_devices=bootdevice,soc/11230000.mmc,11230000.mmc,soc/11270000.ufshci,11270000.ufshci androidboot.rsc=cn panel_name=dsi_k10a_36_02_0a_dsc_vdo mtk_drm.panel_opt=0x46,0x36,0x32,0x01,0x4b,0x0a,0x31,0x00 WpAndMaxlum:0x7c,0x7d,0x56 ramoops.mem_address=0x48090000 ramoops.mem_size=0xe0000 ramoops.pmsg_size=0x10000 ramoops.console_size=0x40000 clk_ignore_unused bootopt=64S3,32N2,64N2 androidboot.serialconsole=0 root=/dev/ram androidboot.vbmeta.avb_version=1.2 androidboot.vbmeta.device_state=unlocked androidboot.veritymode=disabled androidboot.veritymode.managed=yes androidboot.slot_suffix=_a androidboot.slot=a androidboot.verifiedbootstate=orange androidboot.atm=disabled androidboot.force_normal_boot=1 androidboot.meta_log_disable=0 androidboot.tee_type=1 mtk_printk_ctrl.disable_uart=1 androidboot.bootreason=PowerKey androidboot.hwc=CN androidboot.hwlevel=MP androidboot.hwversion=1.9.0 androidboot.secureboot=1 androidboot.dp=3 androidboot.product.hardware.sku=chopin usb2jtag_mode=0 androidboot.dtb_idx=0 androidboot.dtbo_idx=0";
		kaslr-seed = <0x0 0x0>;
		phandle = <0xf3>;
		atag,videolfb-fb_base_l = <0x7e020000>;
		atag,videolfb-fb_base_h = <0x00>;
		atag,videolfb-islcmfound = <0x01>;
		atag,videolfb-islcm_inited = <0x00>;
		atag,videolfb-fps = <0x1770>;
		atag,videolfb-vramSize = <0x1be0000>;
		atag,videolfb-lcmname = "nt35595_fhd_dsi_cmd_truly_nt50358_drv";
		#address-cells = <0x02>;
		#size-cells = <0x02>;
		ranges;

		framebuffer@78e0c000 {
			compatible = "simple-framebuffer";
			reg = <0x0 0x78e0c000 0x0 0x9f6000>;
			width = <0x438>;
			height = <0x960>;
			stride = <0x1100>;
			format = "a8r8g8b8";
			status = "disabled";
		};
	};
	aliases {
		ovl0 = "/disp_ovl@14000000";
		ovl1 = "/disp_ovl@14100000";
		ovl3 = "/disp_ovl@14001000";
		ovl4 = "/disp_ovl@14101000";
		ovl5 = "/disp_ovl@14002000";
		ovl6 = "/disp_ovl@14102000";
		rdma0 = "/disp_rdma@14003000";
		rdma1 = "/disp_rdma@14103000";
		rdma4 = "/disp_rdma@14005000";
		rdma5 = "/disp_rdma@14105000";
		wdma0 = "/disp_wdma@14006000";
		wdma1 = "/disp_wdma@14106000";
		color0 = "/disp_color@14007000";
		color1 = "/disp_color@14107000";
		ccorr0 = "/disp_ccorr@14008000";
		ccorr1 = "/disp_ccorr@14108000";
		aal0 = "/disp_aal@14009000";
		aal1 = "/disp_aal@14109000";
		gamma0 = "/disp_gamma@1400a000";
		gamma1 = "/disp_gamma@1410a000";
		dither0 = "/disp_dither@1400b000";
		dither1 = "/disp_dither@1410b000";
		postmask0 = "/disp_postmask@1400d000";
		postmask1 = "/disp_postmask@1410d000";
		dsi0 = "/dsi@1400e000";
		merge1 = "/disp_merge@14115000";
		rsz0 = "/disp_rsz@1400c000";
		rsz1 = "/disp_rsz@1410c000";
		maal0 = "/mdp_aal4@14010000";
		maal1 = "/mdp_aal5@14110000";
	};
	disp_leds {
		compatible = "mediatek,disp-leds";

		backlight {
			label = "lcd-backlight";
			max-brightness = <0x7ff>;
			led-bits = <0x0b>;
			trans-bits = <0x0b>;
			default-state = "on";
		};
	};
	mtk_lpm: mtk_lpm {
		compatible = "mediatek,mtk-lpm";
		#address-cells = <0x02>;
		#size-cells = <0x02>;
		ranges;
		suspend-method = "s2idle";
		irq-remain = <0x13 0x14 0x15 0x16 0x17 0x18 0x19 0x1a 0x1b 0x1c 0x1d 0x1e 0x1f 0x20 0x21 0x22 0x23 0x24>;
		resource-ctrl = <0x25 0x26 0x27 0x28 0x29>;
		constraints = <0x2a 0x2b 0x2c>;
		phandle = <0xf7>;

		lpm_sysram: lpm_sysram@0011b500 {
			compatible = "mediatek,lpm-sysram";
			reg = <0x0 0x11b500 0x0 0x300>;
			phandle = <0xf8>;
		};

		irq-remain-list {

			edge_keypad: edge_keypad {
				target = <0x2d>;
				value = <0x01 0x00 0x00 0x04>;
				phandle = <0x13>;
			};

			edge_mdwdt: edge_mdwdt {
				target = <0x2e>;
				value = <0x01 0x00 0x80000000 0x2000000>;
				phandle = <0x14>;
			};

			level_vpu_core0: level_vpu_core0 {
				target = <0x2f>;
				value = <0x0 0x0 0x0 0x0>;
				phandle = <0x15>;
			};

			level_vpu_core1: level_vpu_core1 {
				target = <0x30>;
				value = <0x0 0x0 0x0 0x0>;
				phandle = <0x16>;
			};

			level_vpu_core2: level_vpu_core2 {
				target = <0x31>;
				value = <0x0 0x0 0x0 0x0>;
				phandle = <0x17>;
			};

			level_mtk_mdla0: level_mtk_mdla0 {
				target = <0x32>;
				value = <0x0 0x0 0x0 0x0>;
				phandle = <0x18>;
			};

			level_mtk_mdla1: level_mtk_mdla1 {
				target = <0x32>;
				value = <0x00 0x01 0x00 0x00>;
				phandle = <0x19>;
			};

			level_edma0: level_edma0 {
				target = <0x33>;
				value = <0x0 0x0 0x0 0x0>;
				phandle = <0x1a>;
			};

			level_edma1: level_edma1 {
				target = <0x34>;
				value = <0x0 0x0 0x0 0x0>;
				phandle = <0x1b>;
			};

			level_mali0: level_mali0 {
				target = <0x35>;
				value = <0x0 0x0 0x0 0x0>;
				phandle = <0x1c>;
			};

			level_mali1: level_mali1 {
				target = <0x35>;
				value = <0x00 0x01 0x00 0x00>;
				phandle = <0x1d>;
			};

			level_mali2: level_mali2 {
				target = <0x35>;
				value = <0x00 0x02 0x00 0x00>;
				phandle = <0x1e>;
			};

			level_mali3: level_mali3 {
				target = <0x35>;
				value = <0x00 0x03 0x00 0x00>;
				phandle = <0x1f>;
			};

			level_mali4: level_mali4 {
				target = <0x35>;
				value = <0x00 0x04 0x00 0x00>;
				phandle = <0x20>;
			};

			level_i2c0: level_i2c0 {
				target = <0x36>;
				value = <0x0 0x0 0x0 0x0>;
				phandle = <0x21>;
			};

			level_bt: level_bt {
				target = <0x37>;
				value = <0x0 0x0 0x0 0x0>;
				phandle = <0x24>;
			};

			level_btif_tx: level_btif_tx {
				target = <0x38>;
				value = <0x00 0x01 0x00 0x00>;
				phandle = <0x22>;
			};

			level_btif_rx: level_btif_rx {
				target = <0x38>;
				value = <0x00 0x02 0x00 0x00>;
				phandle = <0x23>;
			};
		};

		resource-ctrl-list {

			bus26m: bus26m {
				id = <0x0>;
				value = <0x0>;
				phandle = <0x25>;
			};

			infra: infra {
				id = <0x01>;
				value = <0x0>;
				phandle = <0x26>;
			};

			syspll: syspll {
				id = <0x02>;
				value = <0x0>;
				phandle = <0x27>;
			};

			dram_s0: dram_s0 {
				id = <0x03>;
				value = <0x0>;
				phandle = <0x28>;
			};

			dram_s1: dram_s1 {
				id = <0x04>;
				value = <0x0>;
				phandle = <0x29>;
			};
		};

		constraint-list {

			rc_bus26m: rc_bus26m {
				id = <0x0>;
				value = <0x01>;
				phandle = <0x2a>;
			};

			rc_syspll: rc_syspll {
				id = <0x01>;
				value = <0x01>;
				phandle = <0x2b>;
			};

			rc_dram: rc_dram {
				id = <0x02>;
				value = <0x01>;
				phandle = <0x2c>;
			};
		};
	};
	cpupm_sysram: cpupm-sysram@0011b000 {
		compatible = "mediatek,cpupm-sysram";
		reg = <0x0 0x11b000 0x0 0x500>;
		phandle = <0xf9>;
	};
	mcucfg_mp0_counter {
		compatible = "mediatek,mcucfg_mp0_counter";
		reg_mp0_counter_base = <0x39>;
	};
	mcusys_ctrl: mcusys-ctrl@0c53a000 {
		compatible = "mediatek,mcusys-ctrl";
		reg = <0x0 0xc53a000 0x0 0x1000>;
		phandle = <0xfa>;
	};
	dsu-pmu-0 {
		compatible = "arm,dsu-pmu";
		interrupts = <0x00 0x12 0x04>;
		cpus = <0x0b 0x0c 0x0d 0x0e 0x0f 0x10 0x11 0x12>;
	};
	memory {
		tee_reserved_mem = <0xe0bf 0x00 0x400 0x00>;
		lca_reserved_mem = <0x00 0x00 0x00 0x00>;
		mblock_info = <0xe000000 0x00 0x40 0x00 0x800 0x00 0x00 0x00 0xd047 0x00 0x3800 0x00 0x00 0x00 0x1848 0x00 0x800 0x00 0x00 0x00 0x6048 0x00 0x6000 0x00 0x00 0x00 0xe048 0x00 0x1000 0x00 0x00 0x00 0x1055 0x00 0xe00a 0x00 0x00 0x00 0xf85f 0x00 0x8917 0x00 0x00 0x00 0xe07f 0x00 0xb00 0x00 0x00 0x00 0xfb7f 0x00 0xf00000 0x00 0x00 0x00 0x80 0x00 0xe03f 0x00 0x00 0x00 0xe4bf 0x00 0x1400 0x00 0x00 0x00 0xc0 0x00 0xe63f 0x00 0x00 0x00 0xffff 0x00 0xf000c0 0x00 0x00 0x00 0xc0 0x1000000 0xf0ff7f 0x1000000 0x1000000 0x00 0x00 0x00 0x00 0x00 0x00 0x00 0x00 0x00 0x00 0x00 0x00 0x00 0x00 0x00 0x00 0x00 0x00 0x00 0x00 0x00 0x00 0x00 0x00 0x00 0x00 0x00 0x00 0x00 0x00 0x00 0x00 0x00 0x00 0x00 0x00 0x00 0x00 0x00 0x00 0x00 0x00 0x00 0x00 0x00 0x00 0x00 0x00 0x00 0x00 0x00 0x00 0x00 0x00 0x00 0x00 0x00 0x00 0x00 0x00 0x00 0x00 0x00 0x00 0x00 0x00 0x00 0x00 0x00 0x00 0x00 0x00 0x00 0x00 0x00 0x00 0x00 0x00 0x00 0x00 0x00 0x00 0x00 0x00 0x00 0x00 0x00 0x00 0x00 0x00 0x00 0x00 0x00 0x00 0x00 0x00 0x00 0x00 0x00 0x00 0x00 0x00 0x00 0x00 0x00 0x00 0x00 0x00 0x00 0x00 0x00 0x00 0x00 0x00 0x00 0x00 0x00 0x00 0x00 0x00 0x00 0x00 0x00 0x00 0x00 0x00 0x00 0x00 0x00 0x00 0x00 0x00 0x00 0x00 0x00 0x00 0x00 0x00 0x00 0x00 0x00 0x00 0x00 0x00 0x00 0x00 0x00 0x00 0x00 0x00 0x00 0x00 0x00 0x00 0x00 0x00 0x00 0x00 0x00 0x00 0x00 0x00 0x00 0x00 0x00 0x00 0x00 0x00 0x00 0x00 0x00 0x00 0x00 0x00 0x00 0x00 0x00 0x00 0x00 0x00 0x00 0x00 0x00 0x00 0x00 0x00 0x00 0x00 0x00 0x00 0x00 0x00 0x00 0x00 0x00 0x00 0x00 0x00 0x00 0x00 0x00 0x00 0x00 0x00 0x00 0x00 0x00 0x00 0x00 0x00 0x00 0x00 0x00 0x00 0x00 0x00 0x00 0x00 0x00 0x00 0x00 0x00 0x00 0x00 0x00 0x00 0x00 0x00 0x00 0x00 0x00 0x00 0x00 0x00 0x00 0x00 0x00 0x00 0x00 0x00 0x00 0x00 0x00 0x00 0x00 0x00 0x00 0x00 0x00 0x00 0x00 0x00 0x00 0x00 0x00 0x00 0x00 0x00 0x00 0x00 0x00 0x00 0x00 0x00 0x00 0x00 0x00 0x00 0x00 0x00 0x00 0x00 0x00 0x00 0x00 0x00 0x00 0x00 0x00 0x00 0x00 0x00 0x00 0x00 0x00 0x00 0x00 0x00 0x00 0x00 0x00 0x00 0x00 0x00 0x00 0x00 0x00 0x00 0x00 0x00 0x00 0x00 0x00 0x00 0x00 0x00 0x00 0x00 0x00 0x00 0x00 0x00 0x00 0x00 0x00 0x00 0x00 0x00 0x00 0x00 0x00 0x00 0x00 0x00 0x00 0x00 0x00 0x00 0x00 0x00 0x00 0x00 0x00 0x00 0x00 0x00 0x00 0x00 0x00 0x00 0x00 0x00 0x00 0x00 0x00 0x00 0x00 0x00 0x00 0x00 0x00 0x00 0x00 0x00 0x00 0x00 0x00 0x00 0x00 0x00 0x00 0x00 0x00 0x00 0x00 0x00 0x00 0x00 0x00 0x00 0x00 0x00 0x00 0x00 0x00 0x00 0x00 0x00 0x00 0x00 0x00 0x00 0x00 0x00 0x00 0x00 0x00 0x00 0x00 0x00 0x00 0x00 0x00 0x00 0x00 0x00 0x00 0x00 0x00 0x00 0x00 0x00 0x00 0x00 0x00 0x00 0x00 0x00 0x00 0x00 0x00 0x00 0x00 0x00 0x00 0x00 0x00 0x00 0x00 0x00 0x00 0x00 0x00 0x00 0x00 0x00 0x00 0x00 0x00 0x00 0x00 0x00 0x00 0x00 0x00 0x00 0x00 0x00 0x00 0x00 0x00 0x00 0x00 0x00 0x00 0x00 0x00 0x00 0x00 0x00 0x00 0x00 0x00 0x00 0x00 0x00 0x00 0x00 0x00 0x00 0x00 0x00 0x00 0x00 0x00 0x00 0x00 0x00 0x00 0x00 0x00 0x00 0x00 0x00 0x00 0x00 0x00 0x00 0x00 0x00 0x00 0x00 0x00 0x00 0x00 0x00 0x00 0x00 0x00 0x00 0x00 0x00 0x00 0x00 0x00 0x00 0x00 0x00 0x00 0x00 0x00 0x00 0x00 0x00 0x00 0x00 0x00 0x00 0x00 0x00 0x00 0x00 0x00 0x00 0x00 0x00 0x00 0x00 0x00 0x00 0x00 0x00 0x00 0x00 0x00 0x00 0x00 0x00 0x00 0x00 0x00 0x00 0x00 0x00 0x00 0x00 0x00 0x00 0x00 0x00 0x00 0x00 0x00 0x00 0x00 0x00 0x00 0x00 0x00 0x00 0x00 0x00 0x00 0x00 0x00 0x00 0x00 0x00 0x00 0x00 0x00 0x00 0x00 0x00 0x00 0x00 0x00 0x00 0x00 0x00 0x00 0x00 0x00 0x00 0x00 0x00 0x00 0x00 0x00 0x00 0x00 0x00 0x00 0x00 0x00 0x00 0x00 0x00 0x00 0x00 0x00 0x00 0x00 0x00 0x00 0x00 0x00 0x00 0x00 0x00 0x00 0x00 0x00 0x00 0x00 0x00 0x00 0x00 0x00 0x00 0x00 0x00 0x00 0x00 0x00 0x00 0x00 0x00 0x00 0x00 0x00 0x00 0x00 0x00 0x00 0x00 0x00 0x00 0x00 0x00 0x00 0x00 0x00 0x00 0x00 0x00 0x00 0x00 0x00 0x00 0x00 0x00 0x00 0x00 0x00 0x00 0x00 0x00 0x00 0x00 0x00 0x00 0x00 0x00 0x00 0x00 0x00 0x00 0x00 0x00 0x00 0x00 0x00 0x00 0x00 0x00 0x00 0x00 0x00 0x00 0x00 0x00 0x00 0x00 0x00 0x00 0x00 0x00 0x00 0x00 0x00 0x00 0x00 0x00 0x00 0x99999999 0x2000000 0x19000000 0x00 0xf0ffbf 0x1000000 0x100000 0x00 0x00 0x6472616d 0x632d726b 0x30000000 0x00 0x00 0x00 0x00 0x00 0x00 0x00 0x00 0x00 0x00 0x00 0x00 0x00 0x00 0x00 0x00 0x00 0x00 0x00 0x00 0x00 0x00 0x00 0x00 0x00 0x00 0x00 0x00 0x00 0x00 0xf0ff3f 0x3000000 0x100000 0x00 0x00 0x6472616d 0x632d726b 0x31000000 0x00 0x00 0x00 0x00 0x00 0x00 0x00 0x00 0x00 0x00 0x00 0x00 0x00 0x00 0x00 0x00 0x00 0x00 0x00 0x00 0x00 0x00 0x00 0x00 0x00 0x00 0x00 0x00 0x00 0x00 0xf0ff7f 0x00 0x100000 0x00 0x00 0x656d695f 0x6d626973 0x745f6275 0x66000000 0x00 0x00 0x00 0x00 0x00 0x00 0x00 0x00 0x00 0x00 0x00 0x00 0x00 0x00 0x00 0x00 0x00 0x00 0x00 0x00 0x00 0x00 0x00 0x00 0x00 0x00 0x00 0x00 0x00 0xf0fb7f 0x00 0x400 0x00 0x1000000 0x6c6f675f 0x73746f72 0x65000000 0x00 0x00 0x00 0x00 0x00 0x00 0x00 0x00 0x00 0x00 0x00 0x00 0x00 0x00 0x00 0x00 0x00 0x00 0x00 0x00 0x00 0x00 0x00 0x00 0x00 0x00 0x00 0x00 0x00 0x00 0xc048 0x00 0x2000 0x00 0x00 0x6174662d 0x72657365 0x72766564 0x00 0x00 0x00 0x00 0x00 0x00 0x00 0x00 0x00 0x00 0x00 0x00 0x00 0x00 0x00 0x00 0x00 0x00 0x00 0x00 0x00 0x00 0x00 0x00 0x00 0x00 0x00 0x00 0x00 0x00 0xf8bf 0x00 0x800 0x00 0x00 0x6174662d 0x72616d64 0x756d702d 0x72657365 0x72766564 0x00 0x00 0x00 0x00 0x00 0x00 0x00 0x00 0x00 0x00 0x00 0x00 0x00 0x00 0x00 0x00 0x00 0x00 0x00 0x00 0x00 0x00 0x00 0x00 0x00 0x00 0x00 0x00 0xe0bf 0x00 0x400 0x00 0x00 0x6174662d 0x6c6f672d 0x72657365 0x72766564 0x00 0x00 0x00 0x00 0x00 0x00 0x00 0x00 0x00 0x00 0x00 0x00 0x00 0x00 0x00 0x00 0x00 0x00 0x00 0x00 0x00 0x00 0x00 0x00 0x00 0x00 0x00 0x00 0x00 0xc07f 0x00 0x2000 0x00 0x00 0x7465652d 0x7365636d 0x656d0000 0x00 0x00 0x00 0x00 0x00 0x00 0x00 0x00 0x00 0x00 0x00 0x00 0x00 0x00 0x00 0x00 0x00 0x00 0x00 0x00 0x00 0x00 0x00 0x00 0x00 0x00 0x00 0x00 0x00 0x00 0xeb7f 0x00 0x1000 0x00 0x00 0x5353504d 0x2d726573 0x65727665 0x64000000 0x00 0x00 0x00 0x00 0x00 0x00 0x00 0x00 0x00 0x00 0x00 0x00 0x00 0x00 0x00 0x00 0x00 0x00 0x00 0x00 0x00 0x00 0x00 0x00 0x00 0x00 0x00 0x00 0x00 0x707a 0x00 0x5005 0x00 0x00 0x7465652d 0x72657365 0x72766564 0x00 0x00 0x00 0x00 0x00 0x00 0x00 0x00 0x00 0x00 0x00 0x00 0x00 0x00 0x00 0x00 0x00 0x00 0x00 0x00 0x00 0x00 0x00 0x00 0x00 0x00 0x00 0x00 0x00 0x00 0x607a 0x00 0x1000 0x00 0x00 0x4d435550 0x4d2d7265 0x73657276 0x65640000 0x00 0x00 0x00 0x00 0x00 0x00 0x00 0x00 0x00 0x00 0x00 0x00 0x00 0x00 0x00 0x00 0x00 0x00 0x00 0x00 0x00 0x00 0x00 0x00 0x00 0x00 0x00 0x00 0x00 0xf05f 0x00 0x800 0x00 0x00 0x50494341 0x43485500 0x00 0x00 0x00 0x00 0x00 0x00 0x00 0x00 0x00 0x00 0x00 0x00 0x00 0x00 0x00 0x00 0x00 0x00 0x00 0x00 0x00 0x00 0x00 0x00 0x00 0x00 0x00 0x00 0x00 0x00 0x00 0x848 0x00 0x100 0x00 0x00 0x72616d5f 0x636f6e73 0x6f6c6500 0x00 0x00 0x00 0x00 0x00 0x00 0x00 0x00 0x00 0x00 0x00 0x00 0x00 0x00 0x00 0x00 0x00 0x00 0x00 0x00 0x00 0x00 0x00 0x00 0x00 0x00 0x00 0x00 0x00 0x00 0x948 0x00 0xe00 0x00 0x00 0x7073746f 0x72650000 0x00 0x00 0x00 0x00 0x00 0x00 0x00 0x00 0x00 0x00 0x00 0x00 0x00 0x00 0x00 0x00 0x00 0x00 0x00 0x00 0x00 0x00 0x00 0x00 0x00 0x00 0x00 0x00 0x00 0x00 0x00 0x1748 0x00 0x100 0x00 0x00 0x6d696e69 0x7264756d 0x70000000 0x00 0x00 0x00 0x00 0x00 0x00 0x00 0x00 0x00 0x00 0x00 0x00 0x00 0x00 0x00 0x00 0x00 0x00 0x00 0x00 0x00 0x00 0x00 0x00 0x00 0x00 0x00 0x00 0x00 0x00 0xf048 0x00 0x1000 0x00 0x1000000 0x706c2d64 0x72616d62 0x75660000 0x00 0x00 0x00 0x00 0x00 0x00 0x00 0x00 0x00 0x00 0x00 0x00 0x00 0x00 0x00 0x00 0x00 0x00 0x00 0x00 0x00 0x00 0x00 0x00 0x00 0x00 0x00 0x00 0x00 0x00 0x49 0x00 0x1000 0x00 0x1000000 0x706c2d62 0x6f6f7474 0x61670000 0x00 0x00 0x00 0x00 0x00 0x00 0x00 0x00 0x00 0x00 0x00 0x00 0x00 0x00 0x00 0x00 0x00 0x00 0x00 0x00 0x00 0x00 0x00 0x00 0x00 0x00 0x00 0x00 0x00 0x00 0x2048 0x00 0x4000 0x00 0x00 0x6c6b5f61 0x6464725f 0x6d620000 0x00 0x00 0x00 0x00 0x00 0x00 0x00 0x00 0x00 0x00 0x00 0x00 0x00 0x00 0x00 0x00 0x00 0x00 0x00 0x00 0x00 0x00 0x00 0x00 0x00 0x00 0x00 0x00 0x00 0x00 0x1049 0x00 0x08 0x00 0x00 0x73637261 0x7463685f 0x61646472 0x5f6d6200 0x00 0x00 0x00 0x00 0x00 0x00 0x00 0x00 0x00 0x00 0x00 0x00 0x00 0x00 0x00 0x00 0x00 0x00 0x00 0x00 0x00 0x00 0x00 0x00 0x00 0x00 0x00 0x00 0x00 0x8178 0x00 0xdf01 0x00 0x1000000 0x6672616d 0x65627566 0x66657200 0x00 0x00 0x00 0x00 0x00 0x00 0x00 0x00 0x00 0x00 0x00 0x00 0x00 0x00 0x00 0x00 0x00 0x00 0x00 0x00 0x00 0x00 0x00 0x00 0x00 0x00 0x00 0x00 0x00 0x00 0x8177 0x00 0x01 0x00 0x00 0x6c6f676f 0x5f64625f 0x61646472 0x5f706100 0x00 0x00 0x00 0x00 0x00 0x00 0x00 0x00 0x00 0x00 0x00 0x00 0x00 0x00 0x00 0x00 0x00 0x00 0x00 0x00 0x00 0x00 0x00 0x00 0x00 0x00 0x00 0x00 0x00 0xc847 0x00 0x800 0x00 0x1000000 0x6474625f 0x6b65726e 0x656c5f61 0x6464725f 0x6d620000 0x00 0x00 0x00 0x00 0x00 0x00 0x00 0x00 0x00 0x00 0x00 0x00 0x00 0x00 0x00 0x00 0x00 0x00 0x00 0x00 0x00 0x00 0x00 0x00 0x00 0x00 0x00 0x00 0x840 0x00 0xc007 0x00 0x00 0x6b65726e 0x656c5f61 0x6464725f 0x6d620000 0x00 0x00 0x00 0x00 0x00 0x00 0x00 0x00 0x00 0x00 0x00 0x00 0x00 0x00 0x00 0x00 0x00 0x00 0x00 0x00 0x00 0x00 0x00 0x00 0x00 0x00 0x00 0x00 0x00 0x1051 0x00 0x04 0x00 0x00 0x72616d64 0x69736b5f 0x61646472 0x5f6d6200 0x00 0x00 0x00 0x00 0x00 0x00 0x00 0x00 0x00 0x00 0x00 0x00 0x00 0x00 0x00 0x00 0x00 0x00 0x00 0x00 0x00 0x00 0x00 0x00 0x00 0x00 0x00 0x00 0x00 0xe6ff 0x00 0x1900 0x00 0x00 0x44504d2d 0x72657365 0x72766564 0x00 0x00 0x00 0x00 0x00 0x00 0x00 0x00 0x00 0x00 0x00 0x00 0x00 0x00 0x00 0x00 0x00 0x00 0x00 0x00 0x00 0x00 0x00 0x00 0x00 0x00 0x00 0x00 0x00 0x00 0x00 0x00 0x00 0x00 0x00 0x00 0x00 0x00 0x00 0x00 0x00 0x00 0x00 0x00 0x00 0x00 0x00 0x00 0x00 0x00 0x00 0x00 0x00 0x00 0x00 0x00 0x00 0x00 0x00 0x00 0x00 0x00 0x00 0x00 0x00 0x00 0x00 0x00 0x00 0x00 0x00 0x00 0x00 0x00 0x00 0x00 0x00 0x00 0x00 0x00 0x00 0x00 0x00 0x00 0x00 0x00 0x00 0x00 0x00 0x00 0x00 0x00 0x00 0x00 0x00 0x00 0x00 0x00 0x00 0x00 0x00 0x00 0x00 0x00 0x00 0x00 0x00 0x00 0x00 0x00 0x00 0x00 0x00 0x00 0x00 0x00 0x00 0x00 0x00 0x00 0x00 0x00 0x00 0x00 0x00 0x00 0x00 0x00 0x00 0x00 0x00 0x00 0x00 0x00 0x00 0x00 0x00 0x00 0x00 0x00 0x00 0x00 0x00 0x00 0x00 0x00 0x00 0x00 0x00 0x00 0x00 0x00 0x00 0x00 0x00 0x00 0x00 0x00 0x00 0x00 0x00 0x00 0x00 0x00 0x00 0x00 0x00 0x00 0x00 0x00 0x00 0x00 0x00 0x00 0x00 0x00 0x00 0x00 0x00 0x00 0x00 0x00 0x00 0x00 0x00 0x00 0x00 0x00 0x00 0x00 0x00 0x00 0x00 0x00 0x00 0x00 0x00 0x00 0x00 0x00 0x00 0x00 0x00 0x00 0x00 0x00 0x00 0x00 0x00 0x00 0x00 0x00 0x00 0x00 0x00 0x00 0x00 0x00 0x00 0x00 0x00 0x00 0x00 0x00 0x00 0x00 0x00 0x00 0x00 0x00 0x00 0x00 0x00 0x00 0x00 0x00 0x00 0x00 0x00 0x00 0x00 0x00 0x00 0x00 0x00 0x00 0x00 0x00 0x00 0x00 0x00 0x00 0x00 0x00 0x00 0x00 0x00 0x00 0x00 0x00 0x00 0x00 0x00 0x00 0x00 0x00 0x00 0x00 0x00 0x00 0x00 0x00 0x00 0x00 0x00 0x00 0x00 0x00 0x00 0x00 0x00 0x00 0x00 0x00 0x00 0x00 0x00 0x00 0x00 0x00 0x00 0x00 0x00 0x00 0x00 0x00 0x00 0x00 0x00 0x00 0x00 0x00 0x00 0x00 0x00 0x00 0x00 0x00 0x00 0x00 0x00 0x00 0x00 0x00 0x00 0x00 0x00 0x00 0x00 0x00 0x00 0x00 0x00 0x00 0x00 0x00 0x00 0x00 0x00 0x00 0x00 0x00 0x00 0x00 0x00 0x00 0x00 0x00 0x00 0x00 0x00 0x00 0x00 0x00 0x00 0x00 0x00 0x00 0x00 0x00 0x00 0x00 0x00 0x00 0x00 0x00 0x00 0x00 0x00 0x00 0x00 0x00 0x00 0x00 0x00 0x00 0x00 0x00 0x00 0x00 0x00 0x00 0x00 0x00 0x00 0x00 0x00 0x00 0x00 0x00 0x00 0x00 0x00 0x00 0x00 0x00 0x00 0x00 0x00 0x00 0x00 0x00 0x00 0x00 0x00 0x00 0x00 0x00 0x00 0x00 0x00 0x00 0x00 0x00 0x00 0x00 0x00 0x00 0x00 0x00 0x00 0x00 0x00 0x00 0x00 0x00 0x00 0x00 0x00 0x00 0x00 0x00 0x00 0x00 0x00 0x00 0x00 0x00 0x00 0x00 0x00 0x00 0x00 0x00 0x00 0x00 0x00 0x00 0x00 0x00 0x00 0x00 0x00 0x00 0x00 0x00 0x00 0x00 0x00 0x00 0x00 0x00 0x00 0x00 0x00 0x00 0x00 0x00 0x00 0x00 0x00 0x00 0x00 0x00 0x00 0x00 0x00 0x00 0x00 0x00 0x00 0x00 0x00 0x00 0x00 0x00 0x00 0x00 0x00 0x00 0x00 0x00 0x00 0x00 0x00 0x00 0x00 0x00 0x00 0x00 0x00 0x00 0x00 0x00 0x00 0x00 0x00 0x00 0x00 0x00 0x00 0x00 0x00 0x00 0x00 0x00 0x00 0x00 0x00 0x00 0x00 0x00 0x00 0x00 0x00 0x00 0x00 0x00 0x00 0x00 0x00 0x00 0x00 0x00 0x00 0x00 0x00 0x00 0x00 0x00 0x00 0x00 0x00 0x00 0x00 0x00 0x00 0x00 0x00 0x00 0x00 0x00 0x00 0x00 0x00 0x00 0x00 0x00 0x00 0x00 0x00 0x00 0x00 0x00 0x00 0x00 0x00 0x00 0x00 0x00 0x00 0x00 0x00 0x00 0x00 0x00 0x00 0x00 0x00 0x00 0x00 0x00 0x00 0x00 0x00 0x00 0x00 0x00 0x00 0x00 0x00 0x00 0x00 0x00 0x00 0x00 0x00 0x00 0x00 0x00 0x00 0x00 0x00 0x00 0x00 0x00 0x00 0x00 0x00 0x00 0x00 0x00 0x00 0x00 0x00 0x00 0x00 0x00 0x00 0x00 0x00 0x00 0x00 0x00 0x00 0x00 0x00 0x00 0x00 0x00 0x00 0x00 0x00 0x00 0x00 0x00 0x00 0x00 0x00 0x00 0x00 0x00 0x00 0x00 0x00 0x00 0x00 0x00 0x00 0x00 0x00 0x00 0x00 0x00 0x00 0x00 0x00 0x00 0x00 0x00 0x00 0x00 0x00 0x00 0x00 0x00 0x00 0x00 0x00 0x00 0x00 0x00 0x00 0x00 0x00 0x00 0x00 0x00 0x00 0x00 0x00 0x00 0x00 0x00 0x00 0x00 0x00 0x00 0x00 0x00 0x00 0x00 0x00 0x00 0x00 0x00 0x00 0x00 0x00 0x00 0x00 0x00 0x00 0x00 0x00 0x00 0x00 0x00 0x00 0x00 0x00 0x00 0x00 0x00 0x00 0x00 0x00 0x00 0x00 0x00 0x00 0x00 0x00 0x00 0x00 0x00 0x00 0x00 0x00 0x00 0x00 0x00 0x00 0x00 0x00 0x00 0x00 0x00 0x00 0x00 0x00 0x00 0x00 0x00 0x00 0x00 0x00 0x00 0x00 0x00 0x00 0x00 0x00 0x00 0x00 0x00 0x00 0x00 0x00 0x00 0x00 0x00 0x00 0x00 0x00 0x00 0x00 0x00 0x00 0x00 0x00 0x00 0x00 0x00 0x00 0x00 0x00 0x00 0x00 0x00 0x00 0x00 0x00 0x00 0x00 0x00 0x00 0x00 0x00 0x00 0x00 0x00 0x00 0x00 0x00 0x00 0x00 0x00 0x00 0x00 0x00 0x00 0x00 0x00 0x00 0x00 0x00 0x00 0x00 0x00 0x00 0x00 0x00 0x00 0x00 0x00 0x00 0x00 0x00 0x00 0x00 0x00 0x00 0x00 0x00 0x00 0x00 0x00 0x00 0x00 0x00 0x00 0x00 0x00 0x00 0x00 0x00 0x00 0x00 0x00 0x00 0x00 0x00 0x00 0x00 0x00 0x00 0x00 0x00 0x00 0x00 0x00 0x00 0x00 0x00 0x00 0x00 0x00 0x00 0x00 0x00 0x00 0x00 0x00 0x00 0x00 0x00 0x00 0x00 0x00 0x00 0x00 0x00 0x00 0x00 0x00 0x00 0x00 0x00 0x00 0x00 0x00 0x00 0x00 0x00 0x00 0x00 0x00 0x00 0x00 0x00 0x00 0x00 0x00 0x00 0x00 0x00 0x00 0x00 0x00 0x00 0x00 0x00 0x00 0x00 0x00 0x00 0x00 0x00 0x00 0x00 0x00 0x00 0x00 0x00 0x00 0x00 0x00 0x00 0x00 0x00 0x00 0x00 0x00 0x00 0x00 0x00 0x00 0x00 0x00 0x00 0x00 0x00 0x00 0x00 0x00 0x00 0x00 0x00 0x00 0x00 0x00 0x00 0x00 0x00 0x00 0x00 0x00 0x00 0x00 0x00 0x00 0x00 0x00 0x00 0x00 0x00 0x00 0x00 0x00 0x00 0x00 0x00 0x00 0x00 0x00 0x00 0x00 0x00 0x00 0x00 0x00 0x00 0x00 0x00 0x00 0x00 0x00 0x00 0x00 0x00 0x00 0x00 0x00 0x00 0x00 0x00 0x00 0x00 0x00 0x00 0x00 0x00 0x00 0x00 0x00 0x00 0x00 0x00 0x00 0x00 0x00 0x00 0x00 0x00 0x00 0x00 0x00 0x00 0x00 0x00 0x00 0x00 0x00 0x00 0x00 0x00 0x00 0x00 0x00 0x00 0x00 0x00 0x00 0x00 0x00 0x00 0x00 0x00 0x00 0x00 0x00 0x00 0x00 0x00 0x00 0x00 0x00 0x00 0x00 0x00 0x00 0x00 0x00 0x00 0x00 0x00 0x00 0x00 0x00 0x00 0x00 0x00 0x00 0x00 0x00 0x00 0x00 0x00 0x00 0x00 0x00 0x00 0x00 0x00 0x00 0x00 0x00 0x00 0x00 0x00 0x00 0x00 0x00 0x00 0x00 0x00 0x00 0x00 0x00 0x00 0x00 0x00 0x00 0x00 0x00 0x00 0x00 0x00 0x00 0x00 0x00 0x00 0x00 0x00 0x00 0x00 0x00 0x00 0x00 0x00 0x00 0x00 0x00 0x00 0x00 0x00 0x00 0x00 0x00 0x00 0x00 0x00 0x00 0x00 0x00 0x00 0x00 0x00 0x00 0x00 0x00 0x00 0x00 0x00 0x00 0x00 0x00 0x00 0x00 0x00 0x00 0x00 0x00 0x00 0x00 0x00 0x00 0x00 0x00 0x00 0x00 0x00 0x00 0x00 0x00 0x00 0x00 0x00 0x00 0x00 0x00 0x00 0x00 0x00 0x00 0x00 0x00 0x00 0x00 0x00 0x00 0x00 0x00 0x00 0x00 0x00 0x00 0x00 0x00 0x00 0x00 0x00 0x00 0x00 0x00 0x00 0x00 0x00 0x00 0x00 0x00 0x00 0x00 0x00 0x00 0x00 0x00 0x00 0x00 0x00 0x00 0x00 0x00 0x00 0x00 0x00 0x00 0x00 0x00 0x00 0x00 0x00 0x00 0x00 0x00 0x00 0x00 0x00 0x00 0x00 0x00 0x00 0x00 0x00 0x00 0x00 0x00 0x00 0x00 0x00 0x00 0x00 0x00 0x00 0x00 0x00 0x00 0x00 0x00 0x00 0x00 0x00 0x00 0x00 0x00 0x00 0x00 0x00 0x00 0x00 0x00 0x00 0x00 0x00 0x00 0x00 0x00 0x00 0x00 0x00 0x00 0x00 0x00 0x00 0x00 0x00 0x00 0x00 0x00 0x00 0x00 0x00 0x00 0x00 0x00 0x00 0x00 0x00 0x00 0x00 0x00 0x00 0x00 0x00 0x00 0x00 0x00 0x00 0x00 0x00 0x00 0x00 0x00 0x00 0x00 0x00 0x00 0x00 0x00 0x00 0x00 0x00 0x00 0x00 0x00 0x00 0x00 0x00 0x00 0x00 0x00 0x00 0x00 0x00 0x00 0x00 0x00 0x00 0x00 0x00 0x00 0x00 0x00 0x00 0x00 0x00 0x00 0x00 0x00 0x00 0x00 0x00 0x00 0x00 0x00 0x00 0x00 0x00 0x00 0x00 0x00 0x00 0x00 0x00 0x00 0x00 0x00 0x00 0x00 0x00 0x00 0x00 0x00 0x00 0x00 0x00 0x00 0x00 0x00 0x00 0x00 0x00 0x00 0x00 0x00 0x00 0x00 0x00 0x00 0x00 0x00 0x00 0x00 0x00 0x00 0x00 0x00 0x00 0x00 0x00 0x00 0x00 0x00 0x00 0x00 0x00 0x00 0x00 0x00 0x00 0x00 0x00 0x00 0x00 0x00 0x00 0x00 0x00 0x00 0x00 0x00 0x00 0x00 0x00 0x00 0x00 0x00 0x00 0x00 0x00 0x00 0x00 0x00 0x00 0x00 0x00 0x00 0x00 0x00 0x00 0x00 0x00 0x00 0x00 0x00 0x00 0x00 0x00 0x00 0x00 0x00 0x00 0x00 0x00 0x00 0x00 0x00 0x00 0x00 0x00 0x00 0x00 0x00 0x00 0x00 0x00 0x00 0x00 0x00 0x00 0x00 0x00 0x00 0x00 0x00 0x00 0x00 0x00 0x00 0x00 0x00 0x00 0x00 0x00 0x00 0x00 0x00 0x00 0x00 0x00 0x00 0x00 0x00 0x00 0x00 0x00 0x00 0x00 0x00 0x00 0x00 0x00 0x00 0x00 0x00 0x00 0x00 0x00 0x00 0x00 0x00 0x00 0x00 0x00 0x00 0x00 0x00 0x00 0x00 0x00 0x00 0x00 0x00 0x00 0x00 0x00 0x00 0x00 0x00 0x00 0x00 0x00 0x00 0x00 0x00 0x00 0x00 0x00 0x00 0x00 0x00 0x00 0x00 0x00 0x00 0x00 0x00 0x00 0x00 0x00 0x00 0x00 0x00 0x00 0x00 0x00 0x00 0x00 0x00 0x00 0x00 0x00 0x00 0x00 0x00 0x00 0x00 0x00 0x00 0x00 0x00 0x00 0x00 0x00 0x00 0x00 0x00 0x00 0x00 0x00 0x00 0x00 0x00 0x00 0x00 0x00 0x00 0x00 0x00 0x00 0x00 0x00 0x00 0x00 0x00 0x00 0x00 0x00 0x00 0x00 0x00 0x00 0x00 0x00 0x00 0x00 0x00 0x00 0x00 0x00 0x00 0x00 0x00 0x00 0x00 0x00 0x00 0x00 0x00 0x00 0x00 0x00 0x00 0x00 0x00 0x00 0x00 0x00 0x00 0x00 0x00 0x00 0x00 0x00 0x00 0x00 0x00 0x00 0x00 0x00 0x00 0x00 0x00 0x00 0x00 0x00 0x00 0x00 0x00 0x00 0x00 0x00 0x00 0x00 0x00 0x00 0x00 0x00 0x00 0x00 0x00 0x00 0x00 0x00 0x00 0x00 0x00 0x00 0x00 0x00 0x00 0x00 0x00 0x00 0x00 0x00 0x00 0x00 0x00 0x00 0x00 0x00 0x00 0x00 0x00 0x00 0x00 0x00 0x00 0x00 0x00 0x00 0x00 0x00 0x00 0x00 0x00 0x00 0x00 0x00 0x00 0x00 0x00 0x00 0x00 0x00 0x00 0x00 0x00 0x00 0x00 0x00 0x00 0x00 0x00 0x00 0x00 0x00 0x00 0x00 0x00 0x00 0x00 0x00 0x00 0x00 0x00 0x00 0x00 0x00 0x00 0x00 0x00 0x00 0x00 0x00 0x00 0x00 0x00 0x00 0x00 0x00 0x00 0x00 0x00 0x00 0x00 0x00 0x00 0x00 0x00 0x00 0x00 0x00 0x00 0x00 0x00 0x00 0x00 0x00 0x00 0x00 0x00 0x00 0x00 0x00 0x00 0x00 0x00 0x00 0x00 0x00 0x00 0x00 0x00 0x00 0x00 0x00 0x00 0x00 0x00 0x00 0x00 0x00 0x00 0x00 0x00 0x00 0x00 0x00 0x00 0x00 0x00 0x00 0x00 0x00 0x00 0x00 0x00 0x00 0x00 0x00 0x00 0x00 0x00 0x00 0x00 0x00 0x00 0x00 0x00 0x00 0x00 0x00 0x00 0x00 0x00 0x00 0x00 0x00 0x00 0x00 0x00 0x00 0x00 0x00 0x00 0x00 0x00 0x00 0x00 0x00 0x00 0x00 0x00 0x00 0x00 0x00 0x00 0x00 0x00 0x00 0x00 0x00 0x00 0x00 0x00 0x00 0x00 0x00 0x00 0x00 0x00 0x00 0x00 0x00 0x00 0x00 0x00 0x00 0x00 0x00 0x00 0x00 0x00 0x00 0x00 0x00 0x00 0x00 0x00 0x00 0x00 0x00 0x00 0x00 0x00 0x00 0x00 0x00 0x00 0x00 0x00 0x00 0x00 0x00 0x00 0x00 0x00 0x00 0x00 0x00 0x00 0x00 0x00 0x00 0x00 0x00 0x00 0x00 0x00 0x00 0x00 0x00 0x00 0x00 0x00 0x00 0x00 0x00 0x00 0x00 0x00 0x00 0x00 0x00 0x00 0x00 0x00 0x00 0x00 0x00 0x00 0x00 0x00 0x00 0x00 0x00 0x00 0x00 0x00 0x00 0x00 0x00 0x00 0x00 0x00 0x00 0x00 0x00 0x00 0x00 0x00 0x00 0x00 0x00 0x00 0x00 0x00 0x00 0x00 0x00 0x00 0x00 0x00 0x00 0x00 0x00 0x00 0x00 0x00 0x00 0x00 0x00 0x00 0x00 0x00 0x00 0x00 0x00 0x00 0x00 0x00 0x00 0x00 0x00 0x00 0x00 0x00 0x00 0x00 0x00 0x00 0x00 0x00 0x00 0x00 0x00 0x00 0x00 0x00 0x00 0x00 0x00 0x00 0x00 0x00 0x00 0x00 0x00 0x00 0x00 0x00 0x00 0x00 0x00 0x00 0x00 0x00 0x00 0x00 0x00 0x00 0x00 0x00 0x00 0x00 0x00 0x00 0x00 0x00 0x00 0x00 0x00 0x00 0x00 0x00 0x00 0x00 0x00 0x00 0x00 0x00 0x00 0x00 0x00 0x00 0x00 0x00 0x00 0x00 0x00 0x00 0x00 0x00 0x00 0x00 0x00 0x00 0x00 0x00 0x00 0x00 0x00 0x00 0x00 0x00 0x00 0x00 0x00 0x00 0x00 0x00 0x00 0x00 0x00 0x00 0x00 0x00 0x00 0x00 0x00 0x00 0x00 0x00 0x00 0x00 0x00 0x00 0x00 0x00 0x00 0x00 0x00 0x00 0x00 0x00 0x00 0x00 0x00 0x00 0x00 0x00 0x00 0x00 0x00 0x00 0x00 0x00 0x00 0x00 0x00 0x00 0x00 0x00 0x00 0x00 0x00 0x00 0x00 0x00 0x00 0x00 0x00 0x00 0x00 0x00 0x00 0x00 0x00 0x00 0x00 0x00 0x00 0x00 0x00 0x00 0x00 0x00 0x00 0x00 0x00 0x00 0x00 0x00 0x00 0x00 0x00 0x00 0x00 0x00 0x00 0x00 0x00 0x00 0x00 0x00 0x00 0x00 0x00 0x00 0x00 0x00 0x00 0x00 0x00 0x00 0x00 0x00 0x00 0x00 0x00 0x00 0x00 0x00 0x00 0x00 0x00 0x00 0x00 0x00 0x00 0x00 0x00 0x00 0x00 0x00 0x00 0x00 0x00 0x00 0x00 0x00 0x00 0x00 0x00 0x00 0x00 0x00 0x00 0x00 0x00 0x00 0x00 0x00 0x00 0x00 0x00 0x00 0x00 0x00 0x00 0x00 0x00 0x00 0x00 0x00 0x00 0x00 0x00 0x00 0x00 0x00 0x00 0x00 0x00 0x00 0x00 0x00 0x00 0x00 0x00 0x00 0x00 0x00 0x00 0x00 0x00 0x00 0x00 0x00 0x00 0x00 0x00 0x00 0x00 0x00 0x00 0x00 0x00 0x00 0x00 0x00 0x00 0x00 0x00 0x00 0x00 0x00 0x00 0x00 0x00 0x00 0x00 0x00 0x00 0x00 0x00 0x00 0x00 0x00 0x00 0x00 0x00 0x00 0x00 0x00 0x00 0x00 0x00 0x00 0x00 0x00 0x00 0x00 0x00 0x00 0x00 0x00 0x00 0x00 0x00 0x00 0x00 0x00 0x00 0x00 0x00 0x00 0x00 0x00 0x00 0x00 0x00 0x00 0x00 0x00 0x00 0x00 0x00 0x00 0x00 0x00 0x00 0x00 0x00 0x00 0x00 0x00 0x00 0x00 0x00 0x00 0x00 0x00 0x00 0x00 0x00 0x00 0x00 0x00 0x00 0x00 0x00 0x00 0x00 0x00 0x00 0x00 0x00 0x00 0x00 0x00 0x00 0x00 0x00 0x00 0x00 0x00 0x00 0x00 0x00 0x00 0x00 0x00 0x00 0x00 0x00 0x00 0x00 0x00 0x00 0x00 0x00 0x00 0x00 0x00 0x00 0x00 0x00 0x00 0x00 0x00 0x00 0x00 0x00 0x00 0x00 0x00 0x00 0x00 0x00 0x00 0x00 0x00 0x00 0x00 0x00 0x00 0x00 0x00 0x00 0x00 0x00 0x00 0x00 0x00 0x00 0x00 0x00 0x00 0x00 0x00 0x00 0x00 0x00 0x00 0x00 0x00 0x00 0x00 0x00 0x00 0x00 0x00 0x00 0x00 0x00 0x00 0x00 0x00 0x00 0x00 0x00 0x00 0x00 0x00 0x00 0x00 0x00 0x00 0x00 0x00 0x00 0x00 0x00 0x00 0x00 0x00 0x00 0x00 0x00 0x00 0x00 0x00 0x00 0x00 0x00 0x00 0x00 0x00 0x00 0x00 0x00 0x00 0x00 0x00 0x00 0x00 0x00 0x00 0x00 0x00 0x00 0x00 0x00 0x00 0x00 0x00 0x00 0x00 0x00 0x00 0x00 0x00 0x00 0x00 0x00 0x00 0x00 0x00 0x00 0x00 0x00 0x00 0x00 0x00 0x00 0x00 0x00 0x00 0x00 0x00 0x00 0x00 0x00 0x00 0x00 0x00 0x00 0x00 0x00 0x00 0x00 0x00 0x00 0x00 0x00 0x00 0x00 0x00 0x00 0x00 0x00 0x00 0x00 0x00 0x00 0x00 0x00 0x00 0x00 0x00 0x00 0x00 0x00 0x00 0x00 0x00 0x00 0x00 0x00 0x00 0x00 0x00 0x00 0x00 0x00 0x00 0x00 0x00 0x00 0x00 0x00 0x00 0x00 0x00 0x00 0x00 0x00 0x00 0x00 0x00 0x00 0x00 0x00 0x00 0x00 0x00 0x00 0x00 0x00 0x00 0x00 0x00 0x00 0x00 0x00 0x00 0x00 0x00 0x00 0x00 0x00 0x00 0x00 0x00 0x00 0x00 0x00 0x00 0x00 0x00 0x00 0x00 0x00 0x00 0x00 0x00 0x00 0x00 0x00 0x00 0x00 0x00 0x00 0x00 0x00 0x00 0x00 0x00 0x00 0x00 0x00 0x00 0x00 0x00 0x00 0x00 0x00 0x00 0x00 0x00 0x00 0x00 0x00 0x00 0x00 0x00 0x00 0x00 0x00 0x00 0x00 0x00 0x00 0x00 0x00 0x00 0x00 0x00 0x00 0x00 0x00 0x00 0x00 0x00 0x00 0x00 0x00 0x00 0x00 0x00 0x00 0x00 0x00 0x00 0x00 0x00 0x00 0x00 0x00 0x00 0x00 0x00 0x00 0x00 0x00 0x00 0x00 0x00 0x00 0x00 0x00 0x00 0x00 0x00 0x00 0x00 0x00 0x00 0x00 0x00 0x00 0x00 0x00 0x00 0x00 0x00 0x00 0x00 0x00 0x00 0x00 0x00 0x00 0x00 0x00 0x00 0x00 0x00 0x00 0x00 0x00 0x00 0x00 0x00 0x00 0x00 0x00 0x00 0x00 0x00 0x00 0x00 0x00 0x00 0x00 0x00 0x00 0x00 0x00 0x00 0x00 0x00 0x00 0x00 0x00 0x00 0x00 0x00 0x00 0x00 0x00 0x00 0x00 0x00 0x00 0x00 0x00 0x00 0x00 0x00 0x00 0x00 0x00 0x00 0x00 0x00 0x00 0x00 0x00 0x00 0x00 0x00 0x00 0x00 0x00 0x00 0x00 0x00 0x00 0x00 0x00 0x00 0x00 0x00 0x00 0x00 0x00 0x00 0x00 0x00 0x00 0x00 0x00 0x00 0x00 0x00 0x00 0x00 0x00 0x00 0x00 0x00 0x00 0x00 0x00 0x00 0x00 0x00 0x00 0x00 0x00 0x00 0x00 0x00 0x00 0x00 0x00 0x00 0x00 0x00 0x00 0x00 0x00 0x00 0x00 0x00 0x00 0x00 0x00 0x00 0x00 0x00 0x00 0x00 0x00 0x00 0x00 0x00 0x00 0x00 0x00 0x00 0x00 0x00 0x00 0x00 0x00 0x00 0x00 0x00 0x00 0x00 0x00 0x00 0x00 0x00 0x00 0x00 0x00 0x00 0x00 0x00 0x00 0x00 0x00 0x00 0x00 0x00 0x00 0x00 0x00 0x00 0x00 0x00 0x00 0x00 0x00 0x00 0x00 0x00 0x00 0x00 0x00 0x00 0x00 0x00 0x00 0x00 0x00 0x00 0x00 0x00 0x00 0x00 0x00 0x00 0x00 0x00 0x00 0x00 0x00 0x00 0x00 0x00 0x00 0x00 0x00 0x00 0x00 0x00 0x00 0x00 0x00 0x00 0x00 0x00 0x00 0x00 0x00 0x00 0x00 0x00 0x00 0x00 0x00 0x00 0x00 0x00 0x00 0x00 0x00 0x00 0x00 0x00 0x00 0x00 0x00 0x00 0x00 0x00 0x00 0x00 0x00 0x00 0x00 0x00 0x00 0x00 0x00 0x00 0x00 0x00 0x00 0x00 0x00 0x00 0x00 0x00 0x00 0x00 0x00 0x00 0x00 0x00 0x00 0x00 0x00 0x00 0x00 0x00 0x00 0x00 0x00 0x00 0x00 0x00 0x00 0x00 0x00 0x00 0x00 0x00 0x00 0x00 0x00 0x00 0x00 0x00 0x00 0x00 0x00 0x00 0x00 0x00 0x00 0x00 0x00 0x00 0x00 0x00 0x00 0x00 0x00 0x00 0x00 0x00 0x00 0x00 0x00 0x00 0x00 0x00 0x00 0x00 0x00 0x00 0x00 0x00 0x00 0x00 0x00 0x00 0x00 0x00 0x00 0x00 0x00 0x00 0x00 0x00 0x00 0x00 0x00 0x00 0x00 0x00 0x00 0x00 0x00 0x00 0x00 0x00 0x00 0x00 0x00 0x00 0x00 0x00 0x00 0x00 0x00 0x00 0x00 0x00 0x00 0x00 0x00 0x00 0x00 0x00 0x00 0x00 0x00 0x00 0x00 0x00 0x00 0x00 0x00 0x00 0x00 0x00 0x00 0x00 0x00 0x00 0x00 0x00 0x00 0x00 0x00 0x00 0x00 0x00 0x00 0x00 0x00 0x00 0x00 0x00 0x00 0x00 0x00 0x00 0x00 0x00 0x00 0x00 0x00 0x00 0x00 0x00 0x00 0x00 0x00 0x00 0x00 0x00 0x00 0x00 0x00 0x00 0x00 0x00 0x00 0x00 0x00 0x00 0x00 0x00 0x00 0x00 0x00 0x00 0x00 0x00 0x00 0x00 0x00 0x00 0x00 0x00 0x00 0x00 0x00 0x00 0x00 0x00 0x00 0x00 0x00 0x00 0x00 0x00 0x00 0x00 0x00 0x00 0x00 0x00 0x00 0x00 0x00 0x00 0x00 0x00 0x00 0x00 0x00 0x00 0x00 0x00 0x00 0x00 0x00 0x00 0x00 0x00 0x00 0x00 0x00 0x00 0x00 0x00 0x00 0x00 0x00 0x00 0x00 0x00 0x00 0x00 0x00 0x00 0x00 0x00 0x00 0x00 0x00 0x00 0x00 0x00 0x00 0x00 0x00 0x00 0x00 0x00 0x00 0x00 0x00 0x00 0x00 0x00 0x00 0x00 0x00 0x00 0x00 0x00 0x00 0x00 0x00 0x00 0x00 0x00 0x00 0x00 0x00 0x00 0x00 0x00 0x00 0x00 0x00 0x00 0x00 0x00 0x00 0x00 0x00 0x00 0x00 0x00 0x00 0x00 0x00 0x00 0x00 0x00 0x00 0x00 0x00 0x00 0x00 0x00 0x00 0x00 0x00 0x00 0x00 0x00 0x00 0x00 0x00 0x00 0x00 0x00 0x00 0x00 0x00 0x00 0x00 0x00 0x00 0x00 0x00 0x00 0x00 0x00 0x00 0x00 0x00 0x00 0x00 0x00 0x00 0x00 0x00 0x00 0x00 0x00 0x00 0x00 0x00 0x00 0x00 0x00 0x00 0x00 0x00 0x00 0x00 0x00 0x00 0x00 0x00 0x00 0x00 0x00 0x00 0x00 0x00 0x00 0x00 0x00 0x00 0x00 0x00 0x00 0x00 0x00 0x00 0x00 0x00 0x00 0x00 0x00 0x00 0x00 0x00 0x00 0x00 0x00 0x00 0x00 0x00 0x00 0x00 0x00 0x00 0x00 0x00 0x00 0x00 0x00 0x00 0x00 0x00 0x00 0x00 0x00 0x00 0x00 0x00 0x00 0x00 0x00 0x00 0x00 0x00 0x00 0x00 0x00 0x00 0x00 0x00 0x00 0x00 0x00 0x00 0x00 0x00 0x00 0x00 0x00 0x00 0x00 0x00 0x00 0x00 0x00 0x00 0x00 0x00 0x00 0x00 0x00 0x00 0x00 0x00 0x00 0x00 0x00 0x00 0x00 0x00 0x00 0x00 0x00 0x00 0x00 0x00 0x00 0x00 0x00 0x00 0x00 0x00 0x00 0x00 0x00 0x00 0x00 0x00 0x00 0x00 0x00 0x00 0x00 0x00 0x00 0x00 0x00 0x00 0x00 0x00 0x00 0x00 0x00 0x00 0x00 0x00 0x00 0x00 0x00 0x00 0x00 0x00 0x00 0x00 0x00 0x00 0x00 0x00 0x00 0x00 0x00 0x00 0x00 0x00 0x00 0x00 0x00 0x00 0x00 0x00 0x00 0x00 0x00 0x00 0x00 0x00 0x00 0x00 0x00 0x00 0x00 0x00 0x00 0x00 0x00 0x00 0x00 0x00 0x00 0x00 0x00 0x00 0x00 0x00 0x00 0x00 0x00 0x00 0x00 0x00 0x00 0x00 0x00 0x00 0x00 0x00 0x00 0x00 0x00 0x00 0x00 0x00 0x00 0x00 0x00 0x00 0x00 0x00 0x00 0x00 0x00 0x00 0x00 0x00 0x00 0x00 0x00 0x00 0x00 0x00 0x00 0x00 0x00 0x00 0x00 0x00 0x00 0x00 0x00 0x00 0x00 0x00 0x00 0x00 0x00 0x00 0x00 0x00 0x00 0x00 0x00 0x00 0x00 0x00 0x00 0x00 0x00 0x00 0x00 0x00 0x00 0x00 0x00 0x00 0x00 0x00 0x00 0x00 0x00 0x00 0x00 0x00 0x00 0x00 0x00 0x00 0x00 0x00 0x00 0x00 0x00 0x00 0x00 0x00 0x00 0x00 0x00 0x00 0x00 0x00 0x00 0x00 0x00 0x00 0x00 0x00 0x00 0x00 0x00 0x00 0x00 0x00 0x00 0x00 0x00 0x00 0x00 0x00 0x00 0x00 0x00 0x00 0x00 0x00 0x00 0x00 0x00 0x00 0x00 0x00 0x00 0x00 0x00 0x00 0x00 0x00 0x00 0x00 0x00 0x00 0x00 0x00 0x00 0x00 0x00 0x00 0x00 0x00 0x00 0x00 0x00 0x00 0x00 0x00 0x00 0x00 0x00 0x00 0x00 0x00 0x00 0x00 0x00 0x00 0x00 0x00 0x00 0x00 0x00 0x00 0x00 0x00 0x00 0x00 0x00 0x00 0x00 0x00 0x00 0x00 0x00 0x00 0x00 0x00 0x00 0x00 0x00 0x00 0x00 0x00 0x00 0x00 0x00 0x00 0x00 0x00 0x00 0x00 0x00 0x00 0x00 0x00 0x00 0x00 0x00 0x00 0x00 0x00 0x00 0x00 0x00 0x00 0x00 0x00 0x00 0x00 0x00 0x00 0x00 0x00 0x00 0x00 0x00 0x00 0x00 0x00 0x00 0x00 0x00 0x00 0x00 0x00 0x00 0x00 0x00 0x00 0x00 0x00 0x00 0x00 0x00 0x00 0x00 0x00 0x00 0x00 0x00 0x00 0x00 0x00 0x00 0x00 0x00 0x00 0x00 0x00 0x00 0x00 0x00 0x00 0x00 0x00 0x00 0x00 0x00 0x00 0x00 0x00 0x00 0x00 0x00 0x00 0x00 0x00 0x00 0x00 0x00 0x00 0x00 0x00 0x00 0x00 0x00 0x00 0x00 0x00 0x00 0x00 0x00 0x00 0x00 0x00 0x00 0x00 0x00 0x00 0x00 0x00 0x00 0x00 0x00 0x00 0x00 0x00 0x00 0x00 0x00 0x00 0x00 0x00 0x00 0x00 0x00 0x00 0x00 0x00 0x00 0x00 0x00 0x00 0x00 0x00 0x00 0x00 0x00 0x00 0x00 0x00 0x00 0x00 0x00 0x00 0x00 0x00 0x00 0x00 0x00 0x00 0x00 0x00 0x00 0x00 0x00 0x00 0x00 0x00 0x00 0x00 0x00 0x00 0x00 0x00 0x00 0x00 0x00 0x00 0x00 0x00 0x00 0x00 0x00 0x00 0x00 0x00 0x00 0x00 0x00 0x00 0x00 0x00 0x00 0x00 0x00 0x00 0x00 0x00 0x00 0x00 0x00 0x00 0x00 0x00 0x00 0x00 0x00 0x00 0x00 0x00 0x00 0x00 0x00 0x00 0x00 0x00 0x00 0x00 0x00 0x00 0x00 0x00 0x00 0x00 0x00 0x00 0x00 0x00 0x00 0x00 0x00 0x00 0x00 0x00 0x00 0x00 0x00 0x00 0x00 0x00 0x00 0x00 0x00 0x00 0x00 0x00 0x00 0x00 0x00 0x00 0x00 0x00 0x00 0x00 0x00 0x00 0x00 0x00 0x00 0x00 0x00 0x00 0x00 0x00 0x00 0x00 0x00 0x00 0x00 0x00 0x00 0x00 0x00 0x00 0x00 0x00 0x00 0x00 0x00 0x00 0x00 0x00 0x00 0x00 0x00 0x00 0x00 0x00 0x00 0x00 0x00 0x00 0x00 0x00 0x00 0x00 0x00 0x00 0x00 0x00 0x00 0x00 0x00 0x00 0x00 0x00 0x00 0x00 0x00 0x00 0x00 0x00 0x00 0x00 0x00 0x00 0x00 0x00 0x00 0x00 0x00 0x00 0x00 0x00 0x00 0x00 0x00 0x00 0x00 0x00 0x00 0x00 0x00 0x00 0x00 0x00 0x00 0x00 0x00 0x00 0x00 0x00 0x00 0x00 0x00 0x00 0x00 0x00 0x00 0x00 0x00 0x00 0x00 0x00 0x00 0x00 0x00 0x00 0x00 0x00 0x00 0x00 0x00 0x00 0x00 0x00 0x00 0x00 0x00 0x00 0x00 0x00 0x00 0x00 0x00>;
		orig_dram_info = <0x2000000 0x00 0x40 0x00 0x80 0x1000000 0xc0 0x1000000 0x80 0x1000000 0x00 0x00 0x00 0x00 0x00 0x00 0x00 0x00>;
		device_type = "memory";
		reg = <0x00 0x40000000 0x03 0x00>;
	};
	reserved_memory: reserved-memory {
		#address-cells = <0x02>;
		#size-cells = <0x02>;
		ranges;
		phandle = <0xfb>;

		mblock-17-DPM-reserved {
			reg = <0x00 0xffe60000 0x00 0x190000>;
			no-map;
			compatible = "mediatek,DPM-reserved";
		};

		mblock-16-framebuffer {
			no-map;
			reg = <0x00 0x78810000 0x00 0x1df0000>;
			compatible = "mediatek,framebuffer";
		};

		mblock-15-minirdump {
			reg = <0x00 0x48170000 0x00 0x10000>;
			no-map;
			compatible = "mediatek,minirdump";
		};

		mblock-14-pstore {
			reg = <0x00 0x48090000 0x00 0xe0000>;
			no-map;
			compatible = "mediatek,pstore";
		};

		mblock-13-ram_console {
			reg = <0x00 0x48080000 0x00 0x10000>;
			no-map;
			compatible = "mediatek,ram_console";
		};

		mblock-12-PICACHU {
			reg = <0x00 0x5ff00000 0x00 0x80000>;
			no-map;
			compatible = "mediatek,PICACHU";
		};

		mblock-11-MCUPM-reserved {
			reg = <0x00 0x7a600000 0x00 0x100000>;
			no-map;
			compatible = "mediatek,MCUPM-reserved";
		};

		mblock-10-tee-reserved {
			reg = <0x00 0x7a700000 0x00 0x5500000>;
			no-map;
			compatible = "mediatek,tee-reserved";
		};

		mblock-9-SSPM-reserved {
			reg = <0x00 0x7feb0000 0x00 0x100000>;
			no-map;
			compatible = "mediatek,SSPM-reserved";
		};

		mblock-8-tee-secmem {
			reg = <0x00 0x7fc00000 0x00 0x200000>;
			no-map;
			compatible = "mediatek,tee-secmem";
		};

		mblock-7-atf-log-reserved {
			reg = <0x00 0xbfe00000 0x00 0x40000>;
			no-map;
			compatible = "mediatek,atf-log-reserved";
		};

		mblock-6-atf-ramdump-reserved {
			reg = <0x00 0xbff80000 0x00 0x80000>;
			no-map;
			compatible = "mediatek,atf-ramdump-reserved";
		};

		mblock-5-atf-reserved {
			reg = <0x00 0x48c00000 0x00 0x200000>;
			no-map;
			compatible = "mediatek,atf-reserved";
		};

		mblock-4-log_store {
			reg = <0x00 0x7ffbf000 0x00 0x40000>;
			compatible = "mediatek,log_store";
		};

		mblock-3-emi_mbist_buf {
			reg = <0x00 0x7ffff000 0x00 0x1000>;
			no-map;
			compatible = "mediatek,emi_mbist_buf";
		};

		mblock-2-dramc-rk1 {
			reg = <0x03 0x3ffff000 0x00 0x1000>;
			no-map;
			compatible = "mediatek,dramc-rk1";
		};

		mblock-1-dramc-rk0 {
			reg = <0x01 0xbffff000 0x00 0x1000>;
			no-map;
			compatible = "mediatek,dramc-rk0";
		};

		zone-movable-cma-memory {
			alloc-ranges = <0x00 0xc0000000 0x04 0x00>;
			alignment = <0x00 0x1000000>;
			size = <0x00 0x2d000000>;
			compatible = "mediatek,zone_movable_cma";
		};

		reserve-memory-dram_r1_dummy_read {
			alloc-ranges = <0x01 0xc0000000 0x01 0x7ffff000>;
			alignment = <0x00 0x1000>;
			size = <0x00 0x1000>;
			compatible = "reserve-memory-dram_r1_dummy_read";
		};

		reserve-memory-dram_r0_dummy_read {
			alloc-ranges = <0x00 0x55100000 0x00 0xae00000>;
			alignment = <0x00 0x1000>;
			size = <0x00 0x1000>;
			compatible = "reserve-memory-dram_r0_dummy_read";
		};

		zmc-default {
			status = "disabled";
			compatible = "mediatek,zone_movable_cma";
			size = <0x00 0x2d000000>;
			alignment = <0x00 0x1000000>;
			alloc-ranges = <0x00 0xc0000000 0x04 0x00>;
		};

		ion-carveout-heap {
			compatible = "mediatek,ion-carveout-heap";
			no-map;
			size = <0x00 0xc000>;
			alignment = <0x00 0x1000>;
			alloc-ranges = <0x00 0x40000000 0x00 0x80000000>;
		};

		consys-reserve-memory {
			phandle = <0xed>;
			compatible = "mediatek,consys-reserve-memory";
			no-map;
			size = <0x00 0x450000>;
			alignment = <0x00 0x100000>;
			alloc-ranges = <0x00 0x50000000 0x00 0x40000000>;
		};

		wifi_mem: wifi-reserve-memory {
			compatible = "shared-dma-pool";
			no-map;
			size = <0x00 0xf20000>;
			alignment = <0x00 0x1000000>;
			alloc-ranges = <0x00 0x40000000 0x00 0x80000000>;
			phandle = <0xb2>;
		};

		gps-reserve-memory {
			compatible = "mediatek,gps-reserve-memory";
			no-map;
			size = <0x00 0x100000>;
			alignment = <0x00 0x100000>;
			alloc-ranges = <0x00 0x40000000 0x00 0x80000000>;
		};

		reserve-memory-sspm_share {
			compatible = "mediatek,reserve-memory-sspm_share";
			no-map;
			status = <0x6f6b6179>;
			size = <0x00 0x910000>;
			alignment = <0x00 0x10000>;
			alloc-ranges = <0x00 0x40000000 0x00 0x60000000>;
		};

		reserve-memory-adsp_share {
			compatible = "mediatek,reserve-memory-adsp_share";
			no-map;
			size = <0x00 0x1000000>;
			alloc-ranges = <0x00 0x40000000 0x00 0x40000000>;
			alignment = <0x00 0x10000>;
		};

		reserve-memory-scp_share {
			compatible = "mediatek,reserve-memory-scp_share";
			no-map;
			size = <0x00 0x300000>;
			alignment = <0x00 0x1000000>;
			alloc-ranges = <0x00 0x50000000 0x00 0x40000000>;
		};

		reserve-memory-mcupm_share {
			compatible = "mediatek,reserve-memory-mcupm_share";
			no-map;
			status = "okay";
			size = <0x00 0x200000>;
			alignment = <0x00 0x10000>;
			alloc-ranges = <0x00 0x40000000 0x00 0x60000000>;
		};
	};
	cache_parity {
		compatible = "mediatek,cache_parity";
		version = <0x02>;
		err_level = <0x00>;
		interrupts = <0x00 0x01 0x04 0x00 0x02 0x04 0x00 0x03 0x04 0x00 0x04 0x04 0x00 0x05 0x04 0x00 0x06 0x04 0x00 0x07 0x04 0x00 0x08 0x04 0x00 0x00 0x04>;
	};
	qos@0011bb00 {
		compatible = "mediatek,qos-2.0";
		reg = <0x00 0x11bb00 0x00 0x100>;
	};
	gic: interrupt-controller {
		compatible = "arm,gic-v3";
		#interrupt-cells = <0x03>;
		#address-cells = <0x02>;
		#size-cells = <0x02>;
		#redistributor-regions = <0x01>;
		interrupt-parent = <&gic>;
		interrupt-controller;
		reg = <0x0 0xc000000 0x0 0x40000 0x0 0xc040000 0x0 0x200000>;
		interrupts = <0x01 0x09 0x04>;
		phandle = <0x01>;
	};
	clocks {

		clk_null: clk_null {
			compatible = "fixed-clock";
			#clock-cells = <0x00>;
			clock-frequency = <0x0>;
			phandle = <0xfc>;
		};

		clk26m: clk26m {
			compatible = "fixed-clock";
			#clock-cells = <0x00>;
			clock-frequency = <0x18cba80>;
			phandle = <0x3b>;
		};

		clk12m: clk12m {
			compatible = "fixed-clock";
			#clock-cells = <0x00>;
			clock-frequency = <0xb71b00>;
			phandle = <0x74>;
		};

		clk32k: clk32k {
			compatible = "fixed-clock";
			#clock-cells = <0x00>;
			clock-frequency = <0x7d00>;
			phandle = <0xfd>;
		};
	};
	chipid@08000000 {
		compatible = "mediatek,chipid";
		reg = <0x00 0x8000000 0x00 0x04 0x00 0x8000004 0x00 0x04 0x00 0x8000008 0x00 0x04 0x00 0x800000c 0x00 0x04>;
	};
	scp_dvfs {
		compatible = "mediatek,scp_dvfs";
		status = "disabled";
		clocks = <&topckgen 0x56 &clk26m>;
		clock-names = "clk_mux", "clk_pll_0";
	};
	pwraph: pwraphal@10026000 {
		compatible = "mediatek,pwraph";
		mediatek,pwrap-regmap = <0x53>;
		phandle = <0x132>;
	};
	pwmleds {
		compatible = "mediatek,pwm-leds";

		backlight {
			label = "lcd-backlight";
			pwms = <&disp_pwm 0x0 0x99d9>;
			max-brightness = <0xff>;
			pwm-names = "lcd-backlight";
		};
	};
	boot_dramboost: boot_dramboost {
		compatible = "mediatek,dvfsrc-boost";
		boost_opp = <0x00>;
		phandle = <0x134>;
	};
	radio_md_cfg: radio_md_cfg {
		compatible = "mediatek,radio_md_cfg";
		phandle = <0x136>;
	};
	md_auxadc: md_auxadc {
		compatible = "mediatek,md_auxadc";
		io-channels = <0x56 0x02>;
		io-channel-names = "md-channel";
		phandle = <0x137>;
	};
	gpio_usage_mapping: gpio_usage_mapping {
		compatible = "mediatek,gpio_usage_mapping";
		phandle = <0x138>;
		GPIO_SIM1_HOT_PLUG = <0x02 0x2b 0x00>;
		GPIO_SIM2_SCLK = <0x02 0x2d 0x00>;
		GPIO_SIM2_SRST = <0x02 0x2e 0x00>;
		GPIO_SIM2_SIO = <0x02 0x2f 0x00>;
		GPIO_SIM1_SIO = <0x02 0x30 0x00>;
		GPIO_SIM1_SRST = <0x02 0x31 0x00>;
		GPIO_SIM1_SCLK = <0x02 0x32 0x00>;
	};
	atf_logger {
		compatible = "mediatek,atf_logger";
		interrupts = <0x00 0x1f7 0x01>;
	};
	mobicore {
		compatible = "trustonic,mobicore";
		interrupts = <0x00 0x1f8 0x01>;
	};
	tee_sanity {
		compatible = "mediatek,tee_sanity";
		interrupts = <0x00 0x1f9 0x01>;
	};
	utos {
		compatible = "microtrust,utos";
		interrupts = <0x00 0x1fa 0x01 0x00 0x1fb 0x01>;
	};
	utos_tester {
		compatible = "microtrust,tester-v1";
	};
	mcucfg: mcucfg@0c530000 {
		compatible = "mediatek,mcucfg";
		reg = <0x0 0xc530000 0x0 0x10000>;
		phandle = <0x39>;
	};
	hwrng: hwrng {
		compatible = "mediatek,mt67xx-rng";
		phandle = <0x14b>;
	};
	emiisu {
		con_addr = <0x00 0x11d890>;
		ver_addr = <0x00 0x11d8a4>;
		buf_addr = <0x00 0x00>;
		buf_size = <0x800000>;
		compatible = "mediatek,mt6885-emiisu", "mediatek,common-emiisu";
		ctrl_intf = <0x00>;
	};
	upower: upower {
		compatible = "mediatek,mt6893-upower";
		phandle = <0x14d>;
	};
	dvfsp: dvfsp@0011bc00 {
		compatible = "mediatek,mt6885-dvfsp";
		reg = <0x0 0x11bc00 0x0 0x1400 0x0 0x11bc00 0x0 0x1400>;
		state = <0x01>;
		imax_state = <0x02>;
		change_flag = <0x00>;
		proc1-supply = <&mt6315_6_vbuck1>;
		proc2-supply = <&mt6315_7_vbuck3>;
		little-rise-time = <0x3e8>;
		little-down-time = <0x2ee>;
		big-rise-time = <0x3e8>;
		big-down-time = <0x2ee>;
		phandle = <0x14e>;
	};
	mt_cpufreq: mt_cpufreq {
		compatible = "mediatek,mt-cpufreq";
		phandle = <0x14f>;
	};
	cpumssv: cpumssv {
		compatible = "mediatek,cpumssv";
		state = <0x0>;
		phandle = <0x150>;
	};
	usbphy0: usbphy {
		compatible = "usb-nop-xceiv";
		phandle = <0x155>;
	};
	extcon_usb: extcon_usb {
		compatible = "mediatek,extcon-usb";
		phandle = <0x73>;
	};
	usb_boost_manager {
		compatible = "mediatek,usb_boost";
		boost_period = <0x00>;
	};
	mmc_fixed_3v3: fixedregulator@0 {
		compatible = "regulator-fixed";
		status = "okay";
		phandle = <0x159>;
		regulator-name = "mmc_power";
		regulator-min-microvolt = <0x325aa0>;
		regulator-max-microvolt = <0x325aa0>;
		enable-active-high;
		regulator-always-on;
	};
	mmc_fixed_1v8_io: fixedregulator@1 {
		compatible = "regulator-fixed";
		status = "okay";
		phandle = <0x15a>;
		regulator-name = "mmc_io";
		regulator-min-microvolt = <0x1b7740>;
		regulator-max-microvolt = <0x1b7740>;
		enable-active-high;
		regulator-always-on;
	};
	cmdq-test {
		compatible = "mediatek,cmdq-test";
		mediatek,gce = <0x70>;
		mmsys_config = <0x6a>;
		mediatek,gce-subsys = <0x63 0x01>;
		mboxes = <&gce_mbox 0x17 0x0 0x1 &gce_mbox_m 0x17 0xffffffff 0x1 &gce_mbox_sec 0xb 0x0 0x1>;
		token_user0 = [02 89];
		token_gpr_set4 = [02 c0];
	};
	cmdq-bw-mon {
		compatible = "mediatek,cmdq-bw-mon";
		mboxes = <&gce_mbox 0x16 0xffffffff 0x1>;
		smi_mon = <0x77 0x78>;
		bw_mon_gpr = [0d];
	};
	gic500@0c000000 {
		compatible = "mediatek,gic500";
		reg = <0x0 0xc000000 0x0 0x400000>;
	};
	gic_cpu@0c400000 {
		compatible = "mediatek,gic_cpu";
		reg = <0x0 0xc400000 0x0 0x40000>;
	};
	dfd_cache: dfd_cache {
		compatible = "mediatek,dfd_cache";
		mediatek,enabled = <0x0>;
		mediatek,l2c_trigger = <0x00>;
		mediatek,rg_dfd_timeout = <0x5dc0>;
		phandle = <0x15f>;
	};
	dbg_ao@0d000000 {
		compatible = "mediatek,dbg_ao";
		reg = <0x0 0xd000000 0x0 0x10000>;
	};
	dbg_cti@0d020000 {
		compatible = "mediatek,dbg_cti";
		reg = <0x0 0xd020000 0x0 0x10000>;
	};
	dbg_etr@0d030000 {
		compatible = "mediatek,dbg_etr";
		reg = <0x0 0xd030000 0x0 0x10000>;
	};
	bus_tracer@0d040000 {
		compatible = "mediatek,bus_tracer-v1";
		reg = <0x00 0xd040000 0x00 0x100 0x00 0xd01a000 0x00 0x1000 0x00 0xd041000 0x00 0x3000 0x00 0xd010000 0x00 0x1000 0x00 0xd040800 0x00 0x100 0x00 0xd040900 0x00 0x100 0x00 0xd040a00 0x00 0x100>;
		mediatek,err_flag = <0xfbf8ffff>;
		mediatek,num_tracer = <0x03>;
		mediatek,enabled_tracer = <0x00 0x01 0x00>;
		mediatek,at_id = <0x10 0x30 0x70>;
	};
	dbg_dem@0d0a0000 {
		compatible = "mediatek,dbg_dem";
		reg = <0x0 0xd0a0000 0x0 0x10000>;
		interrupts = <0x00 0xae 0x04>;
	};
	dbg_mdsys1@0d100000 {
		compatible = "mediatek,dbg_mdsys1";
		reg = <0x0 0xd100000 0x0 0x80000>;
	};
	ses: ses {
		compatible = "mediatek,ses";
		state = <0x100>;
		ses0_reg3 = <0x00>;
		ses1_reg3 = <0x00>;
		ses2_reg3 = <0x00>;
		ses3_reg3 = <0x00>;
		ses4_reg3 = <0x00>;
		ses5_reg3 = <0x00>;
		ses6_reg3 = <0x00>;
		ses7_reg3 = <0x00>;
		ses8_reg3 = <0x00>;
		ses0_reg2 = <0x00>;
		ses1_reg2 = <0x00>;
		ses2_reg2 = <0x00>;
		ses3_reg2 = <0x00>;
		ses4_reg2 = <0x00>;
		ses5_reg2 = <0x00>;
		ses6_reg2 = <0x00>;
		ses7_reg2 = <0x00>;
		ses8_reg2 = <0x00>;
		ses0_drphipct = <0x00>;
		ses1_drphipct = <0x00>;
		ses2_drphipct = <0x00>;
		ses3_drphipct = <0x00>;
		ses4_drphipct = <0x00>;
		ses5_drphipct = <0x00>;
		ses6_drphipct = <0x00>;
		ses7_drphipct = <0x00>;
		ses8_drphipct = <0x00>;
		ses0_drplopct = <0x00>;
		ses1_drplopct = <0x00>;
		ses2_drplopct = <0x00>;
		ses3_drplopct = <0x00>;
		ses4_drplopct = <0x00>;
		ses5_drplopct = <0x00>;
		ses6_drplopct = <0x00>;
		ses7_drplopct = <0x00>;
		ses8_drplopct = <0x00>;
		phandle = <0x160>;
	};
	brisket: brisket {
		compatible = "mediatek,brisket";
		brisket_doe_ptp = <0xff>;
		brisket_doe_pllclken = <0xf0>;
		brisket_doe_bren = <0xf0>;
		brisket_doe_brisket05 = <0x110842>;
		brisket_doe_brisket06 = <0xfbf1>;
		brisket_doe_brisket07 = <0xfff>;
		brisket_doe_brisket08 = <0xc8a>;
		brisket_doe_brisket09 = <0x3e00>;
		phandle = <0x161>;
	};
	credit_didt: credit_didt {
		compatible = "mediatek,credit_didt";
		credit_didt_doe_ptp = <0xff>;
		credit_didt_doe_enable = <0xf000>;
		credit_didt4_doe_ls_period = <0x06>;
		credit_didt5_doe_ls_period = <0x06>;
		credit_didt6_doe_ls_period = <0x06>;
		credit_didt7_doe_ls_period = <0x06>;
		credit_didt4_doe_ls_credit = <0x06>;
		credit_didt5_doe_ls_credit = <0x06>;
		credit_didt6_doe_ls_credit = <0x06>;
		credit_didt7_doe_ls_credit = <0x06>;
		credit_didt4_doe_ls_low_freq_period = <0x07>;
		credit_didt5_doe_ls_low_freq_period = <0x07>;
		credit_didt6_doe_ls_low_freq_period = <0x07>;
		credit_didt7_doe_ls_low_freq_period = <0x07>;
		credit_didt4_doe_ls_low_freq_enable = <0x00>;
		credit_didt5_doe_ls_low_freq_enable = <0x00>;
		credit_didt6_doe_ls_low_freq_enable = <0x00>;
		credit_didt7_doe_ls_low_freq_enable = <0x00>;
		credit_didt4_doe_vx_period = <0x06>;
		credit_didt5_doe_vx_period = <0x06>;
		credit_didt6_doe_vx_period = <0x06>;
		credit_didt7_doe_vx_period = <0x06>;
		credit_didt4_doe_vx_credit = <0x06>;
		credit_didt5_doe_vx_credit = <0x06>;
		credit_didt6_doe_vx_credit = <0x06>;
		credit_didt7_doe_vx_credit = <0x06>;
		credit_didt4_doe_vx_low_freq_period = <0x07>;
		credit_didt5_doe_vx_low_freq_period = <0x07>;
		credit_didt6_doe_vx_low_freq_period = <0x07>;
		credit_didt7_doe_vx_low_freq_period = <0x07>;
		credit_didt4_doe_vx_low_freq_enable = <0x00>;
		credit_didt5_doe_vx_low_freq_enable = <0x00>;
		credit_didt6_doe_vx_low_freq_enable = <0x00>;
		credit_didt7_doe_vx_low_freq_enable = <0x00>;
		phandle = <0x162>;
	};
	tboard_thermistor1: thermal-sensor1 {
		compatible = "mediatek,mtboard-thermistor1";
		io-channels = <0x56 0x00>;
		io-channel-names = "thermistor-ch0";
		phandle = <0x165>;
	};
	tboard_thermistor2: thermal-sensor2 {
		compatible = "mediatek,mtboard-thermistor2";
		io-channels = <0x56 0x01>;
		io-channel-names = "thermistor-ch1";
		phandle = <0x166>;
	};
	tboard_thermistor3: thermal-sensor3 {
		compatible = "mediatek,mtboard-thermistor3";
		io-channels = <0x56 0x02>;
		io-channel-names = "thermistor-ch2";
		phandle = <0x167>;
	};
	tboard_thermistor4: thermal-sensor4 {
		compatible = "mediatek,mtboard-thermistor4";
		io-channels = <0x56 0x04>;
		io-channel-names = "thermistor-ch4";
		phandle = <0x168>;
		thermal_rename = "charger_therm";
	};
	tboard_thermistor5: thermal-sensor5 {
		compatible = "mediatek,mtboard-thermistor5";
		io-channels = <0x56 0x05>;
		io-channel-names = "thermistor-ch5";
		phandle = <0x169>;
	};
	tboard_thermistor6: thermal-sensor6 {
		compatible = "mediatek,mtboard-thermistor6";
		io-channels = <0x56 0x03>;
		io-channel-names = "thermistor-ch3";
		phandle = <0x16a>;
	};
	mt6315_them_intr {
		compatible = "mediatek,mt6315_therm_intr";
		interrupts-extended = <0x98 0x04 0x01 0x98 0x05 0x01 0x98 0x06 0x04 0x99 0x04 0x01 0x99 0x05 0x01 0x99 0x06 0x04>;
		interrupt-names = "6315_6_temp_l", "6315_6_temp_h", "6315_6_rcs0", "6315_7_temp_l", "6315_7_temp_h", "6315_7_rcs0";
	};
	gpufreq: gpufreq {
		compatible = "mediatek,gpufreq";
		clocks = <&topckgen 0x16 &topckgen 0xa2 &topckgen 0x52 &g3d_config 0x1 &scpsys 0x2 &scpsys 0x3 &scpsys 0x4 &scpsys 0x5 &scpsys 0x6 &scpsys 0x7 &scpsys 0x8>;
		clock-names = "clk_mux", "clk_main_parent", "clk_sub_parent", "subsys_mfg_cg", "mtcmos_mfg_async", "mtcmos_mfg", "mtcmos_mfg_core0", "mtcmos_mfg_core1_2", "mtcmos_mfg_core3_4", "mtcmos_mfg_core5_6", "mtcmos_mfg_core7_8";
		_vgpu-supply = <0x9b>;
		_vsram_gpu-supply = <0x9c>;
		phandle = <0x9d>;
	};
	ged: ged {
		compatible = "mediatek,ged";
		gpufreq-supply = <&gpufreq>;
		phandle = <0x16b>;
	};
	mtkfb: mtkfb {
		compatible = "mediatek,mtkfb";
		phandle = <0x16c>;
		pinctrl-names = "lcd_bias_enp1_gpio", "lcd_bias_enp0_gpio", "lcd_bias_enn1_gpio", "lcd_bias_enn0_gpio", "lcm_rst_out1_gpio", "lcm_rst_out0_gpio", "mode_te_te";
		pinctrl-0 = <0x246>;
		pinctrl-1 = <0x247>;
		pinctrl-2 = <0x248>;
		pinctrl-3 = <0x249>;
		pinctrl-4 = <0x24a>;
		pinctrl-5 = <0x24b>;
		pinctrl-6 = <0x24c>;
		status = "okay";
	};
	dispsys {
		compatible = "mediatek,dispsys";
		mediatek,larb = <0x58>;
		clocks = <&dispsys_config 0x14 &dispsys_config 0x2f &dispsys_config 0x30 &dispsys_config 0x31 &dispsys_config 0x32 &dispsys_config 0x3 &dispsys_config 0x15 &dispsys_config 0x11 &dispsys_config 0x12 &dispsys_config 0x13 &dispsys_config 0x16 &dispsys_config 0x27 &dispsys_config 0x28 &dispsys_config 0x29 &dispsys_config 0x2a &dispsys_config 0x25 &dispsys_config 0x26 &dispsys_config 0x19 &dispsys_config 0x1a &dispsys_config 0x17 &dispsys_config 0x18 &dispsys_config 0x23 &dispsys_config 0x24 &dispsys_config 0x7 &dispsys_config 0x8 &dispsys_config 0x21 &dispsys_config 0x22 &dispsys_config 0x1b &dispsys_config 0x1c &dispsys_config 0x1d &dispsys_config 0x1e &dispsys_config 0x1f &dispsys_config 0x33 &dispsys_config 0x36 &dispsys_config 0x1 &dispsys_config 0x14 &dispsys_config 0x2e &dispsys_config 0x2c &dispsys_config 0x35 &apmixed 0x11 &topckgen 0x27 &infracfg_ao 0x37 &clk26m &topckgen 0x6c &topckgen 0x89 &topckgen 0x8a &topckgen 0x8c>;
		clock-names = "MMSYS_MTCMOS", "MMSYS_SMI_COMMON", "MMSYS_SMI_GALS", "MMSYS_SMI_INFRA", "MMSYS_SMI_IOMMU", "MMSYS_DISP_OVL0", "MMSYS_DISP_OVL1", "MMSYS_DISP_OVL0_2L", "MMSYS_DISP_OVL1_2L", "MMSYS_DISP_OVL2_2L", "MMSYS_DISP_OVL3_2L", "MMSYS_DISP_RDMA0", "MMSYS_DISP_RDMA1", "MMSYS_DISP_RDMA4", "MMSYS_DISP_RDMA5", "MMSYS_DISP_WDMA0", "MMSYS_DISP_WDMA1", "MMSYS_DISP_COLOR0", "MMSYS_DISP_COLOR1", "MMSYS_DISP_CCORR0", "MMSYS_DISP_CCORR1", "MMSYS_DISP_AAL0", "MMSYS_DISP_AAL1", "MMSYS_DISP_MDP_AAL4", "MMSYS_DISP_MDP_AAL5", "MMSYS_DISP_GAMMA0", "MMSYS_DISP_GAMMA1", "MMSYS_DISP_POSTMASK0", "MMSYS_DISP_POSTMASK1", "MMSYS_DISP_DITHER0", "MMSYS_DISP_DITHER1", "MMSYS_DSI0_MM_CK", "MMSYS_DSI0_IF_CK", "MMSYS_26M", "MMSYS_DISP_RSZ0", "MMSYS_DISP_MUTEX0", "MMSYS_DISP_MERGE1", "MMSYS_DP_INTF0", "MM_DP_INTF0", "APMIXED_MIPI_26M", "TOP_MUX_DISP_PWM", "DISP_PWM", "TOP_26M", "TOP_UNIVPLL_D6_D4", "TOP_OSC_D2", "TOP_OSC_D4", "TOP_OSC_D16";
	};
	dsi_te: dsi_te {
		compatible = "mediatek, dsi_te-eint";
		status = "okay";
		phandle = <0x17b>;
		interrupt-parent = <&pio>;
		interrupts = <0x08 0x01 0x08 0x00>;
	};
	mmdvfs_pmqos {
		compatible = "mediatek,mmdvfs_pmqos";
		larb_groups = <0x00 0x01 0x02 0x03 0x04 0x05 0x07 0x08 0x09 0x0b 0x0d 0x0e 0x10 0x11 0x12 0x13 0x14>;
		larb0 = <0x08 0x07 0x07 0x07 0x07 0x08 0x08 0x08 0x07 0x07 0x07 0x09 0x08 0x07 0x07>;
		larb1 = <0x08 0x07 0x07 0x07 0x07 0x08 0x08 0x08 0x07 0x07 0x07 0x09 0x08 0x07 0x07>;
		larb2 = <0x07 0x07 0x08 0x08 0x08 0x08>;
		larb3 = <0x07 0x07 0x08 0x08 0x08 0x08>;
		larb4 = <0x06 0x07 0x08 0x07 0x07 0x07 0x07 0x07 0x07 0x06 0x07>;
		larb5 = <0x07 0x07 0x06 0x07 0x07 0x08 0x07 0x07>;
		larb7 = <0x07 0x08 0x08 0x08 0x07 0x07 0x07 0x07 0x07 0x07 0x08 0x08 0x07 0x08 0x08 0x07 0x07 0x07 0x07 0x07 0x08 0x07 0x08 0x08 0x07 0x08 0x08>;
		larb8 = <0x07 0x08 0x08 0x08 0x07 0x07 0x07 0x07 0x07 0x07 0x08 0x08 0x07 0x08 0x08 0x07 0x07 0x07 0x07 0x07 0x08 0x07 0x08 0x08 0x07 0x08 0x08>;
		larb9 = <0x07 0x07 0x07 0x07 0x07 0x07 0x08 0x08 0x08 0x08 0x07 0x07 0x08 0x09 0x08 0x06 0x06 0x07 0x07 0x07 0x07 0x07 0x07 0x07 0x08 0x08 0x08 0x08 0x07>;
		larb11 = <0x07 0x07 0x07 0x07 0x07 0x07 0x08 0x08 0x08 0x08 0x07 0x07 0x08 0x09 0x08 0x06 0x06 0x07 0x07 0x07 0x07 0x07 0x07 0x07 0x08 0x08 0x08 0x08 0x07>;
		larb13 = <0x07 0x08 0x08 0x08 0x08 0x08 0x08 0x08 0x08 0x07 0x08 0x07>;
		larb14 = <0x07 0x08 0x08 0x08 0x07 0x08>;
		larb16 = <0x08 0x08 0x07 0x07 0x08 0x07 0x07 0x07 0x08 0x08 0x08 0x08 0x08 0x08 0x08 0x08 0x07>;
		larb17 = <0x08 0x08 0x07 0x07 0x08 0x07 0x07 0x07 0x08 0x08 0x08 0x08 0x08 0x08 0x08 0x08 0x07>;
		larb18 = <0x08 0x08 0x07 0x07 0x08 0x07 0x07 0x07 0x08 0x08 0x08 0x08 0x08 0x08 0x08 0x08 0x07>;
		larb19 = <0x07 0x08 0x07 0x08>;
		larb20 = <0x07 0x07 0x08 0x08 0x06 0x07>;
		vcore-supply = <&mt_pmic_vgpu11_buck_reg>;
		cam_larb = <0x0d 0x0e 0x10 0x11 0x12 0x17 0x18>;
		max_ostd_larb = <0x00 0x01>;
		max_ostd = <0x28>;
		comm_freq = "disp_freq", "mdp_freq";
		disp_step0 = <0x222 0x01 0x00 0x0a>;
		disp_step1 = <0x1a0 0x01 0x00 0x0b>;
		disp_step2 = <0x138 0x01 0x00 0x0c>;
		disp_step3 = <0xf9 0x01 0x00 0x0d>;
		mdp_step0 = <0x252 0x01 0x01 0x0e>;
		mdp_step1 = <0x1a0 0x01 0x01 0x0b>;
		mdp_step2 = <0x138 0x01 0x01 0x0c>;
		mdp_step3 = <0x111 0x01 0x01 0x0f>;
		cam_step0 = <0x270 0x01 0x02 0x10>;
		cam_step1 = <0x1f3 0x01 0x02 0x11>;
		cam_step2 = <0x188 0x01 0x02 0x12>;
		cam_step3 = <0x138 0x01 0x02 0x0c>;
		img_step0 = <0x270 0x01 0x03 0x10>;
		img_step1 = <0x1a0 0x01 0x03 0x0b>;
		img_step2 = <0x157 0x01 0x03 0x13>;
		img_step3 = <0x111 0x01 0x03 0x0f>;
		img2_step0 = <0x270 0x01 0x04 0x10>;
		img2_step1 = <0x1a0 0x01 0x04 0x0b>;
		img2_step2 = <0x157 0x01 0x04 0x13>;
		img2_step3 = <0x111 0x01 0x04 0x0f>;
		venc_step0 = <0x270 0x01 0x05 0x10>;
		venc_step1 = <0x1a0 0x01 0x05 0x0b>;
		venc_step2 = <0x138 0x01 0x05 0x0c>;
		venc_step3 = <0x111 0x01 0x05 0x0f>;
		vdec_step0 = <0x222 0x01 0x06 0x0a>;
		vdec_step1 = <0x1a0 0x01 0x06 0x0b>;
		vdec_step2 = <0x138 0x01 0x06 0x0c>;
		vdec_step3 = <0xf9 0x01 0x06 0x0d>;
		dpe_step0 = <0x222 0x01 0x07 0x0a>;
		dpe_step1 = <0x1ca 0x01 0x07 0x14>;
		dpe_step2 = <0x16c 0x01 0x07 0x15>;
		dpe_step3 = <0x138 0x01 0x07 0x0c>;
		ipe_step0 = <0x222 0x01 0x08 0x0a>;
		ipe_step1 = <0x1a0 0x01 0x08 0x0b>;
		ipe_step2 = <0x138 0x01 0x08 0x0c>;
		ipe_step3 = <0x111 0x01 0x08 0x0f>;
		ccu_step0 = <0x1f3 0x01 0x09 0x11>;
		ccu_step1 = <0x188 0x01 0x09 0x12>;
		ccu_step2 = <0x16c 0x01 0x09 0x15>;
		ccu_step3 = <0x138 0x01 0x09 0x0c>;
		fmeter_mux_ids = <0x05 0x06 0x0b 0x07 0x08 0x38 0x39 0x0a 0x09>;
		vopp_steps = <0x01 0x02 0x03 0x04>;
		disp_freq = "disp_step0", "disp_step1", "disp_step2", "disp_step3";
		mdp_freq = "mdp_step0", "mdp_step1", "mdp_step2", "mdp_step3";
		cam_freq = "cam_step0", "cam_step1", "cam_step2", "cam_step3";
		img_freq = "img_step0", "img_step1", "img_step2", "img_step3";
		img2_freq = "img2_step0", "img2_step1", "img2_step2", "img2_step3";
		venc_freq = "venc_step0", "venc_step1", "venc_step2", "venc_step3";
		vdec_freq = "vdec_step0", "vdec_step1", "vdec_step2", "vdec_step3";
		dpe_freq = "dpe_step0", "dpe_step1", "dpe_step2", "dpe_step3";
		ipe_freq = "ipe_step0", "ipe_step1", "ipe_step2", "ipe_step3";
		ccu_freq = "ccu_step0", "ccu_step1", "ccu_step2", "ccu_step3";
		clocks = <&topckgen 0x5 &topckgen 0x6 &topckgen 0xb &topckgen 0x7 &topckgen 0x8 &topckgen 0x38 &topckgen 0x39 &topckgen 0xa &topckgen 0x9 &topckgen 0xc &topckgen 0x4c &topckgen 0x6a &topckgen 0x62 &topckgen 0x66 &topckgen 0x7e &topckgen 0x4d &topckgen 0x61 &topckgen 0x65 &topckgen 0x7b &topckgen 0x74 &topckgen 0x79 &topckgen 0x55 &topckgen 0x25>;
		clock-names = "TOP_MUX_DISP", "TOP_MUX_MDP", "TOP_MUX_CAM", "TOP_MUX_IMG1", "TOP_MUX_IMG2", "TOP_MUX_VENC", "TOP_MUX_VDEC", "TOP_MUX_DPE", "TOP_MUX_IPE", "TOP_MUX_CCU", "TOP_MAINPLL_D4", "TOP_UNIVPLL_D6", "TOP_UNIVPLL_D4_D2", "TOP_UNIVPLL_D5_D2", "TOP_TVDPLL_CK", "TOP_MAINPLL_D4_D2", "TOP_UNIVPLL_D4", "TOP_UNIVPLL_D5", "TOP_MMPLL_D7", "TOP_MMPLL_D4_D2", "TOP_MMPLL_D6", "TOP_MAINPLL_D6", "TOP_MUX_DP";
	};
	kd_camera_hw1: kd_camera_hw1@1a004000 {
		compatible = "mediatek,imgsensor";
		phandle = <0x18f>;
		cam0_vcamio-supply = <0x11a>;
		cam1_vcamio-supply = <0x11a>;
		cam2_vcamio-supply = <0x11a>;
		cam3_vcamio-supply = <0x11a>;
		cam0_vcamd-supply = <0x1f3>;
		cam0_vcama-supply = <0x1f4>;
		cam1_vcamd-supply = <0x1f5>;
		cam1_vcama-supply = <0x1f6>;
		cam2_vcama-supply = <0x1f7>;
		cam3_vcamd-supply = <0x1f8>;
		cam3_vcama-supply = <0x1f7>;
		cam0_enable_sensor = "ov64b40sunny_mipi_raw";
		cam1_enable_sensor = "ov16a1qofilm_mipi_raw";
		cam2_enable_sensor = "gc02m1sunny_mipi_raw";
		cam3_enable_sensor = "imx355sunny_mipi_raw";
		pinctrl-names = "default", "cam0_rst0", "cam0_rst1", "cam0_pnd0", "cam0_pnd1", "cam1_rst0", "cam1_rst1", "cam1_pnd0", "cam1_pnd1", "cam2_rst0", "cam2_rst1", "cam2_pnd0", "cam2_pnd1", "cam3_rst0", "cam3_rst1", "cam3_pnd0", "cam3_pnd1", "cam4_rst0", "cam4_rst1", "cam4_pnd0", "cam4_pnd1", "cam0_ldo_vcamd_0", "cam0_ldo_vcamd_1", "cam0_ldo_vcama_0", "cam0_ldo_vcama_1", "cam1_ldo_vcamd_0", "cam1_ldo_vcamd_1", "cam1_ldo_vcama_0", "cam1_ldo_vcama_1", "cam2_ldo_vcamd_0", "cam2_ldo_vcamd_1", "cam2_ldo_vcama_0", "cam2_ldo_vcama_1", "cam3_ldo_vcamd_0", "cam3_ldo_vcamd_1", "cam3_ldo_vcama_0", "cam3_ldo_vcama_1", "cam4_ldo_vcamd_0", "cam4_ldo_vcamd_1", "cam4_ldo_vcama_0", "cam4_ldo_vcama_1", "cam0_mclk_off", "cam0_mclk_2mA", "cam0_mclk_4mA", "cam0_mclk_6mA", "cam0_mclk_8mA", "cam1_mclk_off", "cam1_mclk_2mA", "cam1_mclk_4mA", "cam1_mclk_6mA", "cam1_mclk_8mA", "cam2_mclk_off", "cam2_mclk_2mA", "cam2_mclk_4mA", "cam2_mclk_6mA", "cam2_mclk_8mA", "cam3_mclk_off", "cam3_mclk_2mA", "cam3_mclk_4mA", "cam3_mclk_6mA", "cam3_mclk_8mA", "cam4_mclk_off", "cam4_mclk_2mA", "cam4_mclk_4mA", "cam4_mclk_6mA", "cam4_mclk_8mA";
		pinctrl-0 = <0x1f9>;
		pinctrl-1 = <0x1fa>;
		pinctrl-2 = <0x1fb>;
		pinctrl-3 = <0x1fc>;
		pinctrl-4 = <0x1fd>;
		pinctrl-5 = <0x1fe>;
		pinctrl-6 = <0x1ff>;
		pinctrl-7 = <0x200>;
		pinctrl-8 = <0x201>;
		pinctrl-9 = <0x202>;
		pinctrl-10 = <0x203>;
		pinctrl-11 = <0x204>;
		pinctrl-12 = <0x205>;
		pinctrl-13 = <0x206>;
		pinctrl-14 = <0x207>;
		pinctrl-15 = <0x208>;
		pinctrl-16 = <0x209>;
		pinctrl-17 = <0x20a>;
		pinctrl-18 = <0x20b>;
		pinctrl-19 = <0x20c>;
		pinctrl-20 = <0x20d>;
		pinctrl-21 = <0x20e>;
		pinctrl-22 = <0x20f>;
		pinctrl-23 = <0x210>;
		pinctrl-24 = <0x211>;
		pinctrl-25 = <0x212>;
		pinctrl-26 = <0x213>;
		pinctrl-27 = <0x214>;
		pinctrl-28 = <0x215>;
		pinctrl-29 = <0x216>;
		pinctrl-30 = <0x217>;
		pinctrl-31 = <0x218>;
		pinctrl-32 = <0x219>;
		pinctrl-33 = <0x21a>;
		pinctrl-34 = <0x21b>;
		pinctrl-35 = <0x21c>;
		pinctrl-36 = <0x21d>;
		pinctrl-37 = <0x21e>;
		pinctrl-38 = <0x21f>;
		pinctrl-39 = <0x220>;
		pinctrl-40 = <0x221>;
		pinctrl-41 = <0x222>;
		pinctrl-42 = <0x223>;
		pinctrl-43 = <0x224>;
		pinctrl-44 = <0x225>;
		pinctrl-45 = <0x226>;
		pinctrl-46 = <0x227>;
		pinctrl-47 = <0x228>;
		pinctrl-48 = <0x229>;
		pinctrl-49 = <0x22a>;
		pinctrl-50 = <0x22b>;
		pinctrl-51 = <0x22c>;
		pinctrl-52 = <0x22d>;
		pinctrl-53 = <0x22e>;
		pinctrl-54 = <0x22f>;
		pinctrl-55 = <0x230>;
		pinctrl-56 = <0x231>;
		pinctrl-57 = <0x232>;
		pinctrl-58 = <0x233>;
		pinctrl-59 = <0x234>;
		pinctrl-60 = <0x235>;
		pinctrl-61 = <0x236>;
		pinctrl-62 = <0x237>;
		pinctrl-63 = <0x238>;
		pinctrl-64 = <0x239>;
		pinctrl-65 = <0x23a>;
		status = "okay";
		vcamio-supply = <&mt_pmic_vcamio_ldo_reg>;
		vcamio_sub-supply = <0x11a>;
		vcamio_main2-supply = <0x11a>;
		vcamaf-supply = <&mt_pmic_vcamio_ldo_reg>;
		vcamaf_main2-supply = <0x11a>;
	};
	camera_af_hw_node: camera_af_hw_node {
		compatible = "mediatek,camera_af_lens";
		phandle = <0x194>;
		vcamwaf-supply = <0x23b>;
		status = "okay";
	};
	flashlight_core: flashlight_core {
		compatible = "mediatek,flashlight_core";
		phandle = <0x195>;
	};
	flashlights_mt6360: flashlights_mt6360 {
		compatible = "mediatek,flashlights_mt6360";
		decouple = <0x01>;
		phandle = <0x196>;

		channel@1 {
			type = <0x0>;
			ct = <0x0>;
			part = <0x0>;
		};

		channel@2 {
			type = <0x0>;
			ct = <0x01>;
			part = <0x0>;
		};
	};
	fm: fm@18000000 {
		compatible = "mediatek,fm";
		family-id = <0x6885>;
		host-id = <0x6893>;
		conn-id = <0x2001>;
		interrupts = <0x00 0x17c 0x04>;
		phandle = <0x19a>;
	};
	hcp: hcp@0 {
		compatible = "mediatek,hcp";
		phandle = <0x19c>;
	};
	odm: odm {
		compatible = "simple-bus";
		phandle = <0x19d>;

		led@0 {
			compatible = "mediatek,red";
			led_mode = <0x00>;
			data = <0x01>;
			pwm_config = <0x00 0x00 0x00 0x00 0x00>;
			phandle = <0x257>;
		};

		led@1 {
			compatible = "mediatek,green";
			led_mode = <0x00>;
			data = <0x01>;
			pwm_config = <0x00 0x00 0x00 0x00 0x00>;
			phandle = <0x258>;
		};

		led@2 {
			compatible = "mediatek,blue";
			led_mode = <0x00>;
			data = <0x01>;
			pwm_config = <0x00 0x00 0x00 0x00 0x00>;
			phandle = <0x259>;
		};

		led@3 {
			compatible = "mediatek,jogball-backlight";
			led_mode = <0x00>;
			data = <0x01>;
			pwm_config = <0x00 0x00 0x00 0x00 0x00>;
			phandle = <0x25a>;
		};

		led@4 {
			compatible = "mediatek,keyboard-backlight";
			led_mode = <0x00>;
			data = <0x01>;
			pwm_config = <0x00 0x00 0x00 0x00 0x00>;
			phandle = <0x25b>;
		};

		led@5 {
			compatible = "mediatek,button-backlight";
			led_mode = <0x00>;
			data = <0x01>;
			pwm_config = <0x00 0x00 0x00 0x00 0x00>;
			phandle = <0x25c>;
		};

		led@6 {
			compatible = "mediatek,lcd-backlight";
			led_mode = <0x04>;
			data = <0x01>;
			pwm_config = <0x00 0x01 0x00 0x00 0x00>;
			phandle = <0x25d>;
		};

		vibrator@0 {
			compatible = "mediatek,vibrator";
			vib_timer = <0x19>;
			vib_limit = <0x09>;
			vib_vol = <0x09>;
			phandle = <0x25e>;
		};

		usb_c_pinctrl {
			compatible = "mediatek,usb_c_pinctrl";
			phandle = <0x25f>;
		};

		testing-mode {
			compatible = "modem,testing-mode";
			status-gpio = <&pio 0x17 0x0>;
			debounce-time = <0x1e>;
			pinctrl-names = "default";
			pinctrl-0 = <0x1f2>;
		};

		thermal-message {
			board-sensor = "VIRTUAL-SENSOR";
			phandle = <0x27c>;
		};
	};
	memory_ssmr_features: memory-ssmr-features {
		compatible = "mediatek,memory-ssmr-features";
		svp-region-based-size = <0x0 0x18000000>;
		iris-recognition-size = <0x0 0x10000000>;
		2d_fr-size = <0x00 0x00>;
		tui-size = <0x0 0x4000000>;
		wfd-size = <0x0 0x4000000>;
		prot-region-based-size = <0x0 0x8000000>;
		ta-elf-size = <0x0 0x1000000>;
		ta-stack-heap-size = <0x0 0x6000000>;
		sdsp-tee-sharedmem-size = <0x0 0x1000000>;
		sdsp-firmware-size = <0x0 0x1000000>;
		phandle = <0x19e>;
	};
	i2c_common: i2c_common {
		compatible = "mediatek,i2c_common";
		dma_support = [03];
		idvfs = [01];
		set_dt_div = [01];
		check_max_freq = [01];
		ver = [02];
		set_ltiming = [01];
		ext_time_config = [18 01];
		cnt_constraint = [01];
		dma_ver = [01];
		phandle = <0x1a7>;
	};
	goodix_fp: fingerprint {
		compatible = "mediatek,fpc1022_irq", "mediatek,goodix-fp";
		phandle = <0x1b7>;
		pinctrl-names = "default", "reset_high", "reset_low", "eint_init", "spi_cs";
		pinctrl-0 = <0x1e6>;
		pinctrl-1 = <0x1e7>;
		pinctrl-2 = <0x1e8>;
		pinctrl-3 = <0x1e9>;
		pinctrl-4 = <0x1ea>;
		fpc,gpio_irq = <0x02 0x0f 0x00>;
		interrupt-parent = <&pio>;
		interrupts = <0x0f 0x01 0x0f 0x00>;
		status = "okay";
	};
	accdet: accdet {
		compatible = "mediatek,pmic-accdet";
		phandle = <0x1b8>;
		accdet-mic-vol = <0x05>;
		headset-mode-setting = <0x500 0x500 0x01 0x1f0 0x800 0x800 0x20 0x44 0x04 0x01 0x05 0x03 0x03 0x05 0x0e>;
		accdet-plugout-debounce = <0x01>;
		accdet-mic-mode = <0x02>;
		headset-three-key-threshold = <0x00 0x50 0xdc 0x190>;
		headset-three-key-threshold-CDD = <0x00 0x79 0xc0 0x258>;
		headset-four-key-threshold = <0x00 0x3a 0x79 0xc0 0x190>;
		eint_use_ext_res = <0x00>;
		status = "okay";
		et7480-i2c-handle = <0x1e2>;
	};
	mt6359_gauge {
		compatible = "mediatek,mt6359_gauge";
		gauge_name = "gauge";
		alias_name = "MT6359";
	};
	gauge_timer {
		compatible = "mediatek,gauge_timer_service";
	};
	bat_gm30: battery {
		compatible = "simple-battery";
		DIFFERENCE_FULLOCV_ITH = <0xc8>;
		SHUTDOWN_1_TIME = <0x05>;
		KEEP_100_PERCENT = <0x01>;
		R_FG_VALUE = <0x05>;
		EMBEDDED_SEL = <0x00>;
		PMIC_SHUTDOWN_CURRENT = <0x14>;
		FG_METER_RESISTANCE = <0x64>;
		CAR_TUNE_VALUE = <0x64>;
		PMIC_MIN_VOL = <0x82dc>;
		POWERON_SYSTEM_IBOOT = <0x1f4>;
		SHUTDOWN_GAUGE0_VOLTAGE = <0x84d0>;
		TEMPERATURE_T0 = <0x32>;
		TEMPERATURE_T1 = <0x19>;
		TEMPERATURE_T2 = <0x0a>;
		TEMPERATURE_T3 = <0x00>;
		TEMPERATURE_T4 = <0xfffffff6>;
		g_FG_PSEUDO100_T0 = <0x64>;
		g_FG_PSEUDO100_T1 = <0x64>;
		g_FG_PSEUDO100_T2 = <0x64>;
		g_FG_PSEUDO100_T3 = <0x64>;
		g_FG_PSEUDO100_T4 = <0x64>;
		Q_MAX_SYS_VOLTAGE_BAT0 = <0xd16>;
		Q_MAX_SYS_VOLTAGE_BAT1 = <0xd16>;
		Q_MAX_SYS_VOLTAGE_BAT2 = <0xd16>;
		Q_MAX_SYS_VOLTAGE_BAT3 = <0xd16>;
		COM_FG_METER_RESISTANCE = <0x64>;
		COM_R_FG_VALUE = <0x00>;
		enable_tmp_intr_suspend = <0x00>;
		ACTIVE_TABLE = <0x00>;
		MULTI_TEMP_GAUGE0 = <0x01>;
		battery0_profile_t0_num = <0x64>;
		battery0_profile_t0_col = <0x03>;
		battery0_profile_t0 = <0x00 0xa8d4 0x4fb 0x131 0xa832 0x4fb 0x263 0xa7b8 0x514 0x394 0xa73e 0x517 0x4c5 0xa6ce 0x548 0x5f6 0xa65d 0x55d 0x728 0xa5e3 0x549 0x859 0xa56b 0x55f 0x98a 0xa4f9 0x55f 0xabb 0xa481 0x563 0xbed 0xa411 0x578 0xd1e 0xa3a3 0x578 0xe4f 0xa33d 0x573 0xf80 0xa2d3 0x55f 0x10b2 0xa25d 0x56b 0x11e3 0xa1f7 0x591 0x1314 0xa18f 0x599 0x1445 0xa126 0x5a2 0x1577 0xa0b9 0x591 0x16a8 0xa050 0x59a 0x17d9 0x9fe4 0x5a0 0x190a 0x9f82 0x59b 0x1a3c 0x9f2b 0x5bf 0x1b6d 0x9ee6 0x608 0x1c9e 0x9e9d 0x629 0x1dcf 0x9e29 0x5f6 0x1f01 0x9da0 0x5dc 0x2032 0x9d16 0x5dc 0x2163 0x9ca7 0x603 0x2294 0x9c4b 0x60c 0x23c6 0x9c06 0x61f 0x24f7 0x9bc8 0x64e 0x2628 0x9b8c 0x668 0x2759 0x9b53 0x663 0x288b 0x9b03 0x649 0x29bc 0x9abb 0x670 0x2aed 0x9a6a 0x68b 0x2c1e 0x9a1c 0x69c 0x2d50 0x99b9 0x693 0x2e81 0x993b 0x655 0x2fb2 0x98af 0x61b 0x30e3 0x9837 0x5c3 0x3215 0x97d7 0x5bd 0x3346 0x9783 0x5af 0x3477 0x9732 0x56e 0x35a8 0x96f1 0x55f 0x36da 0x96bc 0x55f 0x380b 0x9688 0x549 0x393c 0x964c 0x52f 0x3a6d 0x9621 0x52d 0x3b9f 0x95ef 0x545 0x3cd0 0x95bc 0x52e 0x3e01 0x9593 0x545 0x3f32 0x956a 0x52d 0x4064 0x9542 0x52d 0x4195 0x9519 0x515 0x42c6 0x94fb 0x548 0x43f7 0x94dc 0x576 0x4529 0x94bc 0x55f 0x465a 0x948b 0x55f 0x478b 0x946e 0x562 0x48bc 0x9459 0x57b 0x49ee 0x9445 0x595 0x4b1f 0x942f 0x5ae 0x4c50 0x9412 0x5c3 0x4d81 0x93fc 0x5be 0x4eb3 0x93e0 0x5b5 0x4fe4 0x93c9 0x5dc 0x5115 0x93a8 0x5c9 0x5246 0x937f 0x591 0x5378 0x9356 0x58a 0x54a9 0x9334 0x580 0x55da 0x9319 0x589 0x570b 0x92ed 0x578 0x583d 0x92be 0x566 0x596e 0x9299 0x546 0x5a9f 0x9276 0x53c 0x5bd0 0x9251 0x538 0x5d02 0x9237 0x552 0x5e33 0x9214 0x55f 0x5f64 0x91e1 0x56c 0x6095 0x91a4 0x551 0x61c7 0x9167 0x53a 0x62f8 0x9134 0x554 0x6429 0x90fc 0x56d 0x655a 0x90ad 0x55b 0x668c 0x9064 0x555 0x67bd 0x9046 0x55f 0x68ee 0x903c 0x56f 0x6a1f 0x9031 0x599 0x6b51 0x9027 0x5aa 0x6c82 0x900f 0x5de 0x6db3 0x8fdb 0x619 0x6ee4 0x8f14 0x615 0x7016 0x8d80 0x60e 0x7147 0x8b6a 0x65a 0x7278 0x888f 0x6d4 0x73a9 0x8448 0x806 0x74db 0x7bb8 0x2b47 0x760c 0x6d7e 0x19e1>;
		battery0_profile_t1_num = <0x64>;
		battery0_profile_t1_col = <0x03>;
		battery0_profile_t1 = <0x00 0xa8d4 0x4fb 0x131 0xa832 0x4fb 0x263 0xa7b8 0x514 0x394 0xa73e 0x517 0x4c5 0xa6ce 0x548 0x5f6 0xa65d 0x55d 0x728 0xa5e3 0x549 0x859 0xa56b 0x55f 0x98a 0xa4f9 0x55f 0xabb 0xa481 0x563 0xbed 0xa411 0x578 0xd1e 0xa3a3 0x578 0xe4f 0xa33d 0x573 0xf80 0xa2d3 0x55f 0x10b2 0xa25d 0x56b 0x11e3 0xa1f7 0x591 0x1314 0xa18f 0x599 0x1445 0xa126 0x5a2 0x1577 0xa0b9 0x591 0x16a8 0xa050 0x59a 0x17d9 0x9fe4 0x5a0 0x190a 0x9f82 0x59b 0x1a3c 0x9f2b 0x5bf 0x1b6d 0x9ee6 0x608 0x1c9e 0x9e9d 0x629 0x1dcf 0x9e29 0x5f6 0x1f01 0x9da0 0x5dc 0x2032 0x9d16 0x5dc 0x2163 0x9ca7 0x603 0x2294 0x9c4b 0x60c 0x23c6 0x9c06 0x61f 0x24f7 0x9bc8 0x64e 0x2628 0x9b8c 0x668 0x2759 0x9b53 0x663 0x288b 0x9b03 0x649 0x29bc 0x9abb 0x670 0x2aed 0x9a6a 0x68b 0x2c1e 0x9a1c 0x69c 0x2d50 0x99b9 0x693 0x2e81 0x993b 0x655 0x2fb2 0x98af 0x61b 0x30e3 0x9837 0x5c3 0x3215 0x97d7 0x5bd 0x3346 0x9783 0x5af 0x3477 0x9732 0x56e 0x35a8 0x96f1 0x55f 0x36da 0x96bc 0x55f 0x380b 0x9688 0x549 0x393c 0x964c 0x52f 0x3a6d 0x9621 0x52d 0x3b9f 0x95ef 0x545 0x3cd0 0x95bc 0x52e 0x3e01 0x9593 0x545 0x3f32 0x956a 0x52d 0x4064 0x9542 0x52d 0x4195 0x9519 0x515 0x42c6 0x94fb 0x548 0x43f7 0x94dc 0x576 0x4529 0x94bc 0x55f 0x465a 0x948b 0x55f 0x478b 0x946e 0x562 0x48bc 0x9459 0x57b 0x49ee 0x9445 0x595 0x4b1f 0x942f 0x5ae 0x4c50 0x9412 0x5c3 0x4d81 0x93fc 0x5be 0x4eb3 0x93e0 0x5b5 0x4fe4 0x93c9 0x5dc 0x5115 0x93a8 0x5c9 0x5246 0x937f 0x591 0x5378 0x9356 0x58a 0x54a9 0x9334 0x580 0x55da 0x9319 0x589 0x570b 0x92ed 0x578 0x583d 0x92be 0x566 0x596e 0x9299 0x546 0x5a9f 0x9276 0x53c 0x5bd0 0x9251 0x538 0x5d02 0x9237 0x552 0x5e33 0x9214 0x55f 0x5f64 0x91e1 0x56c 0x6095 0x91a4 0x551 0x61c7 0x9167 0x53a 0x62f8 0x9134 0x554 0x6429 0x90fc 0x56d 0x655a 0x90ad 0x55b 0x668c 0x9064 0x555 0x67bd 0x9046 0x55f 0x68ee 0x903c 0x56f 0x6a1f 0x9031 0x599 0x6b51 0x9027 0x5aa 0x6c82 0x900f 0x5de 0x6db3 0x8fdb 0x619 0x6ee4 0x8f14 0x615 0x7016 0x8d80 0x60e 0x7147 0x8b6a 0x65a 0x7278 0x888f 0x6d4 0x73a9 0x8448 0x806 0x74db 0x7bb8 0x2b47 0x760c 0x6d7e 0x19e1>;
		battery0_profile_t2_num = <0x64>;
		battery0_profile_t2_col = <0x03>;
		battery0_profile_t2 = <0x00 0xa816 0x92e 0x131 0xa774 0x930 0x263 0xa6fa 0x9ac 0x394 0xa67f 0x9c4 0x4c5 0xa5fc 0x9c4 0x5f6 0xa583 0x9c6 0x728 0xa51c 0x9da 0x859 0xa4ab 0x9c1 0x98a 0xa434 0x9af 0xabb 0xa3cd 0x9cc 0xbed 0xa35e 0x9ff 0xd1e 0xa2f7 0xa36 0xe4f 0xa287 0xa78 0xf80 0xa219 0xaa3 0x10b2 0xa1b1 0xafc 0x11e3 0xa143 0xb22 0x1314 0xa0d4 0xb0a 0x1445 0xa064 0xae8 0x1577 0xa009 0xaf8 0x16a8 0x9fb4 0xae9 0x17d9 0x9f71 0xb1c 0x190a 0x9f30 0xb4f 0x1a3c 0x9ed4 0xb63 0x1b6d 0x9e48 0xb3e 0x1c9e 0x9d9c 0xb2d 0x1dcf 0x9cf8 0xb2f 0x1f01 0x9c73 0xb3a 0x2032 0x9c03 0xb54 0x2163 0x9ba8 0xb61 0x2294 0x9b62 0xb88 0x23c6 0x9b14 0xb9f 0x24f7 0x9ac9 0xb9f 0x2628 0x9a6f 0xb81 0x2759 0x99ff 0xb5e 0x288b 0x9989 0xb25 0x29bc 0x991b 0xaf9 0x2aed 0x98bc 0xadf 0x2c1e 0x9868 0xac6 0x2d50 0x981d 0xabe 0x2e81 0x97cf 0xaac 0x2fb2 0x9785 0xaca 0x30e3 0x974c 0xa54 0x3215 0x971a 0x9ee 0x3346 0x96d7 0x9f1 0x3477 0x96a0 0xa83 0x35a8 0x9675 0xace 0x36da 0x963c 0x9f0 0x380b 0x9606 0x9c4 0x393c 0x95dc 0x9f1 0x3a6d 0x95b3 0xa52 0x3b9f 0x9581 0xa89 0x3cd0 0x9558 0xaa4 0x3e01 0x9539 0xabd 0x3f32 0x951a 0xb09 0x4064 0x94e8 0xaf1 0x4195 0x94bf 0xb22 0x42c6 0x94aa 0xb22 0x43f7 0x9483 0xb28 0x4529 0x946e 0xb86 0x465a 0x944e 0xb84 0x478b 0x9428 0xb70 0x48bc 0x9413 0xb89 0x49ee 0x93fd 0xba3 0x4b1f 0x93dd 0xbb4 0x4c50 0x93b5 0xb96 0x4d81 0x938e 0xb72 0x4eb3 0x936d 0xb86 0x4fe4 0x9347 0xb4a 0x5115 0x9326 0xa79 0x5246 0x92fd 0xa56 0x5378 0x92d4 0xab1 0x54a9 0x92ac 0xb20 0x55da 0x9283 0xb7d 0x570b 0x9250 0xb58 0x583d 0x9210 0xa7c 0x596e 0x91e1 0xad8 0x5a9f 0x91b0 0xb7c 0x5bd0 0x916a 0xb57 0x5d02 0x911b 0xac0 0x5e33 0x90de 0xb06 0x5f64 0x90ba 0xbb8 0x6095 0x90a0 0xc2a 0x61c7 0x9082 0xc33 0x62f8 0x9074 0xb92 0x6429 0x9063 0xb5b 0x655a 0x9039 0xc0a 0x668c 0x8f9f 0xc85 0x67bd 0x8e48 0xd06 0x68ee 0x8c3a 0xdb8 0x6a1f 0x897c 0xebc 0x6b51 0x8573 0x1053 0x6c82 0x7c66 0x29b0 0x6db3 0x6e32 0x1a45 0x6ee4 0x6e32 0x1a45 0x7016 0x6e32 0x1a45 0x7147 0x6e32 0x1a45 0x7278 0x6e32 0x1a45 0x73a9 0x6e32 0x1a45 0x74db 0x6e32 0x1a45 0x760c 0x6e32 0x1a45>;
		battery0_profile_t3_num = <0x64>;
		battery0_profile_t3_col = <0x03>;
		battery0_profile_t3 = <0x00 0xa6d6 0xed8 0x131 0xa60b 0xeda 0x263 0xa574 0xf40 0x394 0xa4fa 0xfa1 0x4c5 0xa480 0xfbd 0x5f6 0xa407 0xfed 0x728 0xa39f 0x1007 0x859 0xa329 0x1036 0x98a 0xa2cb 0x10fa 0xabb 0xa25b 0x118b 0xbed 0xa1eb 0x11f5 0xd1e 0xa17d 0x124e 0xe4f 0xa117 0x11fc 0xf80 0xa0af 0x1185 0x10b2 0xa044 0x110a 0x11e3 0x9fed 0x116d 0x1314 0x9faa 0x1250 0x1445 0x9f6e 0x1302 0x1577 0x9f0e 0x135f 0x16a8 0x9e89 0x1301 0x17d9 0x9de9 0x1213 0x190a 0x9d34 0x11ee 0x1a3c 0x9c90 0x1288 0x1b6d 0x9c16 0x132c 0x1c9e 0x9ba0 0x1312 0x1dcf 0x9b43 0x123e 0x1f01 0x9af7 0x1202 0x2032 0x9aa6 0x128f 0x2163 0x9a4f 0x12f4 0x2294 0x99e8 0x12fb 0x23c6 0x9984 0x1223 0x24f7 0x9928 0x1177 0x2628 0x98c7 0x118f 0x2759 0x986d 0x11db 0x288b 0x981c 0x1217 0x29bc 0x97d7 0x126b 0x2aed 0x979a 0x126d 0x2c1e 0x975d 0x128f 0x2d50 0x9719 0x1273 0x2e81 0x96d9 0x1161 0x2fb2 0x96a3 0x115a 0x30e3 0x9678 0x1224 0x3215 0x9648 0x12f6 0x3346 0x960d 0x1287 0x3477 0x95e8 0x117f 0x35a8 0x95c1 0x11b0 0x36da 0x9598 0x1244 0x380b 0x956f 0x12e1 0x393c 0x9534 0x131f 0x3a6d 0x951c 0x1352 0x3b9f 0x94eb 0x1282 0x3cd0 0x94d5 0x11e5 0x3e01 0x94b7 0x12a2 0x3f32 0x948e 0x1355 0x4064 0x9470 0x13eb 0x4195 0x9447 0x137e 0x42c6 0x9432 0x1248 0x43f7 0x940b 0x12b9 0x4529 0x9400 0x13c4 0x465a 0x93eb 0x1437 0x478b 0x93cb 0x1405 0x48bc 0x93a5 0x129f 0x49ee 0x938f 0x1335 0x4b1f 0x9373 0x1426 0x4c50 0x935c 0x1459 0x4d81 0x933c 0x147d 0x4eb3 0x9311 0x145e 0x4fe4 0x92e5 0x1449 0x5115 0x92c9 0x145b 0x5246 0x9296 0x13d7 0x5378 0x925e 0x138b 0x54a9 0x9220 0x13ab 0x55da 0x91f4 0x14bb 0x570b 0x91b3 0x1563 0x583d 0x915f 0x1511 0x596e 0x9117 0x145c 0x5a9f 0x90e4 0x1432 0x5bd0 0x90cf 0x145b 0x5d02 0x90b6 0x14a3 0x5e33 0x90a1 0x1553 0x5f64 0x9092 0x1638 0x6095 0x9069 0x172a 0x61c7 0x9006 0x181b 0x62f8 0x8ee7 0x1883 0x6429 0x8d02 0x1920 0x655a 0x8a7c 0x1a9f 0x668c 0x86dc 0x1cd3 0x67bd 0x801b 0x2796 0x68ee 0x7940 0x33db 0x6a1f 0x7940 0x33db 0x6b51 0x7940 0x33db 0x6c82 0x7940 0x33db 0x6db3 0x7940 0x33db 0x6ee4 0x7940 0x33db 0x7016 0x7940 0x33db 0x7147 0x7940 0x33db 0x7278 0x7940 0x33db 0x73a9 0x7940 0x33db 0x74db 0x7940 0x33db 0x760c 0x7940 0x33db>;
		battery0_profile_t4_num = <0x64>;
		battery0_profile_t4_col = <0x03>;
		battery0_profile_t4 = <0x00 0xa4a6 0x28d2 0x131 0xa3b1 0x28d9 0x263 0xa2a9 0x2a4e 0x394 0xa198 0x2ae2 0x4c5 0xa0be 0x2b23 0x5f6 0xa032 0x2c2e 0x728 0x9fc5 0x2db0 0x859 0x9f65 0x2e5d 0x98a 0x9ee7 0x2e2a 0xabb 0x9e4a 0x2df7 0xbed 0x9d92 0x2db7 0xd1e 0x9cdd 0x2d5a 0xe4f 0x9c3b 0x2d62 0xf80 0x9bc3 0x2cd0 0x10b2 0x9b55 0x2c63 0x11e3 0x9af4 0x2c29 0x1314 0x9aa4 0x2c0a 0x1445 0x9a5a 0x2c66 0x1577 0x9a05 0x2ccb 0x16a8 0x99a9 0x2cec 0x17d9 0x994a 0x2ce2 0x190a 0x98e8 0x2ce7 0x1a3c 0x9888 0x2cd1 0x1b6d 0x982b 0x2c7d 0x1c9e 0x97da 0x2c58 0x1dcf 0x9788 0x2bf6 0x1f01 0x9741 0x2b82 0x2032 0x9709 0x2b43 0x2163 0x96d1 0x2b37 0x2294 0x9694 0x2b35 0x23c6 0x965c 0x2b0e 0x24f7 0x9629 0x2aea 0x2628 0x95f6 0x2b47 0x2759 0x95c3 0x2b7f 0x288b 0x9597 0x2ba4 0x29bc 0x956e 0x2bf0 0x2aed 0x9545 0x2bea 0x2c1e 0x9516 0x2bfb 0x2d50 0x94f1 0x2c3f 0x2e81 0x94cb 0x2cb0 0x2fb2 0x94aa 0x2d66 0x30e3 0x9493 0x2e57 0x3215 0x946f 0x2de8 0x3346 0x9456 0x2c7a 0x3477 0x944a 0x2d15 0x35a8 0x942f 0x2da2 0x36da 0x9422 0x2e32 0x380b 0x940e 0x2eb9 0x393c 0x93f1 0x2e9a 0x3a6d 0x93dc 0x2e50 0x3b9f 0x93c7 0x2dbd 0x3cd0 0x93bc 0x2d6c 0x3e01 0x93a8 0x2e76 0x3f32 0x9380 0x2f2a 0x4064 0x9362 0x2fc3 0x4195 0x9343 0x308a 0x42c6 0x931b 0x30c2 0x43f7 0x92fb 0x3153 0x4529 0x92c8 0x3168 0x465a 0x9296 0x3147 0x478b 0x926c 0x3104 0x48bc 0x9239 0x31f2 0x49ee 0x9203 0x33b4 0x4b1f 0x91ba 0x3564 0x4c50 0x916f 0x3757 0x4d81 0x913a 0x380e 0x4eb3 0x90ff 0x3819 0x4fe4 0x90ce 0x38e8 0x5115 0x90a8 0x3bbd 0x5246 0x9082 0x3e96 0x5378 0x9042 0x409d 0x54a9 0x8fee 0x416a 0x55da 0x8f64 0x42e8 0x570b 0x8e68 0x45fb 0x583d 0x8cca 0x4743 0x596e 0x8a75 0x481d 0x5a9f 0x86f8 0x4c23 0x5bd0 0x8172 0x45ef 0x5d02 0x7882 0x3200 0x5e33 0x7882 0x3200 0x5f64 0x7882 0x3200 0x6095 0x7882 0x3200 0x61c7 0x7882 0x3200 0x62f8 0x7882 0x3200 0x6429 0x7882 0x3200 0x655a 0x7882 0x3200 0x668c 0x7882 0x3200 0x67bd 0x7882 0x3200 0x68ee 0x7882 0x3200 0x6a1f 0x7882 0x3200 0x6b51 0x7882 0x3200 0x6c82 0x7882 0x3200 0x6db3 0x7882 0x3200 0x6ee4 0x7882 0x3200 0x7016 0x7882 0x3200 0x7147 0x7882 0x3200 0x7278 0x7882 0x3200 0x73a9 0x7882 0x3200 0x74db 0x7882 0x3200 0x760c 0x7882 0x3200>;
		g_PMIC_MIN_VOL_row = <0x04>;
		g_PMIC_MIN_VOL_col = <0x0a>;
		g_PMIC_MIN_VOL = <0x82dc 0x82dc 0x82dc 0x82dc 0x80e8 0x80e8 0x80e8 0x80e8 0x82dc 0x82dc 0x82dc 0x82dc 0x7dc8 0x7dc8 0x7dc8 0x7dc8 0x7918 0x7918 0x7918 0x7918 0x7b0c 0x7b0c 0x7b0c 0x7b0c 0x7918 0x7918 0x7918 0x7918 0x7918 0x7918 0x7918 0x7918 0x7918 0x7918 0x7918 0x7918 0x7918 0x7918 0x7918 0x79e0>;
		g_PON_SYS_IBOOT_row = <0x04>;
		g_PON_SYS_IBOOT_col = <0x0a>;
		g_PON_SYS_IBOOT = <0x1388 0x1388 0x1388 0x1388 0x1388 0x1388 0x1388 0x1388 0x1388 0x1388 0x1388 0x1388 0x1388 0x1388 0x1388 0x1388 0x1388 0x1388 0x1388 0x1388 0x1388 0x1388 0x1388 0x1388 0x1388 0x1388 0x1388 0x1388 0x1388 0x1388 0x1388 0x1388 0x1388 0x1388 0x1388 0x1388 0x1388 0x1388 0x1388 0x1388>;
		g_QMAX_SYS_VOL_row = <0x04>;
		g_QMAX_SYS_VOL_col = <0x0a>;
		g_QMAX_SYS_VOL = <0x8886 0x8886 0x8886 0x8886 0x8886 0x8886 0x8886 0x8886 0x85ca 0x85ca 0x85ca 0x85ca 0x85ca 0x85ca 0x85ca 0x85ca 0x85ca 0x85ca 0x85ca 0x85ca 0x7ef4 0x7ef4 0x7ef4 0x7ef4 0x8020 0x8020 0x8020 0x8020 0x8020 0x8020 0x8020 0x8020 0x8020 0x8020 0x8020 0x8020 0x8020 0x8020 0x8020 0x8020>;
		g_FG_PSEUDO100_row = <0x04>;
		g_FG_PSEUDO100_col = <0x0a>;
		g_FG_PSEUDO100 = <0x64 0x64 0x64 0x64 0x64 0x64 0x64 0x64 0x64 0x64 0x64 0x64 0x64 0x64 0x64 0x64 0x64 0x64 0x64 0x64 0x64 0x64 0x64 0x64 0x64 0x64 0x64 0x64 0x64 0x64 0x64 0x64 0x64 0x64 0x64 0x64 0x64 0x64 0x64 0x64>;
		phandle = <0x1b9>;
		DISABLE_MTKBATTERY = <0x01>;
		use-ti-gauge;
		charge-full-design-microamp-hours = <0x4c4b40>;
		energy-full-design-microwatt-hours = <0x125bb50>;
		voltage-min-design-microvolt = <0x30d400>;
		voltage-max-design-microvolt = <0x440de0>;
	};
	edma: edma {
		compatible = "mtk,edma";
		sub_nr = <0x02>;
		mediatek,edma-sub = <0x33 0x34>;
		phandle = <0x1c5>;
	};
	ion: iommu {
		compatible = "mediatek,ion";
		iommus = <&iommu0 0xe>;
		phandle = <0x1c6>;
	};
	pseudo_m4u {
		compatible = "mediatek,mt-pseudo_m4u";
		iommus = <&iommu0 0xe>;
	};
	pseudo_m4u-larb0 {
		compatible = "mediatek,mt-pseudo_m4u-port";
		mediatek,larbid = <0x0>;
		iommus = <&iommu0 0x0 &iommu0 0x1 &iommu0 0x2 &iommu0 0x3 &iommu0 0x4 &iommu0 0x5 &iommu0 0x6 &iommu0 0x7 &iommu0 0x8 &iommu0 0x9 &iommu0 0xa &iommu0 0xb &iommu0 0xc &iommu0 0xd &iommu0 0xe>;
	};
	pseudo_m4u-larb1 {
		compatible = "mediatek,mt-pseudo_m4u-port";
		mediatek,larbid = <0x01>;
		iommus = <&iommu0 0x20 &iommu0 0x21 &iommu0 0x22 &iommu0 0x23 &iommu0 0x24 &iommu0 0x25 &iommu0 0x26 &iommu0 0x27 &iommu0 0x28 &iommu0 0x29 &iommu0 0x2a &iommu0 0x2b &iommu0 0x2c &iommu0 0x2d &iommu0 0x2e>;
	};
	pseudo_m4u-larb2 {
		compatible = "mediatek,mt-pseudo_m4u-port";
		mediatek,larbid = <0x02>;
		iommus = <&iommu1 0x40 &iommu1 0x41 &iommu1 0x42 &iommu1 0x43 &iommu1 0x44 &iommu1 0x45>;
	};
	pseudo_m4u-larb3 {
		compatible = "mediatek,mt-pseudo_m4u-port";
		mediatek,larbid = <0x03>;
		iommus = <&iommu1 0x60 &iommu1 0x61 &iommu1 0x62 &iommu1 0x63 &iommu1 0x64 &iommu1 0x65>;
	};
	pseudo_m4u-larb4 {
		compatible = "mediatek,mt-pseudo_m4u-port";
		mediatek,larbid = <0x04>;
		iommus = <&iommu1 0x80 &iommu1 0x81 &iommu1 0x82 &iommu1 0x83 &iommu1 0x84 &iommu1 0x85 &iommu1 0x86 &iommu1 0x87 &iommu1 0x88 &iommu1 0x89 &iommu1 0x8a>;
	};
	pseudo_m4u-larb5 {
		compatible = "mediatek,mt-pseudo_m4u-port";
		mediatek,larbid = <0x05>;
		iommus = <&iommu0 0xa0 &iommu0 0xa1 &iommu0 0xa2 &iommu0 0xa3 &iommu0 0xa4 &iommu0 0xa5 &iommu0 0xa6 &iommu0 0xa7>;
	};
	pseudo_m4u-larb7 {
		compatible = "mediatek,mt-pseudo_m4u-port";
		mediatek,larbid = <0x07>;
		iommus = <&iommu0 0xe0 &iommu0 0xe1 &iommu0 0xe2 &iommu0 0xe3 &iommu0 0xe4 &iommu0 0xe5 &iommu0 0xe6 &iommu0 0xe7 &iommu0 0xe8 &iommu0 0xe9 &iommu0 0xea &iommu0 0xeb &iommu0 0xec &iommu0 0xed &iommu0 0xee &iommu0 0xef &iommu0 0xf0 &iommu0 0xf1 &iommu0 0xf2 &iommu0 0xf3 &iommu0 0xf4 &iommu0 0xf5 &iommu0 0xf6 &iommu0 0xf7 &iommu0 0xf8 &iommu0 0xf9 &iommu0 0xfa>;
	};
	pseudo_m4u-larb8 {
		compatible = "mediatek,mt-pseudo_m4u-port";
		mediatek,larbid = <0x08>;
		iommus = <&iommu1 0x100 &iommu1 0x101 &iommu1 0x102 &iommu1 0x103 &iommu1 0x104 &iommu1 0x105 &iommu1 0x106 &iommu1 0x107 &iommu1 0x108 &iommu1 0x109 &iommu1 0x10a &iommu1 0x10b &iommu1 0x10c &iommu1 0x10d &iommu1 0x10e &iommu1 0x10f &iommu1 0x110 &iommu1 0x111 &iommu1 0x112 &iommu1 0x113 &iommu1 0x114 &iommu1 0x115 &iommu1 0x116 &iommu1 0x117 &iommu1 0x118 &iommu1 0x119 &iommu1 0x11a>;
	};
	pseudo_m4u-larb9 {
		compatible = "mediatek,mt-pseudo_m4u-port";
		mediatek,larbid = <0x09>;
		iommus = <&iommu1 0x120 &iommu1 0x121 &iommu1 0x122 &iommu1 0x123 &iommu1 0x124 &iommu1 0x125 &iommu1 0x126 &iommu1 0x127 &iommu1 0x128 &iommu1 0x129 &iommu1 0x12a &iommu1 0x12b &iommu1 0x12c &iommu1 0x12d &iommu1 0x12e &iommu1 0x12f &iommu1 0x130 &iommu1 0x131 &iommu1 0x132 &iommu1 0x133 &iommu1 0x134 &iommu1 0x135 &iommu1 0x136 &iommu1 0x137 &iommu1 0x138 &iommu1 0x139 &iommu1 0x13a &iommu1 0x13b &iommu1 0x13c>;
	};
	pseudo_m4u-larb11 {
		compatible = "mediatek,mt-pseudo_m4u-port";
		mediatek,larbid = <0x0b>;
		iommus = <&iommu0 0x160 &iommu0 0x161 &iommu0 0x162 &iommu0 0x163 &iommu0 0x164 &iommu0 0x165 &iommu0 0x166 &iommu0 0x167 &iommu0 0x168 &iommu0 0x169 &iommu0 0x16a &iommu0 0x16b &iommu0 0x16c &iommu0 0x16d &iommu0 0x16e &iommu0 0x16f &iommu0 0x170 &iommu0 0x171 &iommu0 0x172 &iommu0 0x173 &iommu0 0x174 &iommu0 0x175 &iommu0 0x176 &iommu0 0x177 &iommu0 0x178 &iommu0 0x179 &iommu0 0x17a &iommu0 0x17b &iommu0 0x17c>;
	};
	pseudo_m4u-larb13 {
		compatible = "mediatek,mt-pseudo_m4u-port";
		mediatek,larbid = <0x0d>;
		iommus = <&iommu1 0x1a0 &iommu1 0x1a1 &iommu1 0x1a2 &iommu1 0x1a3 &iommu1 0x1a4 &iommu1 0x1a5 &iommu1 0x1a6 &iommu1 0x1a7 &iommu1 0x1a8 &iommu1 0x1a9 &iommu1 0x1aa &iommu1 0x1ab>;
	};
	pseudo_m4u-larb14 {
		compatible = "mediatek,mt-pseudo_m4u-port";
		mediatek,larbid = <0x0e>;
		iommus = <&iommu0 0x1c0 &iommu0 0x1c1 &iommu0 0x1c2 &iommu0 0x1c3 &iommu0 0x1c4 &iommu0 0x1c5>;
	};
	pseudo_m4u-larb16 {
		compatible = "mediatek,mt-pseudo_m4u-port";
		mediatek,larbid = <0x10>;
		iommus = <&iommu1 0x200 &iommu1 0x201 &iommu1 0x202 &iommu1 0x203 &iommu1 0x204 &iommu1 0x205 &iommu1 0x206 &iommu1 0x207 &iommu1 0x208 &iommu1 0x209 &iommu1 0x20a &iommu1 0x20b &iommu1 0x20c &iommu1 0x20d &iommu1 0x20e &iommu1 0x20f &iommu1 0x210>;
	};
	pseudo_m4u-larb17 {
		compatible = "mediatek,mt-pseudo_m4u-port";
		mediatek,larbid = <0x11>;
		iommus = <&iommu0 0x220 &iommu0 0x221 &iommu0 0x222 &iommu0 0x223 &iommu0 0x224 &iommu0 0x225 &iommu0 0x226 &iommu0 0x227 &iommu0 0x228 &iommu0 0x229 &iommu0 0x22a &iommu0 0x22b &iommu0 0x22c &iommu0 0x22d &iommu0 0x22e &iommu0 0x22f &iommu0 0x230>;
	};
	pseudo_m4u-larb18 {
		compatible = "mediatek,mt-pseudo_m4u-port";
		mediatek,larbid = <0x12>;
		iommus = <&iommu1 0x240 &iommu1 0x241 &iommu1 0x242 &iommu1 0x243 &iommu1 0x244 &iommu1 0x245 &iommu1 0x246 &iommu1 0x247 &iommu1 0x248 &iommu1 0x249 &iommu1 0x24a &iommu1 0x24b &iommu1 0x24c &iommu1 0x24d &iommu1 0x24e &iommu1 0x24f &iommu1 0x250>;
	};
	pseudo_m4u-larb19 {
		compatible = "mediatek,mt-pseudo_m4u-port";
		mediatek,larbid = <0x13>;
		iommus = <&iommu0 0x260 &iommu0 0x261 &iommu0 0x262 &iommu0 0x263>;
	};
	pseudo_m4u-larb20 {
		compatible = "mediatek,mt-pseudo_m4u-port";
		mediatek,larbid = <0x14>;
		iommus = <&iommu0 0x280 &iommu0 0x281 &iommu0 0x282 &iommu0 0x283 &iommu0 0x284 &iommu0 0x285>;
	};
	pseudo_m4u-ccu-node {
		compatible = "mediatek,mt-pseudo_m4u-port";
		mediatek,larbid = <0x17>;
		iommus = <&iommu1 0x2e0>;
	};
	pseudo_m4u-ccu-larb {
		compatible = "mediatek,mt-pseudo_m4u-port";
		mediatek,larbid = <0x1c>;
		iommus = <&iommu1 0x2c0>;
	};
	pseudo_m4u-vpu-code {
		compatible = "mediatek,mt-pseudo_m4u-port";
		mediatek,larbid = <0x19>;
		iommus = <&iommu2 0x2a0>;
	};
	pseudo_m4u-vpu-data {
		compatible = "mediatek,mt-pseudo_m4u-port";
		mediatek,larbid = <0x1a>;
		iommus = <&iommu3 0x2a1>;
	};
	pseudo_m4u-vpu-vlm {
		compatible = "mediatek,mt-pseudo_m4u-port";
		mediatek,larbid = <0x1b>;
		iommus = <&iommu2 0x2a2>;
	};
	pseudo_m4u-misc-disp {
		compatible = "mediatek,mt_soc_offload_common";
	};
	slbc: slbc {
		compatible = "mediatek,slbc";
		status = "enable";
		phandle = <0x1c9>;
	};
	irtx_pwm: irtx_pwm {
		compatible = "mediatek,irtx-pwm";
		pwm_ch = <0x00>;
		pwm_data_invert = <0x00>;
		phandle = <0x1ca>;
		pinctrl-names = "irtx_gpio_led_default", "irtx_gpio_led_set";
		pinctrl-0 = <0x1e3>;
		pinctrl-1 = <0x1e4>;
		status = "okay";
	};
	mt_charger: mt_charger {
		compatible = "mediatek,mt-charger";
		phandle = <0x1cb>;
	};
	lk_charger: lk_charger {
		compatible = "mediatek,lk_charger";
		enable_anime;
		enable_pd20_reset;
		power_path_support;
		max_charger_voltage = <0xdd40a0>;
		fast_charge_voltage = <0x2dc6c0>;
		usb_charger_current = <0x7a120>;
		ac_charger_current = <0x16e360>;
		ac_charger_input_current = <0x16e360>;
		non_std_ac_charger_current = <0xf4240>;
		charging_host_charger_current = <0x16e360>;
		ta_ac_charger_current = <0x16e360>;
		pd_charger_current = <0x16e360>;
		temp_t4_threshold = <0x3c>;
		temp_t3_threshold = <0x00>;
		temp_t1_threshold = <0xfffffff6>;
		phandle = <0x1cc>;
	};
	charger: charger {
		compatible = "mediatek,charger";
		algorithm_name = "SwitchCharging2";
		enable_type_c;
		power_path_support;
		enable_dynamic_mivr;
		battery_cv = <0x440de0>;
		max_charger_voltage = <0xdd40a0>;
		min_charger_voltage = <0x4630c0>;
		min_charger_voltage_1 = <0x432380>;
		min_charger_voltage_2 = <0x401640>;
		max_dmivr_charger_current = <0x155cc0>;
		usb_charger_current_suspend = <0x00>;
		usb_charger_current_unconfigured = <0x11170>;
		usb_charger_current_configured = <0x7a120>;
		usb_charger_current = <0x7a120>;
		ac_charger_current = <0x1e8480>;
		ac_charger_input_current = <0x16e360>;
		non_std_ac_charger_current = <0xf4240>;
		charging_host_charger_current = <0x16e360>;
		apple_1_0a_charger_current = <0x9eb10>;
		apple_2_1a_charger_current = "", "\f5";
		ta_ac_charger_current = <0x2dc6c0>;
		jeita_temp_above_t4_cv = <0x3e8fa0>;
		jeita_temp_t3_to_t4_cv = <0x3e8fa0>;
		jeita_temp_t2_to_t3_cv = <0x43e6d0>;
		jeita_temp_t1_to_t2_cv = <0x40b280>;
		jeita_temp_t0_to_t1_cv = <0x43e6d0>;
		jeita_temp_below_t0_cv = <0x401640>;
		temp_t4_thres = <0x3c>;
		temp_t4_thres_minus_x_degree = <0x3a>;
		temp_t3_thres = <0x30>;
		temp_t3_thres_minus_x_degree = <0x2f>;
		temp_t2_thres = <0x0f>;
		temp_t2_thres_plus_x_degree = <0x11>;
		temp_t1_thres = <0x05>;
		temp_t1_thres_plus_x_degree = <0x06>;
		temp_t0_thres = <0x00>;
		temp_t0_thres_plus_x_degree = <0x01>;
		temp_neg_10_thres = <0xfffffff6>;
		enable_min_charge_temp;
		min_charge_temp = <0x00>;
		min_charge_temp_plus_x_degree = <0x02>;
		max_charge_temp = <0x3c>;
		max_charge_temp_minus_x_degree = <0x3a>;
		ta_12v_support;
		ta_9v_support;
		pe_ichg_level_threshold = <0xf4240>;
		ta_ac_12v_input_current = <0x30d400>;
		ta_ac_9v_input_current = <0x30d400>;
		ta_ac_7v_input_current = <0x30d400>;
		pe20_ichg_level_threshold = <0xf4240>;
		ta_start_battery_soc = <0x00>;
		ta_stop_battery_soc = <0x55>;
		high_temp_to_leave_pe40 = <0x2e>;
		high_temp_to_enter_pe40 = <0x27>;
		low_temp_to_leave_pe40 = <0x0a>;
		low_temp_to_enter_pe40 = <0x10>;
		pe40_single_charger_input_current = <0x2dc6c0>;
		pe40_single_charger_current = <0x2dc6c0>;
		pe40_dual_charger_input_current = <0x2dc6c0>;
		pe40_dual_charger_chg1_current = <0x1e8480>;
		pe40_dual_charger_chg2_current = <0x1e8480>;
		pe40_stop_battery_soc = <0x50>;
		pe40_r_cable_1a_lower = <0x240>;
		pe40_r_cable_2a_lower = <0x1b3>;
		pe40_r_cable_3a_lower = <0x125>;
		chg1_ta_ac_charger_current = <0x16e360>;
		chg2_ta_ac_charger_current = <0x16e360>;
		slave_mivr_diff = <0x186a0>;
		dual_polling_ieoc = <0xb71b0>;
		cable_imp_threshold = <0x2bb>;
		vbat_cable_imp_threshold = <0x3b8260>;
		bif_threshold1 = <0x40d990>;
		bif_threshold2 = <0x419ce0>;
		bif_cv_under_threshold2 = <0x43e6d0>;
		pd_vbus_low_bound = <0x4c4b40>;
		pd_vbus_upper_bound = <0x895440>;
		pd_ichg_level_threshold = <0xf4240>;
		pd_stop_battery_soc = <0x50>;
		ibus_err = <0x0e>;
		vsys_watt = <0x4c4b40>;
		phandle = <0x1cd>;
		enable_vote;
		enable_cv_step;
		enable_cv_aging;
		step_a = <0x401640>;
		step_b = <0x419ce0>;
		step_c = <0x432380>;
		current_a = <0x885e28>;
		current_b = <0x71a3cc>;
		current_c = <0x5ae970>;
		current_max = <0xbd3580>;
		step_hy_down_a = <0x249f0>;
		step_hy_down_b = <0x249f0>;
		step_hy_down_c = <0x249f0>;
		step_a_aging = <0x3f52f0>;
		step_b_aging = <0x419ce0>;
		step_c_aging = <0x432380>;
		current_step_aging = <0x30d40>;
		current_max_aging = <0xbd3580>;
		enable_ffc;
		non_ffc_ieoc = <0x249f0>;
		non_ffc_cv = <0x43e6d0>;
		ffc_ieoc = <0xaae60>;
		ffc_ieoc_b = <0xcf850>;
		ffc_cv = <0x448310>;
		enable_sw_jeita;
		jeita_temp_t1p5_to_t2_cv = <0x43e6d0>;
		jeita_temp_t1_to_t1p5_cv = <0x43e6d0>;
		jeita_temp_tn1_to_t0_cv_a = <0x401640>;
		jeita_temp_tn1_to_t0_cv_b = <0x43e6d0>;
		temp_t1p5_thres = <0x0a>;
		temp_t1p5_thres_plus_x_degree = <0x0b>;
		temp_tn1_thres = <0xfffffff6>;
		temp_tn1_thres_plus_x_degree = <0xfffffff7>;
		temp_t3_to_t4_fcc = <0x2625a0>;
		temp_t2_to_t3_fcc = <0xbd3580>;
		temp_t1p5_to_t2_fcc = <0x5ae970>;
		temp_t1_to_t1p5_fcc = <0x35082c>;
		temp_t0_to_t1_fcc = <0x2625a0>;
		temp_tn1_to_t0_fcc_a = <0xf4240>;
		temp_tn1_to_t0_fcc_b = <0xb5d2e>;
		qcom,thermal-mitigation-dcp = <0x186a00 0x186a00 0x186a00 0x186a00 0x186a00 0x186a00 0x186a00 0x186a00 0x186a00 0x186a00 0x186a00 0x186a00 0x16e360 0x155cc0 0x124f80 0xf4240>;
		qcom,thermal-mitigation-qc3p5 = <0x44aa20 0x401640 0x3d0900 0x39fbc0 0x36ee80 0x33e140 0x30d400 0x2f4d60 0x2dc6c0 0x2ab980 0x27ac40 0x249f00 0x2191c0 0x1e8480 0xf4240 0xaae60>;
		qcom,thermal-mitigation-qc3 = <0x3567e0 0x3567e0 0x3567e0 0x33e140 0x325aa0 0x325aa0 0x30d400 0x2f4d60 0x2dc6c0 0x2ab980 0x27ac40 0x249f00 0x2191c0 0x1e8480 0xf4240 0xaae60>;
		qcom,thermal-mitigation-qc3-classb = <0x5265c0 0x4dd1e0 0x47b760 0x419ce0 0x3d0900 0x36ee80 0x33e140 0x33e140 0x33e140 0x30d400 0x2625a0 0x2191c0 0x1e8480 0x13d620 0xf4240 0xaae60>;
		qcom,thermal-mitigation-qc2 = <0x16e360 0x16e360 0x16e360 0x16e360 0x16e360 0x16e360 0x155cc0 0x13d620 0x124f80 0x10c8e0 0xf4240 0xdbba0 0xc3500 0xaae60 0x927c0 0x7a120>;
		qcom,thermal-mitigation-pd-base = <0xbd3580 0xa7d8c0 0x989680 0x7a1200 0x6acfc0 0x5b8d80 0x53ec60 0x4c4b40 0x401640 0x2dc6c0 0x2625a0 0x16e360 0xf4240 0xc3500 0x7a120 0x186a0>;
		bc12_charger = <0x01>;
		xm_pps_single_charger_input_current = <0x2dc6c0>;
		xm_pps_single_charger_current = <0x5b8d80>;
		xm_pps_dual_charger_input_current = <0x2dc6c0>;
		xm_pps_dual_charger_chg1_current = <0x7a120>;
		xm_pps_dual_charger_chg2_current = <0x2625a0>;
		xm_pps_max_vbus = <0xb71b00>;
		xm_pps_max_ibus = <0x2dc6c0>;
		xm_pps_single_charger_current_non_verified_pps = "", "I>";
		use_xmusb350_do_apsd;
	};
	pd_adapter: pd_adapter {
		compatible = "mediatek,pd_adapter";
		adapter_name = "pd_adapter";
		phandle = <0x1ce>;
	};
	rt-pd-manager {
		compatible = "mediatek,rt-pd-manager";
	};
	xiaomi_touch: xiaomi_touch {
		compatible = "xiaomi-touch";
		status = "ok";
		touch,name = "xiaomi-touch";
		phandle = <0x1cf>;
	};
	subpmic_pmu_eint: mt6360_pmu_eint {
		phandle = <0x1d0>;
		interrupt-parent = <&pio>;
		interrupts = <0x18 0x02 0x18 0x00>;
		status = "okay";
	};
	cp_qc30: cp_qc30 {
		phandle = <0x1d1>;
		compatible = "xiaomi,cp-qc30";
		status = "okay";
		mi,qc3-bat-volt-max = <0x1180>;
		mi,qc3-bat-curr-max = <0xe10>;
		mi,qc3-bus-volt-max = <0x2ee0>;
		mi,qc3-bus-curr-max = <0x834>;
		mi,qc3-non-ffc-bat-volt-max = <0x1162>;
		mi,qc3-27w-bat-curr-max = <0x1518>;
		mi,qc3-27w-bus-curr-max = <0x992>;
		mi,qc3p-bat-curr-max = <0x1194>;
		mi,qc3p-bus-curr-max = <0x8fc>;
		mi,cp-sec-enable;
	};
	usbpd_pm: usbpd_pm {
		phandle = <0x1d2>;
		compatible = "xiaomi,usbpd-pm";
		status = "okay";
		mi,pd-bat-volt-max = <0x1180>;
		mi,pd-bat-curr-max = <0x3070>;
		mi,pd-bus-volt-max = <0x2ee0>;
		mi,pd-bus-curr-max = <0x1838>;
		mi,pd-non-ffc-bat-volt-max = <0x1162>;
		mi,cp-sec-enable;
		mi,pd-power-max = <0x43>;
		mi,cp-master-disable-fisrt;
	};
	pmic_clock_buffer_ctrl: pmic_clock_buffer_ctrl {
		compatible = "mediatek,pmic_clock_buffer";
		mediatek,clkbuf-quantity = <0x07>;
		mediatek,clkbuf-config = <0x02 0x01 0x01 0x02 0x00 0x00 0x01>;
		mediatek,clkbuf-output-impedance = <0x03 0x04 0x03 0x04 0x00 0x00 0x03>;
		mediatek,clkbuf-controls-for-desense = <0x00 0x04 0x00 0x04 0x00 0x00 0x00>;
		phandle = <0x1d3>;
		status = "okay";
	};
	mrdump_ext_rst: mrdump_ext_rst {
		compatible = "mediatek, mrdump_ext_rst-eint";
		mode = "IRQ";
		status = "okay";
		phandle = <0x1d4>;
		interrupt-parent = <&pio>;
		interrupts = <0x06 0x08 0x06 0x00>;
		deb-gpios = <&pio 0x6 0x0>;
		debounce = <0x7d000>;
	};
	touch: touch {
		compatible = "mediatek,touch";
		phandle = <0x1d5>;
		interrupt-parent = <&pio>;
		interrupts = <0x15 0x02 0x15 0x00>;
		status = "okay";
		vtouch-supply = <&mt_pmic_vtp_ldo_reg>;
	};
	gamekey: gamekey {
		compatible = "xm,gamekey";
		phandle = <0x1d6>;
	};
	tcpc_pd: tcpc_pd {
		phandle = <0x1d7>;
		interrupt-parent = <&pio>;
		interrupts = <0x19 0x02 0x19 0x00>;
		status = "okay";
	};
	nfc: nfc {
		compatible = "mediatek,nfc-gpio-v2";
		reg = <0x08>;
		gpio-rst = <0x0a>;
		gpio-rst-std = <0x02 0x0a 0x00>;
		gpio-irq = <0x0b>;
		gpio-irq-std = <0x02 0x0b 0x00>;
		phandle = <0x1d8>;
	};
	irq_nfc: irq_nfc {
		compatible = "mediatek,irq_nfc-eint";
		reg = <0x08>;
		phandle = <0x1d9>;
		interrupt-parent = <&pio>;
		interrupts = <0x0b 0x04 0x0b 0x00>;
		status = "okay";
	};
	smart_pa: smart_pa {
		phandle = <0x1da>;
		interrupt-parent = <&pio>;
		interrupts = <0x1f 0x08 0x1f 0x00>;
		status = "okay";
	};
	md1_sim1_hot_plug_eint: md1_sim1_hot_plug_eint {
		phandle = <0x1db>;
		compatible = "mediatek,md1_sim1_hot_plug_eint-eint";
		interrupts = <0x00 0x08>;
		debounce = <0x0 0xc350>;
		dedicated = <0x0 0x0>;
		src_pin = <0x00 0x01>;
		sockettype = <0x0 0x0>;
		status = "okay";
	};
	md1_sim2_hot_plug_eint: md1_sim2_hot_plug_eint {
		phandle = <0x1dc>;
	};
	ptp3: ptp3 {
		compatible = "mediatek,ptp3";
		brisket2_InitPath = <0x10>;
		cttBitEn = <0x0f>;
		cttImax_0 = <0x1ffe>;
		cttImax_1 = <0x1ffe>;
		cttImax_2 = <0x1ffe>;
		cttImax_3 = <0x1ffe>;
		cttTmax_0 = <0xff>;
		cttTmax_1 = <0xff>;
		cttTmax_2 = <0xff>;
		cttTmax_3 = <0xff>;
		cttImaxDelta_0 = <0xc8>;
		cttImaxDelta_1 = <0xc8>;
		cttImaxDelta_2 = <0xc8>;
		cttImaxDelta_3 = <0xc8>;
		cttTmaxDelta_0 = <0x0a>;
		cttTmaxDelta_1 = <0x0a>;
		cttTmaxDelta_2 = <0x0a>;
		cttTmaxDelta_3 = <0x0a>;
		drcc_state = <0x00>;
		drcc0_Vref = <0xff>;
		drcc1_Vref = <0xff>;
		drcc2_Vref = <0xff>;
		drcc3_Vref = <0xff>;
		drcc4_Vref = <0xff>;
		drcc5_Vref = <0xff>;
		drcc6_Vref = <0xff>;
		drcc7_Vref = <0xff>;
		drcc0_Code = <0xff>;
		drcc1_Code = <0xff>;
		drcc2_Code = <0xff>;
		drcc3_Code = <0xff>;
		drcc4_Code = <0xff>;
		drcc5_Code = <0xff>;
		drcc6_Code = <0xff>;
		drcc7_Code = <0xff>;
		drcc4_EdgeSel = <0xff>;
		drcc5_EdgeSel = <0xff>;
		drcc6_EdgeSel = <0xff>;
		drcc7_EdgeSel = <0xff>;
		pdp_state = <0xf2>;
		pdp_state_pinctl = <0x00>;
		dt_state = <0xf1>;
		dt_state_pinctl = <0x00>;
		cinst_doe_init = <0x00>;
		cinst_doe_ls_enable = <0xf0>;
		cinst_doe_ls_period = <0xff>;
		cinst_doe_ls_credit = <0xff>;
		cinst_doe_vx_enable = <0xf0>;
		cinst_doe_vx_period = <0xff>;
		cinst_doe_vx_credit = <0xff>;
		cinst_doe_ls_low_en = <0x00>;
		cinst_doe_ls_low_period = <0xff>;
		cinst_doe_vx_low_en = <0x00>;
		cinst_doe_vx_low_period = <0xff>;
		cinst_doe_ls_const_en = <0x00>;
		cinst_doe_vx_const_en = <0x00>;
		igBitEn = <0xf0>;
		lreBitEn = <0xf0>;
		phandle = <0x1dd>;
	};
	ssusb_ip_sleep: ssusb_ip_sleep {
		compatible = "mediatek,usb_ipsleep";
		interrupt-parent = <&pio>;
		interrupts = <0xdb 0x08 0xdf 0x00>;
		phandle = <0x1de>;
	};
	mt6360_typec: type_c_port0 {
		mt-dual,supported_modes = <0x00>;
		mt-tcpc,name = "type_c_port0";
		mt-tcpc,role_def = <0x04>;
		mt-tcpc,rp_level = <0x01>;
		mt-tcpc,vconn_supply = <0x01>;
		mt-tcpc,notifier_supply_num = <0x03>;
		mt6360pd,intr_gpio = <0x02 0x19 0x00>;
		mt6360pd,intr_gpio_num = <0x19>;
		mt6360pd,pcb_gpio = <0x02 0x10 0x00>;
		mt6360pd,pcb_gpio_num = <0x10>;
		mt6360pd,pcb_gpio_polarity = <0x00>;
		interrupt-parent = <&mt6360_pmu>;
		interrupts = <0x40 0x00>;
		interrupt-names = "usbid_evt";
		phandle = <0x1df>;

		pd-data {
			pd,vid = <0x29cf>;
			pd,pid = <0x6360>;
			pd,source-cap-ext = <0x636029cf 0x0 0x0 0x0 0x0 0x7000000>;
			pd,mfrs = "RichtekTCPC";
			pd,charging_policy = <0x31>;
			pd,source-pdo-size = <0x01>;
			pd,source-pdo-data = <0x19096>;
			pd,sink-pdo-size = <0x01>;
			pd,sink-pdo-data = <0x190c8>;
			pd,id-vdo-size = <0x06>;
			pd,id-vdo-data = <0xd54029cf 0x0 0x63600000 0x41800000 0x0 0x21800000>;
			bat,nr = <0x01>;

			bat-info0 {
				bat,vid = <0x29cf>;
				bat,pid = <0x6360>;
				bat,mfrs = "bat1";
				bat,design_cap = <0xbb8>;
			};
		};

		dpm_caps {
			local_dr_power;
			local_dr_data;
			local_usb_comm;
			local_no_suspend;
			local_vconn_supply;
			attemp_enter_dp_mode;
			attemp_discover_cable;
			attemp_discover_id;
			pr_check = <0x00>;
			dr_check = <0x00>;
		};

		displayport {
			1st_connection = "dfp_d";
			2nd_connection = "dfp_d";
			signal,dp_v13;
			typec,receptacle;

			ufp_d {
			};

			dfp_d {
				pin_assignment,mode_c;
				pin_assignment,mode_d;
				pin_assignment,mode_e;
			};
		};
	};
	trusty {
		compatible = "android,trusty-smc-v1";
		ranges;
		#address-cells = <0x02>;
		#size-cells = <0x02>;
		tee-id = <0x0>;
		tee-name = "trusty";

		mtee {
			compatible = "mediatek,trusty-mtee-v1";
		};

		gz-main {
			compatible = "mediatek,trusty-gz";
		};

		trusty-irq {
			compatible = "android,trusty-irq-v1";
			ppi-interrupt-parent = <0x01>;
		};

		trusty-virtio {
			compatible = "android,trusty-virtio-v1";
		};

		trusty-gz-log {
			compatible = "android,trusty-gz-log-v1";
		};
	};
	nebula {
		compatible = "android,nebula-smc-v1";
		ranges;
		#address-cells = <0x02>;
		#size-cells = <0x02>;
		tee-id = <0x01>;
		tee-name = "nebula";

		nebula-virtio {
			compatible = "android,nebula-virtio-v1";
		};

		nebula-irq {
			compatible = "android,nebula-irq-v1";
			ppi-interrupt-parent = <0x01>;
		};

		nebula-gz-log {
			compatible = "android,nebula-gz-log-v1";
		};
	};
	ufs_fixed_vcc: regulator-ufs-vcc {
		compatible = "regulator-fixed";
		regulator-name = "vreg_ufs_vcc";
		regulator-min-microvolt = <0x2dc6c0>;
		regulator-max-microvolt = <0x2dc6c0>;
		regulator-always-on;
		regulator-boot-on;
		phandle = <0x52>;
	};
	sound: sound {
		compatible = "mediatek,mt6893-mt6359";
		model = "mt6893_mt6359";
		mediatek,platform = <0x282>;
		pinctrl-names = "default", "aud_clk_mosi_off", "aud_clk_mosi_on", "aud_dat_mosi_off", "aud_dat_mosi_on", "aud_dat_miso_off", "aud_dat_miso_on", "aud_gpio_i2s3_off", "aud_gpio_i2s3_on";
		pinctrl-0 = <0xdc>;
		pinctrl-1 = <0xc7>;
		pinctrl-2 = <0xc8>;
		pinctrl-3 = <0xc9>;
		pinctrl-4 = <0xca>;
		pinctrl-5 = <0xcb>;
		pinctrl-6 = <0xcc>;
		pinctrl-7 = <0xdb>;
		pinctrl-8 = <0xdc>;
		phandle = <0x289>;

		speaker-codecs {
			sound-dai = <0x261 0x262>;
		};
	};
	chopin_battery_gauge {
		status = "disabled";
		compatible = "chopin,adc-battery";
		io-channels = <0x283 0x04>;
		io-channel-names = "vbat";
		power-supplies = <0x284>;
		monitored-battery = <0x1b9>;
	};
	vusb33: regulator-vusb33 {
		compatible = "regulator-fixed";
		regulator-name = "vusb33";
		regulator-min-microvolt = <0x325aa0>;
		regulator-max-microvolt = <0x325aa0>;
		regulator-always-on;
		phandle = <0x286>;
	};
	tphy: t-phy@11e40000 {
		compatible = "mediatek,mt6785-tphy", "mediatek,generic-tphy-v2";
		#address-cells = <0x01>;
		#size-cells = <0x01>;
		ranges = <0x0 0x0 0x11e40000 0x1000>;
		status = "okay";
		phandle = <0x28b>;

		u2port: usb-phy@0 {
			reg = <0x0 0x1000>;
			clocks = <&clk26m>;
			clock-names = "ref";
			#phy-cells = <0x01>;
			mediatek,eye-vrt = <0x04>;
			mediatek,eye-term = <0x04>;
			mediatek,intr = <0x1e>;
			mediatek,discth = <0x07>;
			mediatek,force-session-valid;
			status = "okay";
			phandle = <0x285>;
		};
	};
	sensor_hub: sensor-hub {
		compatible = "mediatek,scp-sensorhub";
		mount-matrix = "-1", "0", "0", "0", "-1", "0", "0", "0", "1";
		phandle = <0x28c>;
	};
	scp_start: scp-start {
		compatible = "mediatek,scp-chopin-start";
		phandle = <0x28d>;
	};
};

/* pin states, moved out of the SoC gpio node */
&gpio {

};

/* pin states, moved out of the SoC pinctrl node */
&pio {
		pinctrl_state_mode_idle: pinctrl_state_mode_idle {
			phandle = <0xb3>;

			pins_cmd0_dat {
				pinmux = <0x2500>;
				input-enable;
				bias-pull-down;
			};

			pins_cmd1_dat {
				pinmux = <0x2700>;
				input-enable;
				bias-pull-down;
			};
		};

		pinctrl_state_mode_spi: pinctrl_state_mode_spi {
			phandle = <0xb4>;

			pins_cmd0_dat {
				pinmux = <0x2501>;
				bias-disable;
			};

			pins_cmd1_dat {
				pinmux = <0x2701>;
				bias-disable;
			};
		};

		aud_clk_mosi_off: aud_clk_mosi_off {
			phandle = <0xc7>;

			pins_cmd0_dat {
				pinmux = <0xd600>;
				input-enable;
				bias-pull-down;
			};

			pins_cmd1_dat {
				pinmux = <0xd700>;
				input-enable;
				bias-pull-down;
			};
		};

		aud_clk_mosi_on: aud_clk_mosi_on {
			phandle = <0xc8>;

			pins_cmd0_dat {
				pinmux = <0xd601>;
				input-schmitt-enable;
				bias-disable;
			};

			pins_cmd1_dat {
				pinmux = <0xd701>;
				input-schmitt-enable;
				bias-disable;
			};
		};

		aud_dat_mosi_off: aud_dat_mosi_off {
			phandle = <0xc9>;

			pins_cmd1_dat {
				pinmux = <0xd800>;
				input-enable;
				bias-pull-down;
			};

			pins_cmd2_dat {
				pinmux = <0xd900>;
				input-enable;
				bias-pull-down;
			};
		};

		aud_dat_mosi_on: aud_dat_mosi_on {
			phandle = <0xca>;

			pins_cmd1_dat {
				pinmux = <0xd801>;
				input-schmitt-enable;
				bias-disable;
			};

			pins_cmd2_dat {
				pinmux = <0xd901>;
				input-schmitt-enable;
				bias-disable;
			};
		};

		aud_dat_mosi_ch34_off: aud_dat_mosi_ch34_off {
			phandle = <0xe7>;

			pins_cmd1_dat {
				pinmux = <0xc400>;
				input-enable;
				bias-pull-down;
			};
		};

		aud_dat_mosi_ch34_on: aud_dat_mosi_ch34_on {
			phandle = <0xe8>;

			pins_cmd1_dat {
				pinmux = <0xc401>;
				input-schmitt-enable;
				bias-disable;
			};
		};

		aud_dat_miso_off: aud_dat_miso_off {
			phandle = <0xcb>;

			pins_cmd1_dat {
				pinmux = <0xda00>;
				input-enable;
				bias-pull-down;
			};

			pins_cmd2_dat {
				pinmux = <0xdb00>;
				input-enable;
				bias-disable;
			};
		};

		aud_dat_miso_on: aud_dat_miso_on {
			phandle = <0xcc>;

			pins_cmd1_dat {
				pinmux = <0xda01>;
				input-schmitt-enable;
				bias-disable;
			};

			pins_cmd2_dat {
				pinmux = <0xdb01>;
				input-schmitt-enable;
				bias-disable;
			};
		};

		aud_dat_miso_ch34_off: aud_dat_miso_ch34_off {
			phandle = <0xe9>;

			pins_cmd1_dat {
				pinmux = <0xc700>;
				input-enable;
				bias-pull-down;
			};
		};

		aud_dat_miso_ch34_on: aud_dat_miso_ch34_on {
			phandle = <0xea>;

			pins_cmd1_dat {
				pinmux = <0xc701>;
				input-schmitt-enable;
				bias-disable;
			};
		};

		vow_dat_miso_off: vow_dat_miso_off {
			phandle = <0xcd>;

			pins_cmd1_dat {
				pinmux = <0xda00>;
				input-enable;
				bias-pull-down;
			};
		};

		vow_dat_miso_on: vow_dat_miso_on {
			phandle = <0xce>;

			pins_cmd1_dat {
				pinmux = <0xda02>;
				input-schmitt-enable;
				bias-disable;
			};
		};

		vow_clk_miso_off: vow_clk_miso_off {
			phandle = <0xcf>;

			pins_cmd3_dat {
				pinmux = <0xdb00>;
				input-enable;
				bias-pull-down;
			};
		};

		vow_clk_miso_on: vow_clk_miso_on {
			phandle = <0xd0>;

			pins_cmd1_dat {
				pinmux = <0xdb02>;
				input-schmitt-enable;
				bias-disable;
			};
		};

		aud_nle_mosi_off: aud_nle_mosi_off {
			phandle = <0xd1>;

			pins_cmd1_dat {
				pinmux = <0xc500>;
				input-enable;
				bias-pull-down;
			};

			pins_cmd2_dat {
				pinmux = <0xc600>;
				input-enable;
				bias-pull-down;
			};
		};

		aud_nle_mosi_on: aud_nle_mosi_on {
			phandle = <0xd2>;

			pins_cmd1_dat {
				pinmux = <0xc501>;
				input-schmitt-enable;
				bias-disable;
			};

			pins_cmd2_dat {
				pinmux = <0xc601>;
				input-schmitt-enable;
				bias-disable;
			};
		};

		aud_dat_miso2_off: aud_dat_miso2_off {
			phandle = <0xd3>;

			pins_cmd1_dat {
				pinmux = <0xc700>;
				input-enable;
				bias-pull-down;
			};
		};

		aud_dat_miso2_on: aud_dat_miso2_on {
			phandle = <0xd4>;

			pins_cmd1_dat {
				pinmux = <0xc701>;
				input-schmitt-enable;
				bias-disable;
			};
		};

		aud_gpio_i2s0_off: aud_gpio_i2s0_off {
			phandle = <0xd5>;

			pins_cmd1_dat {
				pinmux = <0x2200>;
				input-enable;
				bias-pull-down;
			};
		};

		aud_gpio_i2s0_on: aud_gpio_i2s0_on {
			phandle = <0xd6>;

			pins_cmd1_dat {
				pinmux = <0x2201>;
				input-schmitt-enable;
				bias-disable;
			};
		};

		aud_gpio_i2s1_off: aud_gpio_i2s1_off {
			phandle = <0xd7>;
		};

		aud_gpio_i2s1_on: aud_gpio_i2s1_on {
			phandle = <0xd8>;
		};

		aud_gpio_i2s2_off: aud_gpio_i2s2_off {
			phandle = <0xd9>;
		};

		aud_gpio_i2s2_on: aud_gpio_i2s2_on {
			phandle = <0xda>;
		};

		aud_gpio_i2s3_off: aud_gpio_i2s3_off {
			phandle = <0xdb>;

			pins_cmd1_dat {
				pinmux = <0x2000>;
				input-enable;
				bias-pull-down;
			};

			pins_cmd2_dat {
				pinmux = <0x2100>;
				input-enable;
				bias-pull-down;
			};

			pins_cmd3_dat {
				pinmux = <0x2300>;
				input-enable;
				bias-pull-down;
			};
		};

		aud_gpio_i2s3_on: aud_gpio_i2s3_on {
			phandle = <0xdc>;

			pins_cmd1_dat {
				pinmux = <0x2001>;
				input-schmitt-enable;
				bias-disable;
			};

			pins_cmd2_dat {
				pinmux = <0x2101>;
				input-schmitt-enable;
				bias-disable;
			};

			pins_cmd3_dat {
				pinmux = <0x2301>;
				input-schmitt-enable;
				bias-disable;
			};
		};

		aud_gpio_i2s5_off: aud_gpio_i2s5_off {
			phandle = <0xdd>;
		};

		aud_gpio_i2s5_on: aud_gpio_i2s5_on {
			phandle = <0xde>;
		};

		aud_gpio_i2s6_off: aud_gpio_i2s6_off {
			phandle = <0xdf>;
		};

		aud_gpio_i2s6_on: aud_gpio_i2s6_on {
			phandle = <0xe0>;
		};

		aud_gpio_i2s7_off: aud_gpio_i2s7_off {
			phandle = <0xe1>;
		};

		aud_gpio_i2s7_on: aud_gpio_i2s7_on {
			phandle = <0xe2>;
		};

		aud_gpio_i2s8_off: aud_gpio_i2s8_off {
			phandle = <0xe3>;
		};

		aud_gpio_i2s8_on: aud_gpio_i2s8_on {
			phandle = <0xe4>;
		};

		aud_gpio_i2s9_off: aud_gpio_i2s9_off {
			phandle = <0xe5>;
		};

		aud_gpio_i2s9_on: aud_gpio_i2s9_on {
			phandle = <0xe6>;
		};

		nfc_default: nfc_default {
			phandle = <0xff>;
		};

		nfc_int_active: nfc_int_active {
			phandle = <0x100>;

			pins_cmd_dat {
				pinmux = <0xb00>;
				slew-rate = <0x0>;
				drive-strength = <0x02>;
				bias-pull-up;
			};
		};

		nfc_int_suspend: nfc_int_suspend {
			phandle = <0x101>;

			pins_cmd_dat {
				pinmux = <0xb00>;
				slew-rate = <0x0>;
				drive-strength = <0x02>;
				bias-pull-up;
			};
		};

		nfc_enable_active: nfc_enable_active {
			phandle = <0x102>;

			pins_cmd_dat {
				pinmux = <0xa00>;
				slew-rate = <0x01>;
				output-high;
				drive-strength = <0x02>;
				bias-pull-up = <0x67>;
			};
		};

		nfc_enable_suspend: nfc_enable_suspend {
			phandle = <0x103>;

			pins_cmd_dat {
				pinmux = <0xa00>;
				slew-rate = <0x01>;
				drive-strength = <0x02>;
				bias-disable;
			};
		};
};


/* devices on the SoC i2c buses */
&i2c0 {
		bq2597x-slave@66 {
			compatible = "ti,bq2597x-slave";
			reg = <0x66>;
			interrupt-parent = <&pio>;
			interrupts = <0x10 0x02 0x10 0x00>;
			pinctrl-names = "bq2597x_slave_irq";
			pinctrl-0 = <0x23c 0x23d>;
			charger_name = "quaternary_chg";
			ti,bq2597x,bat-ucp-alarm-disable;
			ti,bq2597x,bat-ucp-disable;
			ti,bq2597x,bat-therm-disable;
			ti,bq2597x,bus-therm-disable;
			ti,bq2597x,die-therm-disable;
			ti,bq2597x,bat-ovp-threshold = <0x122a>;
			ti,bq2597x,bat-ovp-alarm-threshold = <0x1211>;
			ti,bq2597x,bat-ocp-threshold = <0x1b58>;
			ti,bq2597x,bat-ocp-alarm-threshold = <0x1770>;
			ti,bq2597x,bus-ovp-threshold = <0x2ee0>;
			ti,bq2597x,bus-ovp-alarm-threshold = <0x2af8>;
			ti,bq2597x,bus-ocp-threshold = <0xea6>;
			ti,bq2597x,bus-ocp-alarm-threshold = <0xdac>;
			ti,bq2597x,bat-therm-threshold = <0x15>;
			ti,bq2597x,bus-therm-threshold = <0x15>;
			ti,bq2597x,die-therm-threshold = <0x91>;
			ti,bq2597x,ac-ovp-threshold = <0x0e>;
			sc8551,ac-ovp-threshold = <0x0d>;
			sc8551,bypass-enable;
			sc8551a,dual-stdalone-scheme;
		};

		bq27z561@55 {
			compatible = "ti,bq27z561";
			reg = <0x55>;
			bq,ignore-digest-debug;
			bq,charge-full-design = <0x4c4b40>;
			bq,recharge-voltage = <0x111c>;
			bq,shutdown-delay-enable;
			bq,soc_decimal_rate = <0x00 0x26 0x0a 0x23 0x14 0x21 0x1e 0x21 0x28 0x21 0x32 0x21 0x3c 0x21 0x46 0x1e 0x50 0x19 0x5a 0x14 0x5f 0x0a>;
			bq,cold_thermal_seq = <0x01 0x00 0x64 0x6a4 0x02 0xfffffed4 0x00 0x3e8>;
			monitored-battery = <0x1b9>;
		};

		xmusb350-charger@35 {
			compatible = "xm,xmusb350-charger";
			reg = <0x35>;
			interrupt-parent = <&pio>;
			interrupts = <0x6e 0x02 0x6e 0x00>;
			pinctrl-names = "xmusb350_normal", "xmusb350_isp";
			pinctrl-0 = <0x23e 0x23f 0x240>;
			pinctrl-1 = <0x241 0x242 0x243>;
			xm,xmusb350_rst_gpio = <0x02 0x1c 0x00>;
			xm,xmusb350_sda_gpio = <0x02 0xcd 0x00>;
			xm,xmusb350_scl_gpio = <0x02 0xcc 0x00>;
			mi,connect_therm = <0x02 0x1d 0x00>;
			charger_name = "secondary_chg";
			alias_name = "xmusb350";
			en_bc12;
			en_hvdcp;
			en_intb;
			en_sleep;
		};
};

&i2c2 {
		camera_eeprom0@51 {
			compatible = "mediatek,camera_eeprom";
			reg = <0x51>;
			status = "okay";
			phandle = <0x263>;
		};

		camera_main@10 {
			compatible = "mediatek,camera_main";
			reg = <0x10>;
			status = "okay";
			phandle = <0x268>;
		};

		camera_main_eeprom@51 {
			compatible = "mediatek,camera_main_eeprom";
			reg = <0x51>;
			status = "okay";
			phandle = <0x269>;
		};

		camera_main_af@0c {
			compatible = "mediatek,camera_main_af";
			reg = <0x0c>;
			status = "okay";
			phandle = <0x26a>;
		};
};

&i2c4 {
		camera_eeprom1@51 {
			compatible = "mediatek,camera_eeprom";
			reg = <0x51>;
			status = "okay";
			phandle = <0x264>;
		};

		camera_eeprom4@51 {
			compatible = "mediatek,camera_eeprom";
			reg = <0x51>;
			status = "okay";
			phandle = <0x265>;
		};

		camera_sub@10 {
			compatible = "mediatek,camera_sub";
			reg = <0x10>;
			status = "okay";
			phandle = <0x26b>;
		};

		camera_sub_eeprom@51 {
			compatible = "mediatek,camera_sub_eeprom";
			reg = <0x51>;
			status = "okay";
			phandle = <0x26c>;
		};
};

&i2c5 {
		subpmic@34 {
			compatible = "mediatek,mt6360";
			reg = <0x34>;
			status = "okay";
			phandle = <0x26d>;
			interrupt-parent = <&pio>;
			interrupts = <0x18 0x02>;
			interrupt-names = "IRQB";
			interrupt-controller;
			#interrupt-cells = <0x01>;
			wakeup-source;

			charger {
				compatible = "mediatek,mt6360-chg";
				richtek,vinovp-microvolt = <0xdd40a0>;
				phandle = <0x284>;

				otg_vbus: usb-otg-vbus-regulator {
					regulator-name = "usb-otg-vbus";
					regulator-min-microvolt = <0x438528>;
					regulator-max-microvolt = <0x58e1e8>;
					phandle = <0x287>;
				};
			};

			adc {
				compatible = "mediatek,mt6360-adc";
				#io-channel-cells = <0x01>;
				phandle = <0x283>;
			};

			tcpc {
				compatible = "mediatek,mt6360-tcpc";
				interrupt-parent = <&pio>;
				interrupts = <0x19 0x08>;
				interrupt-names = "PD_IRQB";
				usb-role-switch = <0xf2>;

				connector {
					compatible = "usb-c-connector";
					label = "USB-C";
					data-role = "dual";
					power-role = "dual";
					try-power-role = "sink";
					op-sink-microwatt = <0x19bfcc0>;
					source-pdos = <0x4019064>;
					sink-pdos = <0x401912c 0x402d12c 0x403c0e1>;
				};
			};
		};

		usb_type_c@4e {
			compatible = "mediatek,usb_type_c";
			reg = <0x4e>;
			status = "disabled";
			phandle = <0x26e>;
		};

		subpmic_pmic@1a {
			compatible = "mediatek,subpmic_pmic";
			reg = <0x1a>;
			status = "okay";
			phandle = <0x26f>;
		};

		subpmic_ldo@64 {
			compatible = "mediatek,subpmic_ldo";
			reg = <0x64>;
			status = "okay";
			phandle = <0x270>;
		};
};

&i2c6 {
		ext_buck_vmddr_mtk: ext_buck_vmddr@51 {
			compatible = "mediatek,ext_buck_vmddr";
			reg = <0x51>;
			regulator-name = "ext_buck_vmddr";
			regulator-min-microvolt = <0x493e0>;
			regulator-max-microvolt = <0x13d620>;
			status = "okay";
			phandle = <0x1ae>;
		};

		ext_buck_vufs12: ext_buck_vufs12@56 {
			compatible = "mediatek,ext_buck_vufs12";
			reg = <0x56>;
			regulator-name = "ext_buck_vufs12";
			regulator-min-microvolt = <0x493e0>;
			regulator-max-microvolt = <0x13d620>;
			regulator-always-on;
			status = "okay";
			phandle = <0x1af>;
		};

		speaker_amp: speaker_amp@34 {
			compatible = "mediatek,speaker_amp";
			#sound-dai-cells = <0x00>;
			reg = <0x34>;
			status = "okay";
			phandle = <0xee>;
		};

		cs35l41@40 {
			compatible = "cirrus,cs35l41";
			#sound-dai-cells = <0x00>;
			reg = <0x40>;
			interrupt-parent = <&pio>;
			interrupts = <0x1f 0x08>;
			sound-name-prefix = "Right";
			cirrus,boost-peak-milliamp = <0x1194>;
			cirrus,boost-ind-nanohenry = <0x3e8>;
			cirrus,boost-cap-microfarad = <0x0f>;
			cirrus,asp-sdout-hiz = <0x01>;
			reset-gpios = <&pio 0x1e 0x0>;
			phandle = <0x261>;
		};

		cs35l41@42 {
			compatible = "cirrus,cs35l41";
			#sound-dai-cells = <0x00>;
			reg = <0x42>;
			sound-name-prefix = "Left";
			cirrus,boost-peak-milliamp = <0x1194>;
			cirrus,boost-ind-nanohenry = <0x3e8>;
			cirrus,boost-cap-microfarad = <0x0f>;
			cirrus,asp-sdout-hiz = <0x01>;
			cirrus,tuning-has-prefix;
			cirrus,gpio2-src-select = <0x04>;
			cirrus,gpio2-output-enable;
			phandle = <0x262>;
		};

		i2c_lcd_bias@11 {
			compatible = "mediatek,i2c_lcd_bias";
			reg = <0x11>;
			status = "okay";
			phandle = <0x271>;
		};

		dp_switch@50 {
			compatible = "mediatek,dp_switch";
			reg = <0x50>;
			status = "okay";
			phandle = <0x272>;
		};

		ext_buck_vmddr@61 {
			compatible = "mediatek,ext_buck_vmddr";
			reg = <0x61>;
			status = "okay";
			phandle = <0x273>;
		};
};

&i2c7 {
		st21nfc@08 {
			compatible = "mediatek,nfc";
			reg = <0x08>;
			gpio-irq = <0x0b>;
			gpio-irq-std = <0x02 0x0b 0x00>;
			interrupt-parent = <&pio>;
			interrupts = <0x0b 0x04 0x0b 0x00>;
			gpio-rst = <0x0a>;
			gpio-rst-std = <0x02 0x0a 0x00>;
			interrupt-names = "nfc_irq";
			pinctrl-names = "default", "nfc_active", "nfc_suspend";
			pinctrl-0 = <0xff>;
			pinctrl-1 = <0x100 0x102>;
			pinctrl-2 = <0x101 0x103>;
		};

		nfc@08 {
			compatible = "mediatek,nfc";
			reg = <0x08>;
			status = "okay";
			phandle = <0x274>;
		};

		willsemi,ldo@28 {
			compatible = "willsemi,wl2866d1";
			reg = <0x28>;
			index = <0x0>;
			phandle = <0x27f>;

			on,wl2866d1@0 {
				offset = [00 00];
				regulator-name = "wl2866d-dvdd1";
				regulator-min-microvolt = <0x927c0>;
				regulator-max-microvolt = <0x1b7740>;
				min-dropout-voltage = <0x13880>;
				iout_ua = <0x7a120>;
				init-voltage = <0x100590>;
				phandle = <0x1f5>;
			};

			on,wl2866d1@1 {
				offset = [00 01];
				regulator-name = "wl2866d-dvdd2";
				regulator-min-microvolt = <0x927c0>;
				regulator-max-microvolt = <0x1b7740>;
				min-dropout-voltage = <0x13880>;
				iout_ua = <0x7a120>;
				init-voltage = <0x124f80>;
				phandle = <0x1f3>;
			};

			on,wl2866d1@2 {
				offset = [00 02];
				regulator-name = "wl2866d-avdd1";
				regulator-min-microvolt = <0x124f80>;
				regulator-max-microvolt = <0x419ce0>;
				min-dropout-voltage = <0x15f90>;
				iout_ua = <0x493e0>;
				init-voltage = <0x2ab980>;
				phandle = <0x1f4>;
			};

			on,wl2866d1@3 {
				offset = [00 03];
				regulator-name = "wl2866d-avdd2";
				regulator-min-microvolt = <0x124f80>;
				regulator-max-microvolt = <0x419ce0>;
				min-dropout-voltage = <0x15f90>;
				iout_ua = <0x493e0>;
				init-voltage = <0x2ab980>;
				phandle = <0x1f6>;
			};
		};
};

&i2c8 {
		camera_eeprom2@52 {
			compatible = "mediatek,camera_eeprom";
			reg = <0x52>;
			status = "okay";
			phandle = <0x266>;
		};

		camera_eeprom3@50 {
			compatible = "mediatek,camera_eeprom";
			reg = <0x50>;
			status = "okay";
			phandle = <0x267>;
		};

		camera_main_two@37 {
			compatible = "mediatek,camera_main_two";
			reg = <0x37>;
			status = "okay";
			phandle = <0x275>;
		};

		camera_main_two_eeprom@52 {
			compatible = "mediatek,camera_main_two_eeprom";
			reg = <0x52>;
			status = "okay";
			phandle = <0x276>;
		};

		camera_main_two_af@0c {
			compatible = "mediatek,camera_main_two_af";
			reg = <0x0c>;
			status = "okay";
			phandle = <0x277>;
		};

		camera_sub_two@1a {
			compatible = "mediatek,camera_sub_two";
			reg = <0x1a>;
			status = "okay";
			phandle = <0x278>;
		};

		camera_sub_two_eeprom@50 {
			compatible = "mediatek,camera_sub_two_eeprom";
			reg = <0x50>;
			status = "okay";
			phandle = <0x279>;
		};
};

&i2c9 {
		et7480@42 {
			status = "ok";
			compatible = "mediatek,et7480-audioswitch";
			reg = <0x42>;
			pinctrl-names = "uart_enable", "uart_disable";
			pinctrl-0 = <0x1e0>;
			pinctrl-1 = <0x1e1>;
			phandle = <0x1e2>;
		};

		i2c_lcd_dvdd@50 {
			compatible = "mediatek,i2c_lcd_dvdd";
			reg = <0x50>;
			status = "okay";
			phandle = <0x27a>;
		};

		camera_main_three_af@0c {
			compatible = "mediatek,camera_main_three_af";
			reg = <0x0c>;
			status = "okay";
			phandle = <0x27b>;
		};

		bq2597x-master@65 {
			compatible = "ti,bq2597x-master";
			reg = <0x65>;
			interrupt-parent = <&pio>;
			interrupts = <0x15 0x02 0x15 0x00>;
			pinctrl-names = "bq2597x_master_irq";
			pinctrl-0 = <0x244 0x245>;
			charger_name = "tertiary_chg";
			ti,bq2597x,bat-ucp-alarm-disable;
			ti,bq2597x,bat-ucp-disable;
			ti,bq2597x,bat-therm-disable;
			ti,bq2597x,bus-therm-disable;
			ti,bq2597x,die-therm-disable;
			ti,bq2597x,bat-ovp-threshold = <0x122a>;
			ti,bq2597x,bat-ovp-alarm-threshold = <0x1211>;
			ti,bq2597x,bat-ocp-threshold = <0x1b58>;
			ti,bq2597x,bat-ocp-alarm-threshold = <0x1770>;
			ti,bq2597x,bus-ovp-threshold = <0x2ee0>;
			ti,bq2597x,bus-ovp-alarm-threshold = <0x2af8>;
			ti,bq2597x,bus-ocp-threshold = <0xea6>;
			ti,bq2597x,bus-ocp-alarm-threshold = <0xdac>;
			ti,bq2597x,bat-therm-threshold = <0x15>;
			ti,bq2597x,bus-therm-threshold = <0x15>;
			ti,bq2597x,die-therm-threshold = <0x91>;
			ti,bq2597x,ac-ovp-threshold = <0x0e>;
			sc8551,ac-ovp-threshold = <0x0d>;
			sc8551,bypass-enable;
			sc8551a,dual-stdalone-scheme;
		};

		willsemi,ldo@28 {
			compatible = "willsemi,wl2866d2";
			reg = <0x28>;
			index = <0x01>;
			phandle = <0x280>;

			on,wl2866d2@0 {
				offset = [00 00];
				regulator-name = "wl2866d-dvdd1";
				regulator-min-microvolt = <0x927c0>;
				regulator-max-microvolt = <0x1b7740>;
				min-dropout-voltage = <0x13880>;
				iout_ua = <0x7a120>;
				init-voltage = <0x100590>;
				phandle = <0x1f8>;
			};

			on,wl2866d2@1 {
				offset = [00 01];
				regulator-name = "wl2866d-dvdd2";
				regulator-min-microvolt = <0x927c0>;
				regulator-max-microvolt = <0x1b7740>;
				min-dropout-voltage = <0x13880>;
				iout_ua = <0x7a120>;
				init-voltage = <0x13d620>;
				phandle = <0x24d>;
			};

			on,wl2866d2@2 {
				offset = [00 02];
				regulator-name = "wl2866d-avdd1";
				regulator-min-microvolt = <0x124f80>;
				regulator-max-microvolt = <0x419ce0>;
				min-dropout-voltage = <0x15f90>;
				iout_ua = <0x493e0>;
				init-voltage = <0x2ab980>;
				phandle = <0x1f7>;
			};

			on,wl2866d2@3 {
				offset = [00 03];
				regulator-name = "wl2866d-avdd2";
				regulator-min-microvolt = <0x124f80>;
				regulator-max-microvolt = <0x419ce0>;
				min-dropout-voltage = <0x15f90>;
				iout_ua = <0x493e0>;
				init-voltage = <0x2ab980>;
				phandle = <0x23b>;
			};
		};

		aw8697_haptic@5a {
			compatible = "awinic,aw8697_haptic";
			reg = <0x5a>;
			reset-gpio = <&pio 0x81 0x0>;
			irq-gpio = <&pio 0x16 0x0>;
			vib_mode = <0x00>;
			vib_f0_pre = <0x6a4>;
			vib_f0_cali_percen = <0x07>;
			vib_cont_drv_lev = <0x3c>;
			vib_cont_drv_lvl_ov = <0x3c>;
			vib_cont_td = <0xef>;
			vib_cont_zc_thr = <0x8f8>;
			vib_cont_num_brk = <0x03>;
			vib_f0_coeff = <0x104>;
			vib_f0_trace_parameter = <0x05 0x03 0x02 0x0f>;
			vib_bemf_config = <0x00 0x08 0x03 0xf8>;
			vib_sw_brake = <0x2c>;
			vib_tset = <0x1a>;
			vib_r_spare = <0x68>;
			vib_bstdbg = <0x30 0xeb 0xd4 0x00 0x00 0x00>;
			vib_effect_id_boundary = <0x0a>;
			vib_effect_max = <0xc5>;
			vib_trig_config = <0x00 0x01 0x00 0x01 0x02 0x00 0x01 0x00 0x01 0x02 0x00 0x01 0x00 0x01 0x02>;
			vib_bst_vol_default = <0x0f>;
			vib_bst_vol_ram = <0x0f>;
			vib_bst_vol_rtp = <0x0f>;
			vib_rtp_time = <0x14 0x14 0x14 0x14 0x14 0x14 0x14 0x14 0x4e20 0x3a98 0x3a98 0x4e20 0x61a8 0x3a98 0x7530 0x61a8 0x4e20 0x4e20 0x4e20 0x4e20 0x4e20 0x4e20 0x4e20 0x4e20 0x4e20 0x4e20 0x4e20 0x4e20 0x4e20 0x4e20 0x4e20 0x4e20 0x4e20 0x4e20 0x4e20 0x4e20 0x4e20 0x4e20 0x4e20 0x4e20 0x4e20 0x4e20 0x4e20 0x4e20 0x4e20 0x4e20 0x4e20 0x4e20 0x4e20 0x4e20 0x4e20 0x4e20 0x4e20 0x4e20 0x4e20 0x4e20 0x4e20 0x4e20 0x4e20 0x4e20 0x4e20 0x4e20 0x4e20 0x4e20 0x4e20 0x4e20 0x4e20 0x4e20 0x4e20 0x4e20 0x4e20 0x4e20 0x4e20 0x4e20 0x4e20 0x4e20 0x4e20 0x4e20 0x4e20 0x4e20 0x4e20 0x4e20 0x4e20 0x4e20 0x4e20 0x4e20 0x4e20 0x4e20 0x4e20 0x4e20 0x4e20 0x4e20 0x4e20 0x4e20 0x4e20 0x4e20 0x4e20 0x4e20 0x4e20 0x4e20 0x4e20 0x4e20 0x4e20 0x4e20 0x4e20 0x4e20 0x4e20 0x4e20 0x4e20 0x4e20 0x4e20 0x4e20 0x4e20 0x4e20 0x4e20 0x4e20 0x4e20 0x4e20 0x4e20 0x4e20 0x4e20 0x4e20 0x4e20 0x4e20 0x4e20 0x4e20 0x4e20 0x4e20 0x4e20 0x4e20 0x4e20 0x4e20 0x4e20 0x4e20 0x4e20 0x4e20 0x4e20 0x4e20 0x4e20 0x4e20 0x4e20 0x4e20 0x4e20 0x4e20 0x4e20 0x4e20 0x4e20 0x4e20 0x4e20 0x4e20 0x4e20 0x4e20 0x4e20 0x4e20 0x4e20 0x4e20 0x4e20 0x4e20 0x4e20 0x4e20 0x4e20 0x4e20 0x4e20 0x4e20 0x4e20 0x4e20 0x4e20 0x4e20 0x4e20 0x4e20 0x4e20 0x4e20 0x4e20 0x4e20 0x4e20>;
			pinctrl-names = "aw8697_reset_reset", "aw8697_reset_active", "aw8697_interrupt_active";
			pinctrl-0 = <0x250>;
			pinctrl-1 = <0x251>;
			pinctrl-2 = <0x252>;
			status = "ok";

			wf_0 {
				mtk,effect-id = <0x0>;
				mtk,wf-vmax-mv = <0xe10>;
				mtk,wf-pattern = [3e 3e];
				mtk,wf-brake-pattern = <0x2010000>;
				mtk,wf-play-rate-us = <0x4e20>;
			};

			wf_1 {
				mtk,effect-id = <0x01>;
				mtk,wf-vmax-mv = <0xe10>;
				mtk,wf-pattern = [7e 3e];
				mtk,wf-brake-pattern = <0x3010000>;
				mtk,wf-play-rate-us = <0x4e20>;
			};

			wf_2 {
				mtk,effect-id = <0x02>;
				mtk,wf-vmax-mv = <0xe10>;
				mtk,wf-pattern = [7e 3e];
				mtk,wf-brake-pattern = <0x2010000>;
				mtk,wf-play-rate-us = <0x4e20>;
			};

			wf_3 {
				mtk,effect-id = <0x03>;
				mtk,wf-vmax-mv = <0xe10>;
				mtk,wf-pattern = [3e 3e];
				mtk,wf-brake-pattern = <0x2010000>;
				mtk,wf-play-rate-us = <0x4e20>;
			};

			wf_4 {
				mtk,effect-id = <0x04>;
				mtk,wf-vmax-mv = <0xe10>;
				mtk,wf-pattern = [3e 3e];
				mtk,wf-brake-pattern = <0x2010000>;
				mtk,wf-play-rate-us = <0x6d60>;
			};

			wf_5 {
				mtk,effect-id = <0x05>;
				mtk,wf-vmax-mv = <0xe10>;
				mtk,wf-pattern = [7e 7e 7e];
				mtk,wf-brake-pattern = <0x3030100>;
				mtk,wf-play-rate-us = <0x4e20>;
			};

			wf_6 {
				mtk,effect-id = <0x06>;
				mtk,wf-vmax-mv = <0xe10>;
				mtk,wf-pattern = [3e 3e];
				mtk,wf-brake-pattern = <0x2010000>;
				mtk,wf-play-rate-us = <0x4e20>;
			};

			wf_7 {
				mtk,effect-id = <0x07>;
				mtk,wf-vmax-mv = <0xe10>;
				mtk,wf-pattern = [3e 3e];
				mtk,wf-brake-pattern = <0x2010000>;
				mtk,wf-play-rate-us = <0x4e20>;
			};

			wf_8 {
				mtk,effect-id = <0x08>;
				mtk,wf-vmax-mv = <0xe10>;
				mtk,wf-pattern = [3e 3e];
				mtk,wf-brake-pattern = <0x2010000>;
				mtk,wf-play-rate-us = <0x4e20>;
			};

			wf_9 {
				mtk,effect-id = <0x09>;
				mtk,wf-vmax-mv = <0xe10>;
				mtk,wf-pattern = [3e 3e];
				mtk,wf-brake-pattern = <0x2010000>;
				mtk,wf-play-rate-us = <0x4e20>;
			};
		};
};


/* spi devices and the panel */
&dsi0 {
		panel1@0 {
			compatible = "k10a_36_02_0a_dsc_vdo,lcm";
			reg = <0x0>;
			dvdd-supply = <0x24d>;
			reset-gpios = <&pio 0x2a 0x0>;
			bias-gpios = <&pio 0x7e 0x0 &pio 0x94 0x0>;
			pinctrl-names = "default";
			status = "disabled";

			port {

				endpoint {
					remote-endpoint = <&dsi_out>;
					phandle = <0x24f>;
				};
			};
		};

		panel2@1 {
			compatible = "k10a_42_02_0b_dsc_vdo,lcm";
			reg = <0x01>;
			dvdd-supply = <0x24d>;
			reset-gpios = <&pio 0x2a 0x0>;
			bias-gpios = <&pio 0x7e 0x0 &pio 0x94 0x0>;
			pinctrl-names = "default";
			status = "disabled";

			port {

				endpoint {
					remote-endpoint = <&dsi_out>;
					phandle = <0x281>;
				};
			};
		};

		ports {
			#address-cells = <0x01>;
			#size-cells = <0x00>;

			port {

				dsi_out: endpoint {
					remote-endpoint = <&panel_in>;
					phandle = <0x24e>;
				};
			};
		};

		panel@0 {
			compatible = "l16_36_02_0b_dsc_vdo,lcm";
			reg = <0x0>;
			reset-gpios = <&pio 0x2a 0x0>;
			status = "okay";
			dvdd-supply = <0x1f3>;
			backlight = <0x271>;

			port {

				panel_in: endpoint {
					remote-endpoint = <&dsi_out>;
					phandle = <0xec>;
				};
			};
		};
};

&spi0 {
		ts_novatek@0 {
			compatible = "novatek,NVT-ts-spi";
			reg = <0x0>;
			status = "ok";
			novatek,invert-y;
			spi-max-frequency = <0x927c00>;
			spi-cs-setup-delay-ns = <0x7d0>;
			spi-cs-hold-delay-ns = <0x7d0>;
			novatek,irq-gpio = <&pio 0x13 0x2001>;
			pinctrl-names = "pmx_ts_active", "pmx_ts_suspend";
			pinctrl-0 = <0x253 0x254>;
			pinctrl-1 = <0x255 0x256>;
			novatek,swrst-n8-addr = <0x3f0fe>;
			novatek,spi-rd-fast-addr = <0x3f310>;
			novatek,config-array-size = <0x02>;

			novatek,cfg_0 {
				novatek,tp-vendor = <0x46>;
				novatek,display-maker = <0x36>;
				novatek,fw-name = "novatek_nt36672c_k10a_fw01.bin";
				novatek,mp-name = "novatek_nt36672c_k10a_mp01.bin";
				novatek,clicknum-file-name = "nvt+tianma";
			};

			novatek,cfg_1 {
				novatek,tp-vendor = <0x53>;
				novatek,display-maker = <0x42>;
				novatek,fw-name = "novatek_nt36672c_k10a_fw02.bin";
				novatek,mp-name = "novatek_nt36672c_k10a_mp02.bin";
				novatek,clicknum-file-name = "nvt+csot";
			};
		};
};

&spi1 {
		fingerprint@0 {
			compatible = "goodix,goodix-fp";
			reg = <0x0>;
			spi-max-frequency = <0x7a1200>;
			netlink-event = <0x1e>;
			vfp-supply = <&mt_pmic_vmc_ldo_reg>;
			power-type = <0x01>;
			status = "okay";
		};
};

&spi5 {
		st54spi@0 {
			compatible = "st,st54spi";
			reg = <0x0>;
			spi-max-frequency = <0x4c4b40>;
			gpio-power_nreset = <0x0d>;
			gpio-power_nreset-std = <0x02 0x0d 0x00>;
			power_mode = "ST54H";
			pinctrl-names = "pinctrl_state_mode_idle", "pinctrl_state_mode_spi";
			pinctrl-0 = <0xb3>;
			pinctrl-1 = <0xb4>;
			status = "okay";
		};
};


/* ===================== denniz: first-boot overrides ===================== */
/* Board devices of the Xiaomi handset (or unknown wiring on denniz): off. */
&i2c0 {
	status = "disabled";
};

&i2c2 {
	status = "disabled";
};

&i2c4 {
	status = "disabled";
};

&i2c5 {
	status = "disabled";
};

&i2c6 {
	status = "disabled";
};

&i2c7 {
	status = "disabled";
};

&i2c8 {
	status = "disabled";
};

&i2c9 {
	status = "disabled";
};

&spi0 {
	status = "disabled";
};

&spi1 {
	status = "disabled";
};

&spi5 {
	status = "disabled";
};

&dsi0 {
	status = "disabled";
};

&xiaomi_touch {
	status = "disabled";
};

&cp_qc30 {
	status = "disabled";
};

&usbpd_pm {
	status = "disabled";
};

&sensor_hub {
	status = "disabled";
};

&scp_start {
	status = "disabled";
};

/* EINT 12 is the chopin SCP sensor data-ready line (kept unmasked for the SCP firmware). On denniz no SCP
 * runs in recovery mode and the line is wired differently: left unmasked it storms (RCU stall in
 * mtk_eint_do_init, watchdog reboot - first denniz boot, 2026-11-14). */
&pio {
	/delete-property/ mediatek,eint-keep-unmasked;
};

/* USB 2.0 device mode only: no role switch, never drive the MT6360 OTG boost. */
&{/usb@11201000} {
	dr_mode = "peripheral";
	/delete-property/ usb-role-switch;
	/delete-property/ role-switch-default-mode;
	/delete-property/ vbus-supply;
};

/* Fuel gauge: TI bq28z610 on i2c7 at 0x55, 100 kHz (from denniz's own tree). */
&i2c7 {
	status = "okay";
	clock-frequency = <100000>;
	/delete-node/ st21nfc@08;
	/delete-node/ nfc@08;
	/delete-node/ willsemi,ldo@28;

	battery@55 {
		compatible = "ti,bq28z610";
		reg = <0x55>;
	};
};
